VERSION "created by canmatrix"

NS_ :

BS_:

BU_: IPD

BO_ 118 ZXD1_CHCANFD_10ms_FrP78: 16 Vector__XXX
 SG_ IICBtoVMCEPSRsvd02 : 15|3@0+ (1,0) [0|7] "null" Vector__XXX
 SG_ IICBtoVMCEPSRsvd03 : 23|8@0+ (1,0) [0|255] "null" Vector__XXX
 SG_ IICBtoVMCEPSRsvd04 : 31|16@0+ (1,0) [0|65535] "null" Vector__XXX
 SG_ IICBHigLeCtrlSts : 45|4@0+ (1,0) [0|15] "null" IPD
 SG_ IICBtoVMCEPSRsvd01 : 47|2@0+ (1,0) [0|3] "null" Vector__XXX
 SG_ IICBHigLeCtrlReason : 51|4@0+ (1,0) [0|15] "null" IPD
 SG_ IICBHigLeCtrlFltSts : 55|4@0+ (1,0) [0|15] "null" IPD
 SG_ IAIbotSphereLampColorR : 71|8@0+ (1,0) [0|255] "null" Vector__XXX
 SG_ IAIbotSphereLampColorG : 79|8@0+ (1,0) [0|255] "null" Vector__XXX
 SG_ IAIbotSphereLampColorB : 87|8@0+ (1,0) [0|255] "null" Vector__XXX

BO_ 805 ZXD_BKBCANFD_100ms_FrP257: 24 Vector__XXX
 SG_ INOAQukChgSwReq : 12|1@0+ (1,0) [0|1] "null" IPD
 SG_ IPDCPwrSts : 13|1@0+ (1,0) [0|1] "null" Vector__XXX
 SG_ IMMCUPwrSts : 14|1@0+ (1,0) [0|1] "null" Vector__XXX
 SG_ IFICMACRTemV : 15|1@0+ (1,0) [0|1] "null" Vector__XXX
 SG_ IAIParkngReq_ZXD : 23|8@0+ (1,0) [0|255] "null" IPD
 SG_ IFICMACRAirMdSwReq : 25|2@0+ (1,0) [0|3] "null" Vector__XXX
 SG_ IFICMACLAirMdSwReq : 27|2@0+ (1,0) [0|3] "null" Vector__XXX
 SG_ IFICMACIonizerReqSwReq : 29|2@0+ (1,0) [0|3] "null" Vector__XXX
 SG_ IFICMACFreshSwReq : 31|2@0+ (1,0) [0|3] "null" Vector__XXX
 SG_ IFICMClmOnOffSwReq : 33|2@0+ (1,0) [0|3] "null" Vector__XXX
 SG_ IFICMACSyncSwReq : 35|2@0+ (1,0) [0|3] "null" Vector__XXX
 SG_ IFICMACRTemIncSwReq : 37|2@0+ (1,0) [0|3] "null" Vector__XXX
 SG_ IFICMACRTemDecSwReq : 39|2@0+ (1,0) [0|3] "null" Vector__XXX
 SG_ IFICMAirClnrBlwrLvlReq : 42|3@0+ (1,0) [0|7] "null" Vector__XXX
 SG_ IFICMACRTemReq : 47|5@0+ (0.5,15.5) [15.5|31] "null" Vector__XXX
 SG_ IAutoLaneChngVcCmd : 51|4@0+ (1,0) [0|15] "null" IPD
 SG_ IFICMIFPACOnOffSwReq : 57|2@0+ (1,0) [0|3] "null" Vector__XXX
 SG_ INOAReportSetSwReq : 60|3@0+ (1,0) [0|7] "null" IPD
 SG_ INarRoVslAssSwReq : 63|3@0+ (1,0) [0|7] "null" IPD
 SG_ IParkngSpdSwResp : 65|2@0+ (1,0) [0|3] "null" IPD
 SG_ INrwroadBwdAssSwReq : 68|3@0+ (1,0) [0|7] "null" IPD
 SG_ IAutoLaneChngSwReq : 71|3@0+ (1,0) [0|7] "null" IPD
 SG_ IESSAdoWrnngReq : 73|2@0+ (1,0) [0|3] "null" IPD
 SG_ IAutoLaneChngSetReq : 75|2@0+ (1,0) [0|3] "null" IPD
 SG_ IAPAOneKeyParkSwReq : 79|2@0+ (1,0) [0|3] "null" IPD
 SG_ INarRoVslAssQuit : 81|2@0+ (1,0) [0|3] "null" IPD
 SG_ ILCRSwReq : 83|2@0+ (1,0) [0|3] "null" IPD
 SG_ IFrtCarGoNotfrSwReq : 85|2@0+ (1,0) [0|3] "null" IPD
 SG_ IESSswReq : 87|2@0+ (1,0) [0|3] "null" IPD
 SG_ INOPSwReq : 89|2@0+ (1,0) [0|3] "null" IPD
 SG_ INOPCitySwReq : 91|2@0+ (1,0) [0|3] "null" IPD
 SG_ INOALaneSetSwReq : 93|2@0+ (1,0) [0|3] "null" IPD
 SG_ INOAETCSetSwReq : 95|2@0+ (1,0) [0|3] "null" IPD
 SG_ IWlcmLghtReq : 96|1@0+ (1,0) [0|1] "null" Vector__XXX
 SG_ ID2DSwReq : 98|2@0+ (1,0) [0|3] "null" Vector__XXX
 SG_ IPEBSwReq : 99|1@0+ (1,0) [0|1] "null" IPD
 SG_ IParkngDirSw : 101|2@0+ (1,0) [0|3] "null" IPD
 SG_ INrwroadBwdAssConfrmSwReq : 103|2@0+ (1,0) [0|3] "null" IPD
 SG_ IDistToDsttnNavForSus : 111|8@0+ (2,0) [0|510] "m" Vector__XXX
 SG_ IFrwlLghtReq : 112|1@0+ (1,0) [0|1] "null" Vector__XXX
 SG_ IFollowMeHomeReq : 113|1@0+ (1,0) [0|1] "null" Vector__XXX
 SG_ IFVCMPowerFailSwReq : 117|2@0+ (1,0) [0|3] "null" Vector__XXX
 SG_ ID2DPriETClanSwReq : 119|2@0+ (1,0) [0|3] "null" Vector__XXX
 SG_ ISLIFWrnngMdReq : 126|2@0+ (1,0) [0|3] "null" IPD
 SG_ IAIParkngEPAMdsw : 127|1@0+ (1,0) [0|1] "null" IPD

BO_ 534 ZXD_BKBCANFD_50ms_FrP256: 16 Vector__XXX
 SG_ ISWSPB3SwStuckL : 12|1@0+ (1,0) [0|1] "null" IPD
 SG_ ISWSSelRSwStuckL : 13|1@0+ (1,0) [0|1] "null" IPD
 SG_ ISWSSelLSwStuckL : 14|1@0+ (1,0) [0|1] "null" IPD
 SG_ ISWSPB2SwStuckL : 15|1@0+ (1,0) [0|1] "null" IPD
 SG_ IRoadCrvt : 23|18@0+ (0.005,-655.36) [-655.360|655.355] "null" Vector__XXX
 SG_ IRoadSlope : 35|12@0+ (0.2,-450) [-450|369] "null" Vector__XXX
 SG_ ISWSCnfmSwStuckL : 37|1@0+ (1,0) [0|1] "null" IPD
 SG_ IRoadCrvtDist : 55|10@0+ (1,0) [0|1023] "null" Vector__XXX
 SG_ IRoadSlopeDist : 57|10@0+ (1,0) [0|1023] "null" Vector__XXX
 SG_ ISWSPB1SwStuckL : 58|1@0+ (1,0) [0|1] "null" IPD
 SG_ IDMSSts : 61|3@0+ (1,0) [0|7] "null" IPD
 SG_ IRoughRoaddetectionDist : 79|10@0+ (1,0) [0|1023] "null" Vector__XXX
 SG_ ISWSSelLSwAL : 81|2@0+ (1,0) [0|3] "null" IPD
 SG_ ISWSSelDwnSwAL : 83|2@0+ (1,0) [0|3] "null" IPD
 SG_ ISWSSelUpSwAL : 85|2@0+ (1,0) [0|3] "null" IPD
 SG_ ISWSPB2SwAL : 89|2@0+ (1,0) [0|3] "null" IPD
 SG_ ISWSPB1SwAL : 91|2@0+ (1,0) [0|3] "null" IPD
 SG_ ISWSCnfmSwAL : 93|2@0+ (1,0) [0|3] "null" IPD
 SG_ ISWSSelRSwAL : 95|2@0+ (1,0) [0|3] "null" IPD
 SG_ IRoughRoaddetection : 101|1@0+ (1,0) [0|1] "null" Vector__XXX
 SG_ ISWSPB3SwAL : 103|2@0+ (1,0) [0|3] "null" IPD

BO_ 711 ZXD_BKPCANFD_100ms_FrP76: 16 Vector__XXX
 SG_ ISCFRemSwReq : 13|2@0+ (1,0) [0|3] "null" IPD
 SG_ ISCFSwReq : 15|2@0+ (1,0) [0|3] "null" IPD
 SG_ IICMtoIPDScrnRespC : 17|2@0+ (1,0) [0|3] "null" IPD
 SG_ IMemParkngBtnRcnmCfm : 19|2@0+ (1,0) [0|3] "null" IPD
 SG_ ISLWFWarSwReq : 21|2@0+ (1,0) [0|3] "null" IPD
 SG_ ISLWFSwReq : 23|2@0+ (1,0) [0|3] "null" IPD
 SG_ ISpdLmtCotNatReq : 31|8@0+ (1,0) [0|255] "null" IPD
 SG_ IICMtoIPDScrnRespA1 : 33|2@0+ (1,0) [0|3] "null" IPD
 SG_ IOrderLaneChgeReq : 36|3@0+ (1,0) [0|7] "null" IPD
 SG_ ISpdLmtCotMdlReq : 39|3@0+ (1,0) [0|7] "null" IPD
 SG_ IAIParkingSoundResp : 41|2@0+ (1,0) [0|3] "null" IPD
 SG_ IACCSLIFMsgReq : 44|3@0+ (1,0) [0|7] "null" IPD
 SG_ IAESSwReq : 49|2@0+ (1,0) [0|3] "null" IPD
 SG_ IRCWPedWrnngSwReq : 52|3@0+ (1,0) [0|7] "null" IPD
 SG_ ISpedRegulaModSwReq : 55|3@0+ (1,0) [0|7] "null" IPD
 SG_ ISpedRegulaPerReq : 59|4@0+ (1,0) [0|15] "null" IPD
 SG_ ISpedRegulaFixeReq : 63|4@0+ (1,0) [0|15] "null" IPD
 SG_ IIPDtoICMScrnRespA2 : 68|2@0+ (1,0) [0|3] "null" IPD
 SG_ IRCWRearCollisionWrnngSwReq : 71|3@0+ (1,0) [0|7] "null" IPD
 SG_ IMemParkingReserveICM1 : 73|2@0+ (1,0) [0|3] "null" IPD
 SG_ INOAE2ESwReq : 76|3@0+ (1,0) [0|7] "null" IPD
 SG_ IIPDCoDrivingPlusSwReq : 79|3@0+ (1,0) [0|7] "null" IPD
 SG_ IMemParkingReserveICM2 : 81|2@0+ (1,0) [0|3] "null" IPD
 SG_ IMemoryDrvSwReq : 84|3@0+ (1,0) [0|7] "null" IPD
 SG_ IPilotE2ESwReq : 87|3@0+ (1,0) [0|7] "null" IPD
 SG_ IMemParkingReserveICM3 : 89|2@0+ (1,0) [0|3] "null" IPD
 SG_ IMemoryRouteSaveCancelReq : 92|3@0+ (1,0) [0|7] "null" IPD
 SG_ IMemoryDrvSetSwReq : 95|3@0+ (1,0) [0|7] "null" IPD
 SG_ INOAE2ESetSeReq : 100|3@0+ (1,0) [0|7] "null" IPD
 SG_ INOAE2ESetReq : 103|3@0+ (1,0) [0|7] "null" IPD
 SG_ IPilotE2ESetSeReq : 108|3@0+ (1,0) [0|7] "null" IPD
 SG_ IPilotE2ESetReq : 111|3@0+ (1,0) [0|7] "null" IPD
 SG_ IMemParkingReserveICM6 : 115|4@0+ (1,0) [0|15] "null" IPD
 SG_ IMemParkingReserveICM5 : 119|4@0+ (1,0) [0|15] "null" IPD
 SG_ IMemParkingReserveICM4 : 127|4@0+ (1,0) [0|15] "null" IPD

BO_ 707 ZXD_BKPCANFD_100ms_FrP77: 32 Vector__XXX
 SG_ IICMSwReq_Reserve11 : 17|2@0+ (1,0) [0|3] "null" IPD
 SG_ IICMSwReq_Reserve02 : 20|3@0+ (1,0) [0|7] "null" IPD
 SG_ IICMSwReq_Reserve01 : 23|3@0+ (1,0) [0|7] "null" IPD
 SG_ IICMSwReq_Reserve12 : 25|2@0+ (1,0) [0|3] "null" IPD
 SG_ IICMSwReq_Reserve04 : 28|3@0+ (1,0) [0|7] "null" IPD
 SG_ IICMSwReq_Reserve03 : 31|3@0+ (1,0) [0|7] "null" IPD
 SG_ IICMSwReq_Reserve13 : 33|2@0+ (1,0) [0|3] "null" IPD
 SG_ IICMSwReq_Reserve06 : 36|3@0+ (1,0) [0|7] "null" IPD
 SG_ IICMSwReq_Reserve05 : 39|3@0+ (1,0) [0|7] "null" IPD
 SG_ IICMSwReq_Reserve14 : 41|2@0+ (1,0) [0|3] "null" IPD
 SG_ IICMSwReq_Reserve08 : 44|3@0+ (1,0) [0|7] "null" IPD
 SG_ IICMSwReq_Reserve07 : 47|3@0+ (1,0) [0|7] "null" IPD
 SG_ IICMSwReq_Reserve15 : 49|2@0+ (1,0) [0|3] "null" IPD
 SG_ IICMSwReq_Reserve10 : 52|3@0+ (1,0) [0|7] "null" IPD
 SG_ IICMSwReq_Reserve09 : 55|3@0+ (1,0) [0|7] "null" IPD
 SG_ IICMSwReq_Reserve19 : 57|2@0+ (1,0) [0|3] "null" IPD
 SG_ IICMSwReq_Reserve18 : 59|2@0+ (1,0) [0|3] "null" IPD
 SG_ IICMSwReq_Reserve17 : 61|2@0+ (1,0) [0|3] "null" IPD
 SG_ IICMSwReq_Reserve16 : 63|2@0+ (1,0) [0|3] "null" IPD
 SG_ IICMSwReq_Reserve20 : 71|2@0+ (1,0) [0|3] "null" IPD
 SG_ IICMwarnType1_Rsrv01 : 73|2@0+ (1,0) [0|3] "null" IPD
 SG_ IICMwarnType2_Rsrv02 : 76|3@0+ (1,0) [0|7] "null" IPD
 SG_ IICMwarnType2_Rsrv01 : 79|3@0+ (1,0) [0|7] "null" IPD
 SG_ IICMwarnType1_Rsrv02 : 81|2@0+ (1,0) [0|3] "null" IPD
 SG_ IICMwarnType2_Rsrv04 : 84|3@0+ (1,0) [0|7] "null" IPD
 SG_ IICMwarnType2_Rsrv03 : 87|3@0+ (1,0) [0|7] "null" IPD
 SG_ IICMwarnType3_Rsrv02 : 91|4@0+ (1,0) [0|15] "null" IPD
 SG_ IICMwarnType3_Rsrv01 : 95|4@0+ (1,0) [0|15] "null" IPD
 SG_ IICMwarnType3_Rsrv04 : 99|4@0+ (1,0) [0|15] "null" IPD
 SG_ IICMwarnType3_Rsrv03 : 103|4@0+ (1,0) [0|15] "null" IPD
 SG_ IICMwarnType2_Rsrv05 : 107|3@0+ (1,0) [0|7] "null" IPD
 SG_ IICMwarnType3_Rsrv05 : 111|4@0+ (1,0) [0|15] "null" IPD
 SG_ IICMwarnType1_Rsrv03 : 114|2@0+ (1,0) [0|3] "null" IPD
 SG_ IICMwarnType4_Rsrv01 : 119|5@0+ (1,0) [0|31] "null" IPD
 SG_ IICMwarnType1_Rsrv04 : 122|2@0+ (1,0) [0|3] "null" IPD
 SG_ IICMwarnType4_Rsrv02 : 127|5@0+ (1,0) [0|31] "null" IPD
 SG_ IICMwarnType1_Rsrv05 : 130|2@0+ (1,0) [0|3] "null" IPD
 SG_ IICMwarnType4_Rsrv03 : 135|5@0+ (1,0) [0|31] "null" IPD
 SG_ IICMwarnType4_Rsrv04 : 143|5@0+ (1,0) [0|31] "null" IPD
 SG_ IICMwarnType4_Rsrv05 : 151|5@0+ (1,0) [0|31] "null" IPD
 SG_ IICMvalue_Rsrv10 : 159|16@0+ (1,0) [0|65535] "null" IPD
 SG_ IICMvalue_Rsrv09 : 175|16@0+ (1,0) [0|65535] "null" IPD
 SG_ IICMvalue_Rsrv08 : 191|12@0+ (1,0) [0|4095] "null" IPD
 SG_ IICMvalue_Rsrv07 : 195|12@0+ (1,0) [0|4095] "null" IPD
 SG_ IICMvalue_Rsrv01 : 215|6@0+ (1,0) [0|63] "null" IPD
 SG_ IICMvalue_Rsrv02 : 223|6@0+ (1,0) [0|63] "null" IPD
 SG_ IICMvalue_Rsrv03 : 231|6@0+ (1,0) [0|63] "null" IPD
 SG_ IICMvalue_Rsrv04 : 239|8@0+ (1,0) [0|255] "null" IPD
 SG_ IICMvalue_Rsrv05 : 247|8@0+ (1,0) [0|255] "null" IPD
 SG_ IICMvalue_Rsrv06 : 255|8@0+ (1,0) [0|255] "null" IPD

BO_ 308 ZXD_PTCANFD_20ms_FrP07: 8 IPD
 SG_ IZXD_20ms_Group07_CRC : 7|8@0+ (1,0) [0|255] "null" Vector__XXX
 SG_ IZXD_20ms_Group07_RC : 11|4@0+ (1,0) [0|15] "null" Vector__XXX
 SG_ IZXD_20ms_Group07_Reserved1 : 15|4@0+ (1,0) [0|15] "null" Vector__XXX
 SG_ IZXD_20ms_Group07_Reserved3 : 18|3@0+ (1,0) [0|7] "null" Vector__XXX
 SG_ IAPAEPBOPReq : 20|2@0+ (1,0) [0|3] "null" Vector__XXX
 SG_ IZXD_20ms_Group07_Reserved2 : 23|3@0+ (1,0) [0|7] "null" Vector__XXX
 SG_ IZXD_20ms_Group07_Reserved4 : 31|8@0+ (1,0) [0|255] "null" Vector__XXX
 SG_ IAIPkgAPASCSAcclReqVal : 34|11@0+ (0.005,-9.22) [-9.220|1.015] "m/s^2" Vector__XXX
 SG_ IZXD_20ms_Group07_Reserved5 : 37|3@0+ (1,0) [0|7] "null" Vector__XXX
 SG_ IAPASCSAcclReqSts : 38|1@0+ (1,0) [0|1] "null" Vector__XXX
 SG_ IAPAEPBOPReqV : 39|1@0+ (1,0) [0|1] "null" Vector__XXX
 SG_ IAutodDrvngSysSCSSdslReqV : 48|1@0+ (1,0) [0|1] "null" Vector__XXX
 SG_ IAutodDrvngSysSCSSdslReq : 49|1@0+ (1,0) [0|1] "null" Vector__XXX
 SG_ IZXD_20ms_Group07_Reserved6 : 55|6@0+ (1,0) [0|63] "null" Vector__XXX
 SG_ IAutodDrvngSysSCSDrvOffReqV : 56|1@0+ (1,0) [0|1] "null" Vector__XXX
 SG_ IAutodDrvngSysSCSDrvOffReq : 57|1@0+ (1,0) [0|1] "null" Vector__XXX
 SG_ IAutodDrvngSysMdReqV : 58|1@0+ (1,0) [0|1] "null" Vector__XXX
 SG_ IAutodDrvngSysMdReq : 59|1@0+ (1,0) [0|1] "null" Vector__XXX
 SG_ IAutodDrvngSysFlrStsV : 60|1@0+ (1,0) [0|1] "null" Vector__XXX
 SG_ IAutodDrvngSysFlrSts : 63|3@0+ (1,0) [0|7] "null" Vector__XXX

BO_ 774 ICBAD_BKPCANFD_100ms_ConFrP31: 64 IPD
 SG_ Header_ID M : 7|24@0- (1,0) [-8388608|8388607] "" Vector__XXX
 SG_ Header_DLC : 31|8@0- (1,0) [-128|127] "" Vector__XXX
 SG_ ITrfcLghtFuctionSwSts m66857 : 61|2@0+ (1,0) [0|3] "null" Vector__XXX
 SG_ IAPASpdMdSwSts m66857 : 63|2@0+ (1,0) [0|3] "null" Vector__XXX
 SG_ IParkngInPrgs m66857 : 71|7@0+ (1,0) [0|127] "percent" Vector__XXX
 SG_ ITrfcMrgdInfoSignDist m66856 : 39|15@0+ (0.0156,-256) [-256.0000|255.1652] "null" Vector__XXX
 SG_ ITrfcMrgdForbidDist m66856 : 63|15@0+ (0.0156,-256) [-256.0000|255.1652] "null" Vector__XXX
 SG_ ITrfcMrgdWrnngSignDist m66856 : 87|15@0+ (0.0156,-256) [-256.0000|255.1652] "null" Vector__XXX
 SG_ ITrfcMrgdForbidSign m66816 : 39|64@0+ (1,0) [0|18446744073709551615] "null" Vector__XXX
 SG_ ITrfcMrgdWrnngSign m66818 : 39|64@0+ (1,0) [0|18446744073709551615] "null" Vector__XXX

BO_ 807 ICBAD_BKPCANFD_100ms_ConFrP34: 64 IPD
 SG_ Header_ID M : 7|24@0- (1,0) [-8388608|8388607] "" Vector__XXX
 SG_ Header_DLC : 31|8@0- (1,0) [-128|127] "" Vector__XXX
 SG_ IEndToEndPilotSwSts m1069061 : 33|2@0+ (1,0) [0|3] "null" Vector__XXX
 SG_ IDLP_NarwSpcAstSts m1069061 : 63|3@0+ (1,0) [0|7] "null" Vector__XXX
 SG_ IACCSLIFMsgResp m66825 : 44|3@0+ (1,0) [0|7] "null" Vector__XXX
 SG_ ISLIFSts_IPD m66825 : 55|3@0+ (1,0) [0|7] "null" Vector__XXX
 SG_ ITSRSts m66825 : 63|3@0+ (1,0) [0|7] "null" Vector__XXX
 SG_ ITSRSwReqResp m66825 : 65|2@0+ (1,0) [0|3] "null" Vector__XXX
 SG_ ITSRTrgtBanSign m66825 : 71|6@0+ (1,0) [0|63] "null" Vector__XXX
 SG_ ITSRTrgtWarnSign m66825 : 78|7@0+ (1,0) [0|127] "null" Vector__XXX
 SG_ ISpdAstSysTrgtSpd_IPD m66825 : 86|15@0+ (0.015625,0) [0.000000|511.984375] "null" Vector__XXX
 SG_ ITrfcMrgdInfoSign m66821 : 39|64@0+ (1,0) [0|18446744073709551615] "null" Vector__XXX

BA_DEF_ BO_ "FrameTriggeringName" STRING;
BA_DEF_ BO_ "GenMsgCycleTime" INT 0 65535;
BA_DEF_ BO_ "GenMsgDelayTime" INT 0 65535;
BA_DEF_ BO_ "GenMsgSendType" ENUM  "cyclicX","spontanX","cyclicIfActiveX","spontanWithDelay","cyclicAndSpontanX","cyclicAndSpontanWithDelay","spontanWithRepitition","cyclicIfActiveAndSpontanWD","cyclicIfActiveFast","cyclicWithRepeatOnDemand","none";
BA_DEF_ BO_ "GenMsgStartValue" STRING;
BA_DEF_ BO_ "PduName" STRING;
BA_DEF_ BO_ "VFrameFormat" ENUM  "StandardCAN","ExtendedCAN","reserved","reserved","reserved","reserved","reserved","reserved","reserved","reserved","reserved","reserved","reserved","reserved","StandardCAN_FD","ExtendedCAN_FD";
BA_DEF_ SG_ "CompuMethodName" STRING;
BA_DEF_ SG_ "GenSigStartValue" FLOAT 0 100000000000;
BA_DEF_ SG_ "ISignalName" STRING;
BA_DEF_ SG_ "LongName" STRING;
BA_DEF_ SG_ "SysSignalName" STRING;
BA_DEF_ SG_ "SystemSignalLongSymbol" STRING;
BA_ "FrameTriggeringName" BO_ 118 "ZXD1_CHCANFD_10ms_FrP78";
BA_ "GenMsgCycleTime" BO_ 118 10;
BA_ "GenMsgSendType" BO_ 118 0;
BA_ "GenMsgStartValue" BO_ 118 "0000000000000000ffffff0000000000";
BA_ "PduName" BO_ 118 "ZXD1_10ms_PDU78";
BA_ "VFrameFormat" BO_ 118 14;
BA_ "FrameTriggeringName" BO_ 805 "ZXD_BKBCANFD_100ms_FrP257";
BA_ "GenMsgCycleTime" BO_ 805 100;
BA_ "GenMsgSendType" BO_ 805 0;
BA_ "GenMsgStartValue" BO_ 805 "0080000000f800000000000000ff00000000000000000000";
BA_ "PduName" BO_ 805 "ICBVC_100ms_PDU257";
BA_ "VFrameFormat" BO_ 805 14;
BA_ "FrameTriggeringName" BO_ 534 "ZXD_BKBCANFD_50ms_FrP256";
BA_ "GenMsgCycleTime" BO_ 534 50;
BA_ "GenMsgSendType" BO_ 534 0;
BA_ "GenMsgStartValue" BO_ 534 "00008000080000000000000000000000";
BA_ "PduName" BO_ 534 "ICBVC_50ms_PDU256";
BA_ "VFrameFormat" BO_ 534 14;
BA_ "FrameTriggeringName" BO_ 711 "ZXD_BKPCANFD_100ms_FrP76";
BA_ "GenMsgCycleTime" BO_ 711 100;
BA_ "GenMsgSendType" BO_ 711 0;
BA_ "GenMsgStartValue" BO_ 711 "00000000000000000000000000000000";
BA_ "PduName" BO_ 711 "ZXD_100ms_PDU76";
BA_ "VFrameFormat" BO_ 711 14;
BA_ "FrameTriggeringName" BO_ 707 "ZXD_BKPCANFD_100ms_FrP77";
BA_ "GenMsgCycleTime" BO_ 707 100;
BA_ "GenMsgSendType" BO_ 707 0;
BA_ "GenMsgStartValue" BO_ 707 "0000000000000000000000000000000000000000000000000000000000000000";
BA_ "PduName" BO_ 707 "ZXD_100ms_PDU77";
BA_ "VFrameFormat" BO_ 707 14;
BA_ "FrameTriggeringName" BO_ 308 "ZXD_PTCANFD_20ms_FrP07";
BA_ "GenMsgCycleTime" BO_ 308 20;
BA_ "GenMsgSendType" BO_ 308 0;
BA_ "GenMsgStartValue" BO_ 308 "00f0e7ff3800fc00";
BA_ "PduName" BO_ 308 "ZXD_20ms_PDU07";
BA_ "VFrameFormat" BO_ 308 14;
BA_ "FrameTriggeringName" BO_ 774 "ICBAD_BKPCANFD_100ms_ConFrP31";
BA_ "GenMsgCycleTime" BO_ 774 100;
BA_ "GenMsgSendType" BO_ 774 1;
BA_ "PduName" BO_ 774 "IPD_BKPCANFD_100ms_Container02";
BA_ "VFrameFormat" BO_ 774 14;
BA_ "FrameTriggeringName" BO_ 807 "ICBAD_BKPCANFD_100ms_ConFrP34";
BA_ "GenMsgCycleTime" BO_ 807 100;
BA_ "GenMsgSendType" BO_ 807 1;
BA_ "PduName" BO_ 807 "IPD_BKPCANFD_100ms_Container03";
BA_ "VFrameFormat" BO_ 807 14;
BA_ "CompuMethodName" SG_ 118 IICBtoVMCEPSRsvd02 "ICBtoVMCEPSRsvd02";
BA_ "ISignalName" SG_ 118 IICBtoVMCEPSRsvd02 "IICBtoVMCEPSRsvd02";
BA_ "LongName" SG_ 118 IICBtoVMCEPSRsvd02 "ICB to VMC EPS Reserved 02";
BA_ "SysSignalName" SG_ 118 IICBtoVMCEPSRsvd02 "ICBtoVMCEPSRsvd02";
BA_ "CompuMethodName" SG_ 118 IICBtoVMCEPSRsvd03 "ICBtoVMCEPSRsvd03";
BA_ "ISignalName" SG_ 118 IICBtoVMCEPSRsvd03 "IICBtoVMCEPSRsvd03";
BA_ "LongName" SG_ 118 IICBtoVMCEPSRsvd03 "ICB to VMC EPS Reserved 03";
BA_ "SysSignalName" SG_ 118 IICBtoVMCEPSRsvd03 "ICBtoVMCEPSRsvd03";
BA_ "CompuMethodName" SG_ 118 IICBtoVMCEPSRsvd04 "ICBtoVMCEPSRsvd04";
BA_ "ISignalName" SG_ 118 IICBtoVMCEPSRsvd04 "IICBtoVMCEPSRsvd04";
BA_ "LongName" SG_ 118 IICBtoVMCEPSRsvd04 "ICB to VMC EPS Reserved 04";
BA_ "SysSignalName" SG_ 118 IICBtoVMCEPSRsvd04 "ICBtoVMCEPSRsvd04";
BA_ "CompuMethodName" SG_ 118 IICBHigLeCtrlSts "ICBHigLeCtrlSts";
BA_ "ISignalName" SG_ 118 IICBHigLeCtrlSts "IICBHigLeCtrlSts";
BA_ "LongName" SG_ 118 IICBHigLeCtrlSts "ICB High Level control Status";
BA_ "SysSignalName" SG_ 118 IICBHigLeCtrlSts "ICBHigLeCtrlSts";
BA_ "CompuMethodName" SG_ 118 IICBtoVMCEPSRsvd01 "ICBtoVMCEPSRsvd01";
BA_ "ISignalName" SG_ 118 IICBtoVMCEPSRsvd01 "IICBtoVMCEPSRsvd01";
BA_ "LongName" SG_ 118 IICBtoVMCEPSRsvd01 "ICB to VMC EPS Reserved 01";
BA_ "SysSignalName" SG_ 118 IICBtoVMCEPSRsvd01 "ICBtoVMCEPSRsvd01";
BA_ "CompuMethodName" SG_ 118 IICBHigLeCtrlReason "ICBHigLeCtrlReason";
BA_ "ISignalName" SG_ 118 IICBHigLeCtrlReason "IICBHigLeCtrlReason";
BA_ "LongName" SG_ 118 IICBHigLeCtrlReason "ICB High Level control respond reason";
BA_ "SysSignalName" SG_ 118 IICBHigLeCtrlReason "ICBHigLeCtrlReason";
BA_ "CompuMethodName" SG_ 118 IICBHigLeCtrlFltSts "ICBHigLeCtrlFltSts";
BA_ "ISignalName" SG_ 118 IICBHigLeCtrlFltSts "IICBHigLeCtrlFltSts";
BA_ "LongName" SG_ 118 IICBHigLeCtrlFltSts "ICB High Level control Fault Status";
BA_ "SysSignalName" SG_ 118 IICBHigLeCtrlFltSts "ICBHigLeCtrlFltSts";
BA_ "CompuMethodName" SG_ 118 IAIbotSphereLampColorR "AIbotSphereLampColorR";
BA_ "GenSigStartValue" SG_ 118 IAIbotSphereLampColorR 255;
BA_ "ISignalName" SG_ 118 IAIbotSphereLampColorR "IAIbotSphereLampColorR";
BA_ "LongName" SG_ 118 IAIbotSphereLampColorR "AIbot Sphere Lamp Color Red";
BA_ "SysSignalName" SG_ 118 IAIbotSphereLampColorR "AIbotSphereLampColorR";
BA_ "CompuMethodName" SG_ 118 IAIbotSphereLampColorG "AIbotSphereLampColorG";
BA_ "GenSigStartValue" SG_ 118 IAIbotSphereLampColorG 255;
BA_ "ISignalName" SG_ 118 IAIbotSphereLampColorG "IAIbotSphereLampColorG";
BA_ "LongName" SG_ 118 IAIbotSphereLampColorG "AIbot Sphere Lamp Color Green";
BA_ "SysSignalName" SG_ 118 IAIbotSphereLampColorG "AIbotSphereLampColorG";
BA_ "CompuMethodName" SG_ 118 IAIbotSphereLampColorB "AIbotSphereLampColorB";
BA_ "GenSigStartValue" SG_ 118 IAIbotSphereLampColorB 255;
BA_ "ISignalName" SG_ 118 IAIbotSphereLampColorB "IAIbotSphereLampColorB";
BA_ "LongName" SG_ 118 IAIbotSphereLampColorB "AIbot Sphere Lamp Color Blue";
BA_ "SysSignalName" SG_ 118 IAIbotSphereLampColorB "AIbotSphereLampColorB";
BA_ "CompuMethodName" SG_ 805 INOAQukChgSwReq "NOAQukChgSwReq";
BA_ "ISignalName" SG_ 805 INOAQukChgSwReq "INOAQukChgSwReq";
BA_ "LongName" SG_ 805 INOAQukChgSwReq "NOA quickly change Switch Request";
BA_ "SysSignalName" SG_ 805 INOAQukChgSwReq "NOAQukChgSwReq";
BA_ "CompuMethodName" SG_ 805 IPDCPwrSts "PDCPwrSts";
BA_ "ISignalName" SG_ 805 IPDCPwrSts "IPDCPwrSts";
BA_ "LongName" SG_ 805 IPDCPwrSts "PDC Power Status";
BA_ "SysSignalName" SG_ 805 IPDCPwrSts "PDCPwrSts";
BA_ "CompuMethodName" SG_ 805 IMMCUPwrSts "MMCUPwrSts";
BA_ "ISignalName" SG_ 805 IMMCUPwrSts "IMMCUPwrSts";
BA_ "LongName" SG_ 805 IMMCUPwrSts "MMCU Power Status";
BA_ "SysSignalName" SG_ 805 IMMCUPwrSts "MMCUPwrSts";
BA_ "CompuMethodName" SG_ 805 IFICMACRTemV "FICMACRTemV";
BA_ "GenSigStartValue" SG_ 805 IFICMACRTemV 1;
BA_ "ISignalName" SG_ 805 IFICMACRTemV "IFICMACRTemV";
BA_ "LongName" SG_ 805 IFICMACRTemV "Front Infotainment Control Module Air Conditioning Right Temperature Validity";
BA_ "SysSignalName" SG_ 805 IFICMACRTemV "FICMACRTemV";
BA_ "CompuMethodName" SG_ 805 IAIParkngReq_ZXD "AIParkngReq_ZXD";
BA_ "ISignalName" SG_ 805 IAIParkngReq_ZXD "IAIParkngReq_ZXD";
BA_ "LongName" SG_ 805 IAIParkngReq_ZXD "ParkingRequest_ZXD";
BA_ "SysSignalName" SG_ 805 IAIParkngReq_ZXD "AIParkngReq_ZXD";
BA_ "CompuMethodName" SG_ 805 IFICMACRAirMdSwReq "FICMACRAirMdSwReq";
BA_ "ISignalName" SG_ 805 IFICMACRAirMdSwReq "IFICMACRAirMdSwReq";
BA_ "LongName" SG_ 805 IFICMACRAirMdSwReq "Front Infotainment Control Module Air Conditioning Mode Switch Request";
BA_ "SysSignalName" SG_ 805 IFICMACRAirMdSwReq "FICMACRAirMdSwReq";
BA_ "CompuMethodName" SG_ 805 IFICMACLAirMdSwReq "FICMACLAirMdSwReq";
BA_ "ISignalName" SG_ 805 IFICMACLAirMdSwReq "IFICMACLAirMdSwReq";
BA_ "LongName" SG_ 805 IFICMACLAirMdSwReq "Front Infotainment Control Module Air Conditioning Mode Switch Request";
BA_ "SysSignalName" SG_ 805 IFICMACLAirMdSwReq "FICMACLAirMdSwReq";
BA_ "CompuMethodName" SG_ 805 IFICMACIonizerReqSwReq "FICMACIonizerReqSwReq";
BA_ "ISignalName" SG_ 805 IFICMACIonizerReqSwReq "IFICMACIonizerReqSwReq";
BA_ "LongName" SG_ 805 IFICMACIonizerReqSwReq "Front Infotainment Control Module Air Condition Ionizer Request Switch Request";
BA_ "SysSignalName" SG_ 805 IFICMACIonizerReqSwReq "FICMACIonizerReqSwReq";
BA_ "CompuMethodName" SG_ 805 IFICMACFreshSwReq "FICMACFreshSwReq";
BA_ "ISignalName" SG_ 805 IFICMACFreshSwReq "IFICMACFreshSwReq";
BA_ "LongName" SG_ 805 IFICMACFreshSwReq "Front Infotainment Control Module Air Condition Fresh Switch Request";
BA_ "SysSignalName" SG_ 805 IFICMACFreshSwReq "FICMACFreshSwReq";
BA_ "CompuMethodName" SG_ 805 IFICMClmOnOffSwReq "FICMClmOnOffSwReq";
BA_ "ISignalName" SG_ 805 IFICMClmOnOffSwReq "IFICMClmOnOffSwReq";
BA_ "LongName" SG_ 805 IFICMClmOnOffSwReq "Front Infotainment Control Module Climate On Off Switch Request";
BA_ "SysSignalName" SG_ 805 IFICMClmOnOffSwReq "FICMClmOnOffSwReq";
BA_ "CompuMethodName" SG_ 805 IFICMACSyncSwReq "FICMACSyncSwReq";
BA_ "ISignalName" SG_ 805 IFICMACSyncSwReq "IFICMACSyncSwReq";
BA_ "LongName" SG_ 805 IFICMACSyncSwReq "Front Infotainment Control Module Air Conditioning Sync Switch Request";
BA_ "SysSignalName" SG_ 805 IFICMACSyncSwReq "FICMACSyncSwReq";
BA_ "CompuMethodName" SG_ 805 IFICMACRTemIncSwReq "FICMACRTemIncSwReq";
BA_ "ISignalName" SG_ 805 IFICMACRTemIncSwReq "IFICMACRTemIncSwReq";
BA_ "LongName" SG_ 805 IFICMACRTemIncSwReq "Front Infotainment Control Module Air Conditioning Right Temperature Increase Switch Request";
BA_ "SysSignalName" SG_ 805 IFICMACRTemIncSwReq "FICMACRTemIncSwReq";
BA_ "CompuMethodName" SG_ 805 IFICMACRTemDecSwReq "FICMACRTemDecSwReq";
BA_ "ISignalName" SG_ 805 IFICMACRTemDecSwReq "IFICMACRTemDecSwReq";
BA_ "LongName" SG_ 805 IFICMACRTemDecSwReq "Front Infotainment Control Module Air Conditioning Right Temperature Decrease Switch Request";
BA_ "SysSignalName" SG_ 805 IFICMACRTemDecSwReq "FICMACRTemDecSwReq";
BA_ "CompuMethodName" SG_ 805 IFICMAirClnrBlwrLvlReq "FICMAirClnrBlwrLvlReq";
BA_ "ISignalName" SG_ 805 IFICMAirClnrBlwrLvlReq "IFICMAirClnrBlwrLvlReq";
BA_ "LongName" SG_ 805 IFICMAirClnrBlwrLvlReq "Front Infotainment Control Module Air Cleaner Blower Level Request";
BA_ "SysSignalName" SG_ 805 IFICMAirClnrBlwrLvlReq "FICMAirClnrBlwrLvlReq";
BA_ "CompuMethodName" SG_ 805 IFICMACRTemReq "FICMACRTemReq";
BA_ "GenSigStartValue" SG_ 805 IFICMACRTemReq 31;
BA_ "ISignalName" SG_ 805 IFICMACRTemReq "IFICMACRTemReq";
BA_ "LongName" SG_ 805 IFICMACRTemReq "Front Infotainment Control Module Air Conditioning Left Temperature Request";
BA_ "SysSignalName" SG_ 805 IFICMACRTemReq "FICMACRTemReq";
BA_ "CompuMethodName" SG_ 805 IAutoLaneChngVcCmd "AutoLaneChngVcCmd";
BA_ "ISignalName" SG_ 805 IAutoLaneChngVcCmd "IAutoLaneChngVcCmd";
BA_ "LongName" SG_ 805 IAutoLaneChngVcCmd "Auto Lane Change Voice Command";
BA_ "SysSignalName" SG_ 805 IAutoLaneChngVcCmd "AutoLaneChngVcCmd";
BA_ "CompuMethodName" SG_ 805 IFICMIFPACOnOffSwReq "FICMIFPACOnOffSwReq";
BA_ "ISignalName" SG_ 805 IFICMIFPACOnOffSwReq "IFICMIFPACOnOffSwReq";
BA_ "LongName" SG_ 805 IFICMIFPACOnOffSwReq "Front Infotainment Control Module Infotainment Faceplate Air Conditioning On Off Switch Request";
BA_ "SysSignalName" SG_ 805 IFICMIFPACOnOffSwReq "FICMIFPACOnOffSwReq";
BA_ "CompuMethodName" SG_ 805 INOAReportSetSwReq "NOAReportSetSwReq";
BA_ "ISignalName" SG_ 805 INOAReportSetSwReq "INOAReportSetSwReq";
BA_ "LongName" SG_ 805 INOAReportSetSwReq "NOA Report Set Switch Request";
BA_ "SysSignalName" SG_ 805 INOAReportSetSwReq "NOAReportSetSwReq";
BA_ "CompuMethodName" SG_ 805 INarRoVslAssSwReq "NarRoVslAssSwReq";
BA_ "ISignalName" SG_ 805 INarRoVslAssSwReq "INarRoVslAssSwReq";
BA_ "LongName" SG_ 805 INarRoVslAssSwReq "Narrow Road Visual Assist Switch Request";
BA_ "SysSignalName" SG_ 805 INarRoVslAssSwReq "NarRoVslAssSwReq";
BA_ "CompuMethodName" SG_ 805 IParkngSpdSwResp "ParkngSpdSwResp";
BA_ "ISignalName" SG_ 805 IParkngSpdSwResp "IParkngSpdSwResp";
BA_ "LongName" SG_ 805 IParkngSpdSwResp "Parking_Speed_Switch_Response";
BA_ "SysSignalName" SG_ 805 IParkngSpdSwResp "ParkngSpdSwResp";
BA_ "CompuMethodName" SG_ 805 INrwroadBwdAssSwReq "NrwroadBwdAssSwReq";
BA_ "ISignalName" SG_ 805 INrwroadBwdAssSwReq "INrwroadBwdAssSwReq";
BA_ "LongName" SG_ 805 INrwroadBwdAssSwReq "Narrow road Backward Assistance Switch Request";
BA_ "SysSignalName" SG_ 805 INrwroadBwdAssSwReq "NrwroadBwdAssSwReq";
BA_ "CompuMethodName" SG_ 805 IAutoLaneChngSwReq "AutoLaneChngSwReq";
BA_ "ISignalName" SG_ 805 IAutoLaneChngSwReq "IAutoLaneChngSwReq";
BA_ "LongName" SG_ 805 IAutoLaneChngSwReq "Auto_Lane_Change_Switch_Request";
BA_ "SysSignalName" SG_ 805 IAutoLaneChngSwReq "AutoLaneChngSwReq";
BA_ "CompuMethodName" SG_ 805 IESSAdoWrnngReq "ESSAdoWrnngReq";
BA_ "ISignalName" SG_ 805 IESSAdoWrnngReq "IESSAdoWrnngReq";
BA_ "LongName" SG_ 805 IESSAdoWrnngReq "Emergency_Steering_System__Audio_Warning_Request";
BA_ "SysSignalName" SG_ 805 IESSAdoWrnngReq "ESSAdoWrnngReq";
BA_ "CompuMethodName" SG_ 805 IAutoLaneChngSetReq "AutoLaneChngSetReq";
BA_ "ISignalName" SG_ 805 IAutoLaneChngSetReq "IAutoLaneChngSetReq";
BA_ "LongName" SG_ 805 IAutoLaneChngSetReq "Auto Lane Change Set Request";
BA_ "SysSignalName" SG_ 805 IAutoLaneChngSetReq "AutoLaneChngSetReq";
BA_ "CompuMethodName" SG_ 805 IAPAOneKeyParkSwReq "APAOneKeyParkSwReq";
BA_ "ISignalName" SG_ 805 IAPAOneKeyParkSwReq "IAPAOneKeyParkSwReq";
BA_ "LongName" SG_ 805 IAPAOneKeyParkSwReq "APA_One_Key_Parking_Switch_Request";
BA_ "SysSignalName" SG_ 805 IAPAOneKeyParkSwReq "APAOneKeyParkSwReq";
BA_ "CompuMethodName" SG_ 805 INarRoVslAssQuit "NarRoVslAssQuit";
BA_ "ISignalName" SG_ 805 INarRoVslAssQuit "INarRoVslAssQuit";
BA_ "LongName" SG_ 805 INarRoVslAssQuit "Narrow Road Visual Assis Quit";
BA_ "SysSignalName" SG_ 805 INarRoVslAssQuit "NarRoVslAssQuit";
BA_ "CompuMethodName" SG_ 805 ILCRSwReq "LCRSwReq";
BA_ "ISignalName" SG_ 805 ILCRSwReq "ILCRSwReq";
BA_ "LongName" SG_ 805 ILCRSwReq "Lane Change Recommendation Switch Request";
BA_ "SysSignalName" SG_ 805 ILCRSwReq "LCRSwReq";
BA_ "CompuMethodName" SG_ 805 IFrtCarGoNotfrSwReq "FrtCarGoNotfrSwReq";
BA_ "ISignalName" SG_ 805 IFrtCarGoNotfrSwReq "IFrtCarGoNotfrSwReq";
BA_ "LongName" SG_ 805 IFrtCarGoNotfrSwReq "FrontCar GoNotifierSwltchRequest";
BA_ "SysSignalName" SG_ 805 IFrtCarGoNotfrSwReq "FrtCarGoNotfrSwReq";
BA_ "CompuMethodName" SG_ 805 IESSswReq "ESSswReq";
BA_ "ISignalName" SG_ 805 IESSswReq "IESSswReq";
BA_ "LongName" SG_ 805 IESSswReq "Emergency_Steering_Switch_Request";
BA_ "SysSignalName" SG_ 805 IESSswReq "ESSswReq";
BA_ "CompuMethodName" SG_ 805 INOPSwReq "NOPSwReq";
BA_ "ISignalName" SG_ 805 INOPSwReq "INOPSwReq";
BA_ "LongName" SG_ 805 INOPSwReq "Hads Navigation On Pilot Switch Request";
BA_ "SysSignalName" SG_ 805 INOPSwReq "NOPSwReq";
BA_ "CompuMethodName" SG_ 805 INOPCitySwReq "NOPCitySwReq";
BA_ "ISignalName" SG_ 805 INOPCitySwReq "INOPCitySwReq";
BA_ "LongName" SG_ 805 INOPCitySwReq "Navigation On Pilot City Switch Request";
BA_ "SysSignalName" SG_ 805 INOPCitySwReq "NOPCitySwReq";
BA_ "CompuMethodName" SG_ 805 INOALaneSetSwReq "NOALaneSetSwReq";
BA_ "ISignalName" SG_ 805 INOALaneSetSwReq "INOALaneSetSwReq";
BA_ "LongName" SG_ 805 INOALaneSetSwReq "NOA Lane Set Switch Request";
BA_ "SysSignalName" SG_ 805 INOALaneSetSwReq "NOALaneSetSwReq";
BA_ "CompuMethodName" SG_ 805 INOAETCSetSwReq "NOAETCSetSwReq";
BA_ "ISignalName" SG_ 805 INOAETCSetSwReq "INOAETCSetSwReq";
BA_ "LongName" SG_ 805 INOAETCSetSwReq "NOA ETC Set Switch Request";
BA_ "SysSignalName" SG_ 805 INOAETCSetSwReq "NOAETCSetSwReq";
BA_ "CompuMethodName" SG_ 805 IWlcmLghtReq "WlcmLghtReq";
BA_ "ISignalName" SG_ 805 IWlcmLghtReq "IWlcmLghtReq";
BA_ "LongName" SG_ 805 IWlcmLghtReq "Welcome Light Request";
BA_ "SysSignalName" SG_ 805 IWlcmLghtReq "WlcmLghtReq";
BA_ "CompuMethodName" SG_ 805 ID2DSwReq "D2DSwReq";
BA_ "ISignalName" SG_ 805 ID2DSwReq "ID2DSwReq";
BA_ "LongName" SG_ 805 ID2DSwReq "D2D Swicth Request";
BA_ "SysSignalName" SG_ 805 ID2DSwReq "D2DSwReq";
BA_ "CompuMethodName" SG_ 805 IPEBSwReq "PEBSwReq";
BA_ "ISignalName" SG_ 805 IPEBSwReq "IPEBSwReq";
BA_ "LongName" SG_ 805 IPEBSwReq "Parking_Emergency_Brake_Switch_Request";
BA_ "SysSignalName" SG_ 805 IPEBSwReq "PEBSwReq";
BA_ "CompuMethodName" SG_ 805 IParkngDirSw "ParkngDirSw";
BA_ "ISignalName" SG_ 805 IParkngDirSw "IParkngDirSw";
BA_ "LongName" SG_ 805 IParkngDirSw "Parking_Direction_Switch";
BA_ "SysSignalName" SG_ 805 IParkngDirSw "ParkngDirSw";
BA_ "CompuMethodName" SG_ 805 INrwroadBwdAssConfrmSwReq "NrwroadBwdAssConfrmSwReq";
BA_ "ISignalName" SG_ 805 INrwroadBwdAssConfrmSwReq "INrwroadBwdAssConfrmSwReq";
BA_ "LongName" SG_ 805 INrwroadBwdAssConfrmSwReq "Narrow road Backward Assistance Conform Switch Request";
BA_ "SysSignalName" SG_ 805 INrwroadBwdAssConfrmSwReq "NrwroadBwdAssConfrmSwReq";
BA_ "CompuMethodName" SG_ 805 IDistToDsttnNavForSus "DistToDsttnNavForSus";
BA_ "GenSigStartValue" SG_ 805 IDistToDsttnNavForSus 255;
BA_ "ISignalName" SG_ 805 IDistToDsttnNavForSus "IDistToDsttnNavForSus";
BA_ "LongName" SG_ 805 IDistToDsttnNavForSus "Distance To Destination of Navigation For Suspension";
BA_ "SysSignalName" SG_ 805 IDistToDsttnNavForSus "DistToDsttnNavForSus";
BA_ "CompuMethodName" SG_ 805 IFrwlLghtReq "FrwlLghtReq";
BA_ "ISignalName" SG_ 805 IFrwlLghtReq "IFrwlLghtReq";
BA_ "LongName" SG_ 805 IFrwlLghtReq "Farewell Light Request";
BA_ "SysSignalName" SG_ 805 IFrwlLghtReq "FrwlLghtReq";
BA_ "CompuMethodName" SG_ 805 IFollowMeHomeReq "FollowMeHomeReq";
BA_ "ISignalName" SG_ 805 IFollowMeHomeReq "IFollowMeHomeReq";
BA_ "LongName" SG_ 805 IFollowMeHomeReq "Follow Me Home Request";
BA_ "SysSignalName" SG_ 805 IFollowMeHomeReq "FollowMeHomeReq";
BA_ "CompuMethodName" SG_ 805 IFVCMPowerFailSwReq "FVCMPowerFailSwReq";
BA_ "ISignalName" SG_ 805 IFVCMPowerFailSwReq "IFVCMPowerFailSwReq";
BA_ "LongName" SG_ 805 IFVCMPowerFailSwReq "FVCM_Power_Fail_Switch_Request";
BA_ "SysSignalName" SG_ 805 IFVCMPowerFailSwReq "FVCMPowerFailSwReq";
BA_ "CompuMethodName" SG_ 805 ID2DPriETClanSwReq "D2DPriETClanSwReq";
BA_ "ISignalName" SG_ 805 ID2DPriETClanSwReq "ID2DPriETClanSwReq";
BA_ "LongName" SG_ 805 ID2DPriETClanSwReq "D2D Priority ETC Lane Switch Request";
BA_ "SysSignalName" SG_ 805 ID2DPriETClanSwReq "D2DPriETClanSwReq";
BA_ "CompuMethodName" SG_ 805 ISLIFWrnngMdReq "SLIFWrnngMdReq";
BA_ "ISignalName" SG_ 805 ISLIFWrnngMdReq "ISLIFWrnngMdReq";
BA_ "LongName" SG_ 805 ISLIFWrnngMdReq "Speed Limit Information Function Warning Mode Request";
BA_ "SysSignalName" SG_ 805 ISLIFWrnngMdReq "SLIFWrnngMdReq";
BA_ "CompuMethodName" SG_ 805 IAIParkngEPAMdsw "AIParkngEPAMdsw";
BA_ "ISignalName" SG_ 805 IAIParkngEPAMdsw "IAIParkngEPAMdsw";
BA_ "LongName" SG_ 805 IAIParkngEPAMdsw "AIParking Exterior Parking Assist Model Switch";
BA_ "SysSignalName" SG_ 805 IAIParkngEPAMdsw "AIParkngEPAMdsw";
BA_ "CompuMethodName" SG_ 534 ISWSPB3SwStuckL "SWSPB3SwStuckL";
BA_ "ISignalName" SG_ 534 ISWSPB3SwStuckL "ISWSPB3SwStuckL";
BA_ "LongName" SG_ 534 ISWSPB3SwStuckL "Steering Wheel Switch Push Button 3 Switch Stuck
      Left";
BA_ "SysSignalName" SG_ 534 ISWSPB3SwStuckL "SWSPB3SwStuckL";
BA_ "CompuMethodName" SG_ 534 ISWSSelRSwStuckL "SWSSelRSwStuckL";
BA_ "ISignalName" SG_ 534 ISWSSelRSwStuckL "ISWSSelRSwStuckL";
BA_ "LongName" SG_ 534 ISWSSelRSwStuckL "Steering Wheel Switch Select Right Switch Stuck
      Left";
BA_ "SysSignalName" SG_ 534 ISWSSelRSwStuckL "SWSSelRSwStuckL";
BA_ "CompuMethodName" SG_ 534 ISWSSelLSwStuckL "SWSSelLSwStuckL";
BA_ "ISignalName" SG_ 534 ISWSSelLSwStuckL "ISWSSelLSwStuckL";
BA_ "LongName" SG_ 534 ISWSSelLSwStuckL "Steering Wheel Switch Select Left Switch Stuck
      Left";
BA_ "SysSignalName" SG_ 534 ISWSSelLSwStuckL "SWSSelLSwStuckL";
BA_ "CompuMethodName" SG_ 534 ISWSPB2SwStuckL "SWSPB2SwStuckL";
BA_ "ISignalName" SG_ 534 ISWSPB2SwStuckL "ISWSPB2SwStuckL";
BA_ "LongName" SG_ 534 ISWSPB2SwStuckL "Steering Wheel Switch Push Button 2 Switch Stuck
      Left";
BA_ "SysSignalName" SG_ 534 ISWSPB2SwStuckL "SWSPB2SwStuckL";
BA_ "CompuMethodName" SG_ 534 IRoadCrvt "RoadCrvt";
BA_ "GenSigStartValue" SG_ 534 IRoadCrvt 131072;
BA_ "ISignalName" SG_ 534 IRoadCrvt "IRoadCrvt";
BA_ "LongName" SG_ 534 IRoadCrvt "Road Curvature";
BA_ "SysSignalName" SG_ 534 IRoadCrvt "RoadCrvt";
BA_ "CompuMethodName" SG_ 534 IRoadSlope "RoadSlope";
BA_ "GenSigStartValue" SG_ 534 IRoadSlope 2048;
BA_ "ISignalName" SG_ 534 IRoadSlope "IRoadSlope";
BA_ "LongName" SG_ 534 IRoadSlope "Road Slope";
BA_ "SysSignalName" SG_ 534 IRoadSlope "RoadSlope";
BA_ "CompuMethodName" SG_ 534 ISWSCnfmSwStuckL "SWSCnfmSwStuckL";
BA_ "ISignalName" SG_ 534 ISWSCnfmSwStuckL "ISWSCnfmSwStuckL";
BA_ "LongName" SG_ 534 ISWSCnfmSwStuckL "Steering Wheel Switch Confirm Switch Stuck Left";
BA_ "SysSignalName" SG_ 534 ISWSCnfmSwStuckL "SWSCnfmSwStuckL";
BA_ "CompuMethodName" SG_ 534 IRoadCrvtDist "RoadCrvtDist";
BA_ "ISignalName" SG_ 534 IRoadCrvtDist "IRoadCrvtDist";
BA_ "LongName" SG_ 534 IRoadCrvtDist "Road Curvature Distance";
BA_ "SysSignalName" SG_ 534 IRoadCrvtDist "RoadCrvtDist";
BA_ "CompuMethodName" SG_ 534 IRoadSlopeDist "RoadSlopeDist";
BA_ "ISignalName" SG_ 534 IRoadSlopeDist "IRoadSlopeDist";
BA_ "LongName" SG_ 534 IRoadSlopeDist "Road Slope Distance";
BA_ "SysSignalName" SG_ 534 IRoadSlopeDist "RoadSlopeDist";
BA_ "CompuMethodName" SG_ 534 ISWSPB1SwStuckL "SWSPB1SwStuckL";
BA_ "ISignalName" SG_ 534 ISWSPB1SwStuckL "ISWSPB1SwStuckL";
BA_ "LongName" SG_ 534 ISWSPB1SwStuckL "Steering Wheel Switch Push Button 1 Switch Stuck Left";
BA_ "SysSignalName" SG_ 534 ISWSPB1SwStuckL "SWSPB1SwStuckL";
BA_ "CompuMethodName" SG_ 534 IDMSSts "DMSSts";
BA_ "ISignalName" SG_ 534 IDMSSts "IDMSSts";
BA_ "LongName" SG_ 534 IDMSSts "DMS_Status";
BA_ "SysSignalName" SG_ 534 IDMSSts "DMSSts";
BA_ "CompuMethodName" SG_ 534 IRoughRoaddetectionDist "RoughRoaddetectionDist";
BA_ "ISignalName" SG_ 534 IRoughRoaddetectionDist "IRoughRoaddetectionDist";
BA_ "LongName" SG_ 534 IRoughRoaddetectionDist "An_indication_that_a_rough Road_feature_has_been_detected_distence";
BA_ "SysSignalName" SG_ 534 IRoughRoaddetectionDist "RoughRoaddetectionDist";
BA_ "CompuMethodName" SG_ 534 ISWSSelLSwAL "SWSSelLSwAL";
BA_ "ISignalName" SG_ 534 ISWSSelLSwAL "ISWSSelLSwAL";
BA_ "LongName" SG_ 534 ISWSSelLSwAL "Steering Wheel Switch Select Left Switch Active
      Left";
BA_ "SysSignalName" SG_ 534 ISWSSelLSwAL "SWSSelLSwAL";
BA_ "CompuMethodName" SG_ 534 ISWSSelDwnSwAL "SWSSelDwnSwAL";
BA_ "ISignalName" SG_ 534 ISWSSelDwnSwAL "ISWSSelDwnSwAL";
BA_ "LongName" SG_ 534 ISWSSelDwnSwAL "Steering Wheel Switch Select Down Switch Active
      Left";
BA_ "SysSignalName" SG_ 534 ISWSSelDwnSwAL "SWSSelDwnSwAL";
BA_ "CompuMethodName" SG_ 534 ISWSSelUpSwAL "SWSSelUpSwAL";
BA_ "ISignalName" SG_ 534 ISWSSelUpSwAL "ISWSSelUpSwAL";
BA_ "LongName" SG_ 534 ISWSSelUpSwAL "Steering Wheel Switch Select
  Up
      Switch Active Left";
BA_ "SysSignalName" SG_ 534 ISWSSelUpSwAL "SWSSelUpSwAL";
BA_ "CompuMethodName" SG_ 534 ISWSPB2SwAL "SWSPB2SwAL";
BA_ "ISignalName" SG_ 534 ISWSPB2SwAL "ISWSPB2SwAL";
BA_ "LongName" SG_ 534 ISWSPB2SwAL "Steering Wheel Switch Push Button 2 Switch Active
      Left";
BA_ "SysSignalName" SG_ 534 ISWSPB2SwAL "SWSPB2SwAL";
BA_ "CompuMethodName" SG_ 534 ISWSPB1SwAL "SWSPB1SwAL";
BA_ "ISignalName" SG_ 534 ISWSPB1SwAL "ISWSPB1SwAL";
BA_ "LongName" SG_ 534 ISWSPB1SwAL "Steering Wheel Switch Push Button 1 Switch Active
      Left";
BA_ "SysSignalName" SG_ 534 ISWSPB1SwAL "SWSPB1SwAL";
BA_ "CompuMethodName" SG_ 534 ISWSCnfmSwAL "SWSCnfmSwAL";
BA_ "ISignalName" SG_ 534 ISWSCnfmSwAL "ISWSCnfmSwAL";
BA_ "LongName" SG_ 534 ISWSCnfmSwAL "Steering Wheel Switch Confirm Switch Active
      Left";
BA_ "SysSignalName" SG_ 534 ISWSCnfmSwAL "SWSCnfmSwAL";
BA_ "CompuMethodName" SG_ 534 ISWSSelRSwAL "SWSSelRSwAL";
BA_ "ISignalName" SG_ 534 ISWSSelRSwAL "ISWSSelRSwAL";
BA_ "LongName" SG_ 534 ISWSSelRSwAL "Steering Wheel Switch Select Right Switch Active
      Left";
BA_ "SysSignalName" SG_ 534 ISWSSelRSwAL "SWSSelRSwAL";
BA_ "CompuMethodName" SG_ 534 IRoughRoaddetection "RoughRoaddetection";
BA_ "ISignalName" SG_ 534 IRoughRoaddetection "IRoughRoaddetection";
BA_ "LongName" SG_ 534 IRoughRoaddetection "An_indication_that_a_rough Road_feature_has_been_detected";
BA_ "SysSignalName" SG_ 534 IRoughRoaddetection "RoughRoaddetection";
BA_ "CompuMethodName" SG_ 534 ISWSPB3SwAL "SWSPB3SwAL";
BA_ "ISignalName" SG_ 534 ISWSPB3SwAL "ISWSPB3SwAL";
BA_ "LongName" SG_ 534 ISWSPB3SwAL "Steering Wheel Switch Push Button 3 Switch Active
      Left";
BA_ "SysSignalName" SG_ 534 ISWSPB3SwAL "SWSPB3SwAL";
BA_ "CompuMethodName" SG_ 711 ISCFRemSwReq "SCFRemSwReq";
BA_ "ISignalName" SG_ 711 ISCFRemSwReq "ISCFRemSwReq";
BA_ "LongName" SG_ 711 ISCFRemSwReq "SCF reminder switch request";
BA_ "SysSignalName" SG_ 711 ISCFRemSwReq "SCFRemSwReq";
BA_ "CompuMethodName" SG_ 711 ISCFSwReq "SCFSwReq";
BA_ "ISignalName" SG_ 711 ISCFSwReq "ISCFSwReq";
BA_ "LongName" SG_ 711 ISCFSwReq "SCF switch request";
BA_ "SysSignalName" SG_ 711 ISCFSwReq "SCFSwReq";
BA_ "CompuMethodName" SG_ 711 IICMtoIPDScrnRespC "ICMtoIPDScrnRespC";
BA_ "ISignalName" SG_ 711 IICMtoIPDScrnRespC "IICMtoIPDScrnRespC";
BA_ "LongName" SG_ 711 IICMtoIPDScrnRespC "ICM response to IPD request ICM screen display_C Screen";
BA_ "SysSignalName" SG_ 711 IICMtoIPDScrnRespC "ICMtoIPDScrnRespC";
BA_ "CompuMethodName" SG_ 711 IMemParkngBtnRcnmCfm "MemParkngBtnRcnmCfm";
BA_ "ISignalName" SG_ 711 IMemParkngBtnRcnmCfm "IMemParkngBtnRcnmCfm";
BA_ "LongName" SG_ 711 IMemParkngBtnRcnmCfm "memory parking path button recommand confirming";
BA_ "SysSignalName" SG_ 711 IMemParkngBtnRcnmCfm "MemParkngBtnRcnmCfm";
BA_ "CompuMethodName" SG_ 711 ISLWFWarSwReq "SLWFWarSwReq";
BA_ "ISignalName" SG_ 711 ISLWFWarSwReq "ISLWFWarSwReq";
BA_ "LongName" SG_ 711 ISLWFWarSwReq "SLWF Warning switch request";
BA_ "SysSignalName" SG_ 711 ISLWFWarSwReq "SLWFWarSwReq";
BA_ "CompuMethodName" SG_ 711 ISLWFSwReq "SLWFSwReq";
BA_ "ISignalName" SG_ 711 ISLWFSwReq "ISLWFSwReq";
BA_ "LongName" SG_ 711 ISLWFSwReq "SLWF switch request";
BA_ "SysSignalName" SG_ 711 ISLWFSwReq "SLWFSwReq";
BA_ "CompuMethodName" SG_ 711 ISpdLmtCotNatReq "SpdLmtCotNatReq";
BA_ "ISignalName" SG_ 711 ISpdLmtCotNatReq "ISpdLmtCotNatReq";
BA_ "LongName" SG_ 711 ISpdLmtCotNatReq "Speed Limit Control Nation Request";
BA_ "SysSignalName" SG_ 711 ISpdLmtCotNatReq "SpdLmtCotNatReq";
BA_ "CompuMethodName" SG_ 711 IICMtoIPDScrnRespA1 "ICMtoIPDScrnRespA1";
BA_ "ISignalName" SG_ 711 IICMtoIPDScrnRespA1 "IICMtoIPDScrnRespA1";
BA_ "LongName" SG_ 711 IICMtoIPDScrnRespA1 "ICM response to IPD request ICM screen display_A1 Screen";
BA_ "SysSignalName" SG_ 711 IICMtoIPDScrnRespA1 "ICMtoIPDScrnRespA1";
BA_ "CompuMethodName" SG_ 711 IOrderLaneChgeReq "OrderLaneChgeReq";
BA_ "ISignalName" SG_ 711 IOrderLaneChgeReq "IOrderLaneChgeReq";
BA_ "LongName" SG_ 711 IOrderLaneChgeReq "Order Lane Change Request";
BA_ "SysSignalName" SG_ 711 IOrderLaneChgeReq "OrderLaneChgeReq";
BA_ "CompuMethodName" SG_ 711 ISpdLmtCotMdlReq "SpdLmtCotMdlReq";
BA_ "ISignalName" SG_ 711 ISpdLmtCotMdlReq "ISpdLmtCotMdlReq";
BA_ "LongName" SG_ 711 ISpdLmtCotMdlReq "Speed Limit Control Mode Request";
BA_ "SysSignalName" SG_ 711 ISpdLmtCotMdlReq "SpdLmtCotMdlReq";
BA_ "CompuMethodName" SG_ 711 IAIParkingSoundResp "AIParkingSoundResp";
BA_ "ISignalName" SG_ 711 IAIParkingSoundResp "IAIParkingSoundResp";
BA_ "LongName" SG_ 711 IAIParkingSoundResp "ICM response to IPD request ICM speak to user for reminder";
BA_ "SysSignalName" SG_ 711 IAIParkingSoundResp "AIParkingSoundResp";
BA_ "CompuMethodName" SG_ 711 IACCSLIFMsgReq "ACCSLIFMsgReq";
BA_ "ISignalName" SG_ 711 IACCSLIFMsgReq "IACCSLIFMsgReq";
BA_ "LongName" SG_ 711 IACCSLIFMsgReq "ACC Speed Limit Control Massage Request";
BA_ "SysSignalName" SG_ 711 IACCSLIFMsgReq "ACCSLIFMsgReq";
BA_ "CompuMethodName" SG_ 711 IAESSwReq "AESSwReq";
BA_ "ISignalName" SG_ 711 IAESSwReq "IAESSwReq";
BA_ "LongName" SG_ 711 IAESSwReq "AES switch request";
BA_ "SysSignalName" SG_ 711 IAESSwReq "AESSwReq";
BA_ "CompuMethodName" SG_ 711 IRCWPedWrnngSwReq "RCWPedWrnngSwReq";
BA_ "ISignalName" SG_ 711 IRCWPedWrnngSwReq "IRCWPedWrnngSwReq";
BA_ "LongName" SG_ 711 IRCWPedWrnngSwReq "RCW Pedestrian Latent warning Switch request";
BA_ "SysSignalName" SG_ 711 IRCWPedWrnngSwReq "RCWPedWrnngSwReq";
BA_ "CompuMethodName" SG_ 711 ISpedRegulaModSwReq "SpedRegulaModSwReq";
BA_ "ISignalName" SG_ 711 ISpedRegulaModSwReq "ISpedRegulaModSwReq";
BA_ "LongName" SG_ 711 ISpedRegulaModSwReq "Speed Regulation Mode Switch request";
BA_ "SysSignalName" SG_ 711 ISpedRegulaModSwReq "SpedRegulaModSwReq";
BA_ "CompuMethodName" SG_ 711 ISpedRegulaPerReq "SpedRegulaPerReq";
BA_ "ISignalName" SG_ 711 ISpedRegulaPerReq "ISpedRegulaPerReq";
BA_ "LongName" SG_ 711 ISpedRegulaPerReq "Speed Regulation Mode Per request";
BA_ "SysSignalName" SG_ 711 ISpedRegulaPerReq "SpedRegulaPerReq";
BA_ "CompuMethodName" SG_ 711 ISpedRegulaFixeReq "SpedRegulaFixeReq";
BA_ "ISignalName" SG_ 711 ISpedRegulaFixeReq "ISpedRegulaFixeReq";
BA_ "LongName" SG_ 711 ISpedRegulaFixeReq "Speed Regulation Mode Fixed request";
BA_ "SysSignalName" SG_ 711 ISpedRegulaFixeReq "SpedRegulaFixeReq";
BA_ "CompuMethodName" SG_ 711 IIPDtoICMScrnRespA2 "IPDtoICMScrnRespA2";
BA_ "ISignalName" SG_ 711 IIPDtoICMScrnRespA2 "IIPDtoICMScrnRespA2";
BA_ "LongName" SG_ 711 IIPDtoICMScrnRespA2 "ICM response to IPD request ICM screen display_A2 Screen";
BA_ "SysSignalName" SG_ 711 IIPDtoICMScrnRespA2 "IPDtoICMScrnRespA2";
BA_ "CompuMethodName" SG_ 711 IRCWRearCollisionWrnngSwReq "RCWRearCollisionWrnngSwReq";
BA_ "ISignalName" SG_ 711 IRCWRearCollisionWrnngSwReq "IRCWRearCollisionWrnngSwReq";
BA_ "LongName" SG_ 711 IRCWRearCollisionWrnngSwReq "RCW Pedestrian Latent warning Switch request";
BA_ "SysSignalName" SG_ 711 IRCWRearCollisionWrnngSwReq "RCWRearCollisionWrnngSwReq";
BA_ "CompuMethodName" SG_ 711 IMemParkingReserveICM1 "MemParkingReserveICM1";
BA_ "ISignalName" SG_ 711 IMemParkingReserveICM1 "IMemParkingReserveICM1";
BA_ "LongName" SG_ 711 IMemParkingReserveICM1 "memory parking reserved ICM 01";
BA_ "SysSignalName" SG_ 711 IMemParkingReserveICM1 "MemParkingReserveICM1";
BA_ "CompuMethodName" SG_ 711 INOAE2ESwReq "NOAE2ESwReq";
BA_ "ISignalName" SG_ 711 INOAE2ESwReq "INOAE2ESwReq";
BA_ "LongName" SG_ 711 INOAE2ESwReq "Navigate ON Autopilot E2E Switch request";
BA_ "SysSignalName" SG_ 711 INOAE2ESwReq "NOAE2ESwReq";
BA_ "CompuMethodName" SG_ 711 IIPDCoDrivingPlusSwReq "IPDCoDrivingPlusSwReq";
BA_ "ISignalName" SG_ 711 IIPDCoDrivingPlusSwReq "IIPDCoDrivingPlusSwReq";
BA_ "LongName" SG_ 711 IIPDCoDrivingPlusSwReq "IPD cooperation driving Plus Switch request";
BA_ "SysSignalName" SG_ 711 IIPDCoDrivingPlusSwReq "IPDCoDrivingPlusSwReq";
BA_ "CompuMethodName" SG_ 711 IMemParkingReserveICM2 "MemParkingReserveICM2";
BA_ "ISignalName" SG_ 711 IMemParkingReserveICM2 "IMemParkingReserveICM2";
BA_ "LongName" SG_ 711 IMemParkingReserveICM2 "memory parking reserved ICM 02";
BA_ "SysSignalName" SG_ 711 IMemParkingReserveICM2 "MemParkingReserveICM2";
BA_ "CompuMethodName" SG_ 711 IMemoryDrvSwReq "MemoryDrvSwReq";
BA_ "ISignalName" SG_ 711 IMemoryDrvSwReq "IMemoryDrvSwReq";
BA_ "LongName" SG_ 711 IMemoryDrvSwReq "Memory drive Switch request";
BA_ "SysSignalName" SG_ 711 IMemoryDrvSwReq "MemoryDrvSwReq";
BA_ "CompuMethodName" SG_ 711 IPilotE2ESwReq "PilotE2ESwReq";
BA_ "ISignalName" SG_ 711 IPilotE2ESwReq "IPilotE2ESwReq";
BA_ "LongName" SG_ 711 IPilotE2ESwReq "Autopilot E2E Switch request";
BA_ "SysSignalName" SG_ 711 IPilotE2ESwReq "PilotE2ESwReq";
BA_ "CompuMethodName" SG_ 711 IMemParkingReserveICM3 "MemParkingReserveICM3";
BA_ "ISignalName" SG_ 711 IMemParkingReserveICM3 "IMemParkingReserveICM3";
BA_ "LongName" SG_ 711 IMemParkingReserveICM3 "memory parking reserved ICM 03";
BA_ "SysSignalName" SG_ 711 IMemParkingReserveICM3 "MemParkingReserveICM3";
BA_ "CompuMethodName" SG_ 711 IMemoryRouteSaveCancelReq "MemoryRouteSaveCancelReq";
BA_ "ISignalName" SG_ 711 IMemoryRouteSaveCancelReq "IMemoryRouteSaveCancelReq";
BA_ "LongName" SG_ 711 IMemoryRouteSaveCancelReq "Memory Route Save Cancel Request";
BA_ "SysSignalName" SG_ 711 IMemoryRouteSaveCancelReq "MemoryRouteSaveCancelReq";
BA_ "CompuMethodName" SG_ 711 IMemoryDrvSetSwReq "MemoryDrvSetSwReq";
BA_ "ISignalName" SG_ 711 IMemoryDrvSetSwReq "IMemoryDrvSetSwReq";
BA_ "LongName" SG_ 711 IMemoryDrvSetSwReq "Memory drive Set Switch request";
BA_ "SysSignalName" SG_ 711 IMemoryDrvSetSwReq "MemoryDrvSetSwReq";
BA_ "CompuMethodName" SG_ 711 INOAE2ESetSeReq "NOAE2ESetSeReq";
BA_ "ISignalName" SG_ 711 INOAE2ESetSeReq "INOAE2ESetSeReq";
BA_ "LongName" SG_ 711 INOAE2ESetSeReq "Memory drive Set Switch Second request";
BA_ "SysSignalName" SG_ 711 INOAE2ESetSeReq "NOAE2ESetSeReq";
BA_ "CompuMethodName" SG_ 711 INOAE2ESetReq "NOAE2ESetReq";
BA_ "ISignalName" SG_ 711 INOAE2ESetReq "INOAE2ESetReq";
BA_ "LongName" SG_ 711 INOAE2ESetReq "Navigate ON Autopilot End to End Set Request";
BA_ "SysSignalName" SG_ 711 INOAE2ESetReq "NOAE2ESetReq";
BA_ "CompuMethodName" SG_ 711 IPilotE2ESetSeReq "PilotE2ESetSeReq";
BA_ "ISignalName" SG_ 711 IPilotE2ESetSeReq "IPilotE2ESetSeReq";
BA_ "LongName" SG_ 711 IPilotE2ESetSeReq "Pilot End to End Set Second Request";
BA_ "SysSignalName" SG_ 711 IPilotE2ESetSeReq "PilotE2ESetSeReq";
BA_ "CompuMethodName" SG_ 711 IPilotE2ESetReq "PilotE2ESetReq";
BA_ "ISignalName" SG_ 711 IPilotE2ESetReq "IPilotE2ESetReq";
BA_ "LongName" SG_ 711 IPilotE2ESetReq "Pilot End to End Set Request";
BA_ "SysSignalName" SG_ 711 IPilotE2ESetReq "PilotE2ESetReq";
BA_ "CompuMethodName" SG_ 711 IMemParkingReserveICM6 "MemParkingReserveICM6";
BA_ "ISignalName" SG_ 711 IMemParkingReserveICM6 "IMemParkingReserveICM6";
BA_ "LongName" SG_ 711 IMemParkingReserveICM6 "memory parking reserved ICM 06";
BA_ "SysSignalName" SG_ 711 IMemParkingReserveICM6 "MemParkingReserveICM6";
BA_ "CompuMethodName" SG_ 711 IMemParkingReserveICM5 "MemParkingReserveICM5";
BA_ "ISignalName" SG_ 711 IMemParkingReserveICM5 "IMemParkingReserveICM5";
BA_ "LongName" SG_ 711 IMemParkingReserveICM5 "memory parking reserved ICM 05";
BA_ "SysSignalName" SG_ 711 IMemParkingReserveICM5 "MemParkingReserveICM5";
BA_ "CompuMethodName" SG_ 711 IMemParkingReserveICM4 "MemParkingReserveICM4";
BA_ "ISignalName" SG_ 711 IMemParkingReserveICM4 "IMemParkingReserveICM4";
BA_ "LongName" SG_ 711 IMemParkingReserveICM4 "memory parking reserved ICM 04";
BA_ "SysSignalName" SG_ 711 IMemParkingReserveICM4 "MemParkingReserveICM4";
BA_ "CompuMethodName" SG_ 707 IICMSwReq_Reserve11 "ICMSwReq_Reserve11";
BA_ "ISignalName" SG_ 707 IICMSwReq_Reserve11 "IICMSwReq_Reserve11";
BA_ "LongName" SG_ 707 IICMSwReq_Reserve11 "ICM_Switch_Request_Reserved11";
BA_ "SysSignalName" SG_ 707 IICMSwReq_Reserve11 "ICMSwReq_Reserve11";
BA_ "CompuMethodName" SG_ 707 IICMSwReq_Reserve02 "ICMSwReq_Reserve02";
BA_ "ISignalName" SG_ 707 IICMSwReq_Reserve02 "IICMSwReq_Reserve02";
BA_ "LongName" SG_ 707 IICMSwReq_Reserve02 "ICM_Switch_Request_Reserved02";
BA_ "SysSignalName" SG_ 707 IICMSwReq_Reserve02 "ICMSwReq_Reserve02";
BA_ "CompuMethodName" SG_ 707 IICMSwReq_Reserve01 "ICMSwReq_Reserve01";
BA_ "ISignalName" SG_ 707 IICMSwReq_Reserve01 "IICMSwReq_Reserve01";
BA_ "LongName" SG_ 707 IICMSwReq_Reserve01 "ICM_Switch_Request_Reserved01";
BA_ "SysSignalName" SG_ 707 IICMSwReq_Reserve01 "ICMSwReq_Reserve01";
BA_ "CompuMethodName" SG_ 707 IICMSwReq_Reserve12 "ICMSwReq_Reserve12";
BA_ "ISignalName" SG_ 707 IICMSwReq_Reserve12 "IICMSwReq_Reserve12";
BA_ "LongName" SG_ 707 IICMSwReq_Reserve12 "ICM_Switch_Request_Reserved12";
BA_ "SysSignalName" SG_ 707 IICMSwReq_Reserve12 "ICMSwReq_Reserve12";
BA_ "CompuMethodName" SG_ 707 IICMSwReq_Reserve04 "ICMSwReq_Reserve04";
BA_ "ISignalName" SG_ 707 IICMSwReq_Reserve04 "IICMSwReq_Reserve04";
BA_ "LongName" SG_ 707 IICMSwReq_Reserve04 "ICM_Switch_Request_Reserved04";
BA_ "SysSignalName" SG_ 707 IICMSwReq_Reserve04 "ICMSwReq_Reserve04";
BA_ "CompuMethodName" SG_ 707 IICMSwReq_Reserve03 "ICMSwReq_Reserve03";
BA_ "ISignalName" SG_ 707 IICMSwReq_Reserve03 "IICMSwReq_Reserve03";
BA_ "LongName" SG_ 707 IICMSwReq_Reserve03 "ICM_Switch_Request_Reserved03";
BA_ "SysSignalName" SG_ 707 IICMSwReq_Reserve03 "ICMSwReq_Reserve03";
BA_ "CompuMethodName" SG_ 707 IICMSwReq_Reserve13 "ICMSwReq_Reserve13";
BA_ "ISignalName" SG_ 707 IICMSwReq_Reserve13 "IICMSwReq_Reserve13";
BA_ "LongName" SG_ 707 IICMSwReq_Reserve13 "ICM_Switch_Request_Reserved13";
BA_ "SysSignalName" SG_ 707 IICMSwReq_Reserve13 "ICMSwReq_Reserve13";
BA_ "CompuMethodName" SG_ 707 IICMSwReq_Reserve06 "ICMSwReq_Reserve06";
BA_ "ISignalName" SG_ 707 IICMSwReq_Reserve06 "IICMSwReq_Reserve06";
BA_ "LongName" SG_ 707 IICMSwReq_Reserve06 "ICM_Switch_Request_Reserved06";
BA_ "SysSignalName" SG_ 707 IICMSwReq_Reserve06 "ICMSwReq_Reserve06";
BA_ "CompuMethodName" SG_ 707 IICMSwReq_Reserve05 "ICMSwReq_Reserve05";
BA_ "ISignalName" SG_ 707 IICMSwReq_Reserve05 "IICMSwReq_Reserve05";
BA_ "LongName" SG_ 707 IICMSwReq_Reserve05 "ICM_Switch_Request_Reserved05";
BA_ "SysSignalName" SG_ 707 IICMSwReq_Reserve05 "ICMSwReq_Reserve05";
BA_ "CompuMethodName" SG_ 707 IICMSwReq_Reserve14 "ICMSwReq_Reserve14";
BA_ "ISignalName" SG_ 707 IICMSwReq_Reserve14 "IICMSwReq_Reserve14";
BA_ "LongName" SG_ 707 IICMSwReq_Reserve14 "ICM_Switch_Request_Reserved14";
BA_ "SysSignalName" SG_ 707 IICMSwReq_Reserve14 "ICMSwReq_Reserve14";
BA_ "CompuMethodName" SG_ 707 IICMSwReq_Reserve08 "ICMSwReq_Reserve08";
BA_ "ISignalName" SG_ 707 IICMSwReq_Reserve08 "IICMSwReq_Reserve08";
BA_ "LongName" SG_ 707 IICMSwReq_Reserve08 "ICM_Switch_Request_Reserved08";
BA_ "SysSignalName" SG_ 707 IICMSwReq_Reserve08 "ICMSwReq_Reserve08";
BA_ "CompuMethodName" SG_ 707 IICMSwReq_Reserve07 "ICMSwReq_Reserve07";
BA_ "ISignalName" SG_ 707 IICMSwReq_Reserve07 "IICMSwReq_Reserve07";
BA_ "LongName" SG_ 707 IICMSwReq_Reserve07 "ICM_Switch_Request_Reserved07";
BA_ "SysSignalName" SG_ 707 IICMSwReq_Reserve07 "ICMSwReq_Reserve07";
BA_ "CompuMethodName" SG_ 707 IICMSwReq_Reserve15 "ICMSwReq_Reserve15";
BA_ "ISignalName" SG_ 707 IICMSwReq_Reserve15 "IICMSwReq_Reserve15";
BA_ "LongName" SG_ 707 IICMSwReq_Reserve15 "ICM_Switch_Request_Reserved15";
BA_ "SysSignalName" SG_ 707 IICMSwReq_Reserve15 "ICMSwReq_Reserve15";
BA_ "CompuMethodName" SG_ 707 IICMSwReq_Reserve10 "ICMSwReq_Reserve10";
BA_ "ISignalName" SG_ 707 IICMSwReq_Reserve10 "IICMSwReq_Reserve10";
BA_ "LongName" SG_ 707 IICMSwReq_Reserve10 "ICM_Switch_Request_Reserved10";
BA_ "SysSignalName" SG_ 707 IICMSwReq_Reserve10 "ICMSwReq_Reserve10";
BA_ "CompuMethodName" SG_ 707 IICMSwReq_Reserve09 "ICMSwReq_Reserve09";
BA_ "ISignalName" SG_ 707 IICMSwReq_Reserve09 "IICMSwReq_Reserve09";
BA_ "LongName" SG_ 707 IICMSwReq_Reserve09 "ICM_Switch_Request_Reserved09";
BA_ "SysSignalName" SG_ 707 IICMSwReq_Reserve09 "ICMSwReq_Reserve09";
BA_ "CompuMethodName" SG_ 707 IICMSwReq_Reserve19 "ICMSwReq_Reserve19";
BA_ "ISignalName" SG_ 707 IICMSwReq_Reserve19 "IICMSwReq_Reserve19";
BA_ "LongName" SG_ 707 IICMSwReq_Reserve19 "ICM_Switch_Request_Reserved19";
BA_ "SysSignalName" SG_ 707 IICMSwReq_Reserve19 "ICMSwReq_Reserve19";
BA_ "CompuMethodName" SG_ 707 IICMSwReq_Reserve18 "ICMSwReq_Reserve18";
BA_ "ISignalName" SG_ 707 IICMSwReq_Reserve18 "IICMSwReq_Reserve18";
BA_ "LongName" SG_ 707 IICMSwReq_Reserve18 "ICM_Switch_Request_Reserved18";
BA_ "SysSignalName" SG_ 707 IICMSwReq_Reserve18 "ICMSwReq_Reserve18";
BA_ "CompuMethodName" SG_ 707 IICMSwReq_Reserve17 "ICMSwReq_Reserve17";
BA_ "ISignalName" SG_ 707 IICMSwReq_Reserve17 "IICMSwReq_Reserve17";
BA_ "LongName" SG_ 707 IICMSwReq_Reserve17 "ICM_Switch_Request_Reserved17";
BA_ "SysSignalName" SG_ 707 IICMSwReq_Reserve17 "ICMSwReq_Reserve17";
BA_ "CompuMethodName" SG_ 707 IICMSwReq_Reserve16 "ICMSwReq_Reserve16";
BA_ "ISignalName" SG_ 707 IICMSwReq_Reserve16 "IICMSwReq_Reserve16";
BA_ "LongName" SG_ 707 IICMSwReq_Reserve16 "ICM_Switch_Request_Reserved16";
BA_ "SysSignalName" SG_ 707 IICMSwReq_Reserve16 "ICMSwReq_Reserve16";
BA_ "CompuMethodName" SG_ 707 IICMSwReq_Reserve20 "ICMSwReq_Reserve20";
BA_ "ISignalName" SG_ 707 IICMSwReq_Reserve20 "IICMSwReq_Reserve20";
BA_ "LongName" SG_ 707 IICMSwReq_Reserve20 "ICM_Switch_Request_Reserved20";
BA_ "SysSignalName" SG_ 707 IICMSwReq_Reserve20 "ICMSwReq_Reserve20";
BA_ "CompuMethodName" SG_ 707 IICMwarnType1_Rsrv01 "ICMwarnType1_Rsrv01";
BA_ "ISignalName" SG_ 707 IICMwarnType1_Rsrv01 "IICMwarnType1_Rsrv01";
BA_ "LongName" SG_ 707 IICMwarnType1_Rsrv01 "ICM_warn_Type1_Reserved01";
BA_ "SysSignalName" SG_ 707 IICMwarnType1_Rsrv01 "ICMwarnType1_Rsrv01";
BA_ "CompuMethodName" SG_ 707 IICMwarnType2_Rsrv02 "ICMwarnType2_Rsrv02";
BA_ "ISignalName" SG_ 707 IICMwarnType2_Rsrv02 "IICMwarnType2_Rsrv02";
BA_ "LongName" SG_ 707 IICMwarnType2_Rsrv02 "ICM_warn_Type2_Reserved02";
BA_ "SysSignalName" SG_ 707 IICMwarnType2_Rsrv02 "ICMwarnType2_Rsrv02";
BA_ "CompuMethodName" SG_ 707 IICMwarnType2_Rsrv01 "ICMwarnType2_Rsrv01";
BA_ "ISignalName" SG_ 707 IICMwarnType2_Rsrv01 "IICMwarnType2_Rsrv01";
BA_ "LongName" SG_ 707 IICMwarnType2_Rsrv01 "ICM_warn_Type2_Reserved01";
BA_ "SysSignalName" SG_ 707 IICMwarnType2_Rsrv01 "ICMwarnType2_Rsrv01";
BA_ "CompuMethodName" SG_ 707 IICMwarnType1_Rsrv02 "ICMwarnType1_Rsrv02";
BA_ "ISignalName" SG_ 707 IICMwarnType1_Rsrv02 "IICMwarnType1_Rsrv02";
BA_ "LongName" SG_ 707 IICMwarnType1_Rsrv02 "ICM_warn_Type1_Reserved02";
BA_ "SysSignalName" SG_ 707 IICMwarnType1_Rsrv02 "ICMwarnType1_Rsrv02";
BA_ "CompuMethodName" SG_ 707 IICMwarnType2_Rsrv04 "ICMwarnType2_Rsrv04";
BA_ "ISignalName" SG_ 707 IICMwarnType2_Rsrv04 "IICMwarnType2_Rsrv04";
BA_ "LongName" SG_ 707 IICMwarnType2_Rsrv04 "ICM_warn_Type2_Reserved04";
BA_ "SysSignalName" SG_ 707 IICMwarnType2_Rsrv04 "ICMwarnType2_Rsrv04";
BA_ "CompuMethodName" SG_ 707 IICMwarnType2_Rsrv03 "ICMwarnType2_Rsrv03";
BA_ "ISignalName" SG_ 707 IICMwarnType2_Rsrv03 "IICMwarnType2_Rsrv03";
BA_ "LongName" SG_ 707 IICMwarnType2_Rsrv03 "ICM_warn_Type2_Reserved03";
BA_ "SysSignalName" SG_ 707 IICMwarnType2_Rsrv03 "ICMwarnType2_Rsrv03";
BA_ "CompuMethodName" SG_ 707 IICMwarnType3_Rsrv02 "ICMwarnType3_Rsrv02";
BA_ "ISignalName" SG_ 707 IICMwarnType3_Rsrv02 "IICMwarnType3_Rsrv02";
BA_ "LongName" SG_ 707 IICMwarnType3_Rsrv02 "ICM_warn_Type3_Reserved02";
BA_ "SysSignalName" SG_ 707 IICMwarnType3_Rsrv02 "ICMwarnType3_Rsrv02";
BA_ "CompuMethodName" SG_ 707 IICMwarnType3_Rsrv01 "ICMwarnType3_Rsrv01";
BA_ "ISignalName" SG_ 707 IICMwarnType3_Rsrv01 "IICMwarnType3_Rsrv01";
BA_ "LongName" SG_ 707 IICMwarnType3_Rsrv01 "ICM_warn_Type3_Reserved01";
BA_ "SysSignalName" SG_ 707 IICMwarnType3_Rsrv01 "ICMwarnType3_Rsrv01";
BA_ "CompuMethodName" SG_ 707 IICMwarnType3_Rsrv04 "ICMwarnType3_Rsrv04";
BA_ "ISignalName" SG_ 707 IICMwarnType3_Rsrv04 "IICMwarnType3_Rsrv04";
BA_ "LongName" SG_ 707 IICMwarnType3_Rsrv04 "ICM_warn_Type3_Reserved04";
BA_ "SysSignalName" SG_ 707 IICMwarnType3_Rsrv04 "ICMwarnType3_Rsrv04";
BA_ "CompuMethodName" SG_ 707 IICMwarnType3_Rsrv03 "ICMwarnType3_Rsrv03";
BA_ "ISignalName" SG_ 707 IICMwarnType3_Rsrv03 "IICMwarnType3_Rsrv03";
BA_ "LongName" SG_ 707 IICMwarnType3_Rsrv03 "ICM_warn_Type3_Reserved03";
BA_ "SysSignalName" SG_ 707 IICMwarnType3_Rsrv03 "ICMwarnType3_Rsrv03";
BA_ "CompuMethodName" SG_ 707 IICMwarnType2_Rsrv05 "ICMwarnType2_Rsrv05";
BA_ "ISignalName" SG_ 707 IICMwarnType2_Rsrv05 "IICMwarnType2_Rsrv05";
BA_ "LongName" SG_ 707 IICMwarnType2_Rsrv05 "ICM_warn_Type2_Reserved05";
BA_ "SysSignalName" SG_ 707 IICMwarnType2_Rsrv05 "ICMwarnType2_Rsrv05";
BA_ "CompuMethodName" SG_ 707 IICMwarnType3_Rsrv05 "ICMwarnType3_Rsrv05";
BA_ "ISignalName" SG_ 707 IICMwarnType3_Rsrv05 "IICMwarnType3_Rsrv05";
BA_ "LongName" SG_ 707 IICMwarnType3_Rsrv05 "ICM_warn_Type3_Reserved05";
BA_ "SysSignalName" SG_ 707 IICMwarnType3_Rsrv05 "ICMwarnType3_Rsrv05";
BA_ "CompuMethodName" SG_ 707 IICMwarnType1_Rsrv03 "ICMwarnType1_Rsrv03";
BA_ "ISignalName" SG_ 707 IICMwarnType1_Rsrv03 "IICMwarnType1_Rsrv03";
BA_ "LongName" SG_ 707 IICMwarnType1_Rsrv03 "ICM_warn_Type1_Reserved03";
BA_ "SysSignalName" SG_ 707 IICMwarnType1_Rsrv03 "ICMwarnType1_Rsrv03";
BA_ "CompuMethodName" SG_ 707 IICMwarnType4_Rsrv01 "ICMwarnType4_Rsrv01";
BA_ "ISignalName" SG_ 707 IICMwarnType4_Rsrv01 "IICMwarnType4_Rsrv01";
BA_ "LongName" SG_ 707 IICMwarnType4_Rsrv01 "ICM_warn_Type4_Reserved01";
BA_ "SysSignalName" SG_ 707 IICMwarnType4_Rsrv01 "ICMwarnType4_Rsrv01";
BA_ "CompuMethodName" SG_ 707 IICMwarnType1_Rsrv04 "ICMwarnType1_Rsrv04";
BA_ "ISignalName" SG_ 707 IICMwarnType1_Rsrv04 "IICMwarnType1_Rsrv04";
BA_ "LongName" SG_ 707 IICMwarnType1_Rsrv04 "ICM_warn_Type1_Reserved04";
BA_ "SysSignalName" SG_ 707 IICMwarnType1_Rsrv04 "ICMwarnType1_Rsrv04";
BA_ "CompuMethodName" SG_ 707 IICMwarnType4_Rsrv02 "ICMwarnType4_Rsrv02";
BA_ "ISignalName" SG_ 707 IICMwarnType4_Rsrv02 "IICMwarnType4_Rsrv02";
BA_ "LongName" SG_ 707 IICMwarnType4_Rsrv02 "ICM_warn_Type4_Reserved02";
BA_ "SysSignalName" SG_ 707 IICMwarnType4_Rsrv02 "ICMwarnType4_Rsrv02";
BA_ "CompuMethodName" SG_ 707 IICMwarnType1_Rsrv05 "ICMwarnType1_Rsrv05";
BA_ "ISignalName" SG_ 707 IICMwarnType1_Rsrv05 "IICMwarnType1_Rsrv05";
BA_ "LongName" SG_ 707 IICMwarnType1_Rsrv05 "ICM_warn_Type1_Reserved05";
BA_ "SysSignalName" SG_ 707 IICMwarnType1_Rsrv05 "ICMwarnType1_Rsrv05";
BA_ "CompuMethodName" SG_ 707 IICMwarnType4_Rsrv03 "ICMwarnType4_Rsrv03";
BA_ "ISignalName" SG_ 707 IICMwarnType4_Rsrv03 "IICMwarnType4_Rsrv03";
BA_ "LongName" SG_ 707 IICMwarnType4_Rsrv03 "ICM_warn_Type4_Reserved03";
BA_ "SysSignalName" SG_ 707 IICMwarnType4_Rsrv03 "ICMwarnType4_Rsrv03";
BA_ "CompuMethodName" SG_ 707 IICMwarnType4_Rsrv04 "ICMwarnType4_Rsrv04";
BA_ "ISignalName" SG_ 707 IICMwarnType4_Rsrv04 "IICMwarnType4_Rsrv04";
BA_ "LongName" SG_ 707 IICMwarnType4_Rsrv04 "ICM_warn_Type4_Reserved04";
BA_ "SysSignalName" SG_ 707 IICMwarnType4_Rsrv04 "ICMwarnType4_Rsrv04";
BA_ "CompuMethodName" SG_ 707 IICMwarnType4_Rsrv05 "ICMwarnType4_Rsrv05";
BA_ "ISignalName" SG_ 707 IICMwarnType4_Rsrv05 "IICMwarnType4_Rsrv05";
BA_ "LongName" SG_ 707 IICMwarnType4_Rsrv05 "ICM_warn_Type4_Reserved05";
BA_ "SysSignalName" SG_ 707 IICMwarnType4_Rsrv05 "ICMwarnType4_Rsrv05";
BA_ "CompuMethodName" SG_ 707 IICMvalue_Rsrv10 "ICMvalue_Rsrv10";
BA_ "ISignalName" SG_ 707 IICMvalue_Rsrv10 "IICMvalue_Rsrv10";
BA_ "LongName" SG_ 707 IICMvalue_Rsrv10 "ICM_value_Reserved10";
BA_ "SysSignalName" SG_ 707 IICMvalue_Rsrv10 "ICMvalue_Rsrv10";
BA_ "CompuMethodName" SG_ 707 IICMvalue_Rsrv09 "ICMvalue_Rsrv09";
BA_ "ISignalName" SG_ 707 IICMvalue_Rsrv09 "IICMvalue_Rsrv09";
BA_ "LongName" SG_ 707 IICMvalue_Rsrv09 "ICM_value_Reserved09";
BA_ "SysSignalName" SG_ 707 IICMvalue_Rsrv09 "ICMvalue_Rsrv09";
BA_ "CompuMethodName" SG_ 707 IICMvalue_Rsrv08 "ICMvalue_Rsrv08";
BA_ "ISignalName" SG_ 707 IICMvalue_Rsrv08 "IICMvalue_Rsrv08";
BA_ "LongName" SG_ 707 IICMvalue_Rsrv08 "ICM_value_Reserved08";
BA_ "SysSignalName" SG_ 707 IICMvalue_Rsrv08 "ICMvalue_Rsrv08";
BA_ "CompuMethodName" SG_ 707 IICMvalue_Rsrv07 "ICMvalue_Rsrv07";
BA_ "ISignalName" SG_ 707 IICMvalue_Rsrv07 "IICMvalue_Rsrv07";
BA_ "LongName" SG_ 707 IICMvalue_Rsrv07 "ICM_value_Reserved07";
BA_ "SysSignalName" SG_ 707 IICMvalue_Rsrv07 "ICMvalue_Rsrv07";
BA_ "CompuMethodName" SG_ 707 IICMvalue_Rsrv01 "ICMvalue_Rsrv01";
BA_ "ISignalName" SG_ 707 IICMvalue_Rsrv01 "IICMvalue_Rsrv01";
BA_ "LongName" SG_ 707 IICMvalue_Rsrv01 "ICM_value_Reserved01";
BA_ "SysSignalName" SG_ 707 IICMvalue_Rsrv01 "ICMvalue_Rsrv01";
BA_ "CompuMethodName" SG_ 707 IICMvalue_Rsrv02 "ICMvalue_Rsrv02";
BA_ "ISignalName" SG_ 707 IICMvalue_Rsrv02 "IICMvalue_Rsrv02";
BA_ "LongName" SG_ 707 IICMvalue_Rsrv02 "ICM_value_Reserved02";
BA_ "SysSignalName" SG_ 707 IICMvalue_Rsrv02 "ICMvalue_Rsrv02";
BA_ "CompuMethodName" SG_ 707 IICMvalue_Rsrv03 "ICMvalue_Rsrv03";
BA_ "ISignalName" SG_ 707 IICMvalue_Rsrv03 "IICMvalue_Rsrv03";
BA_ "LongName" SG_ 707 IICMvalue_Rsrv03 "ICM_value_Reserved03";
BA_ "SysSignalName" SG_ 707 IICMvalue_Rsrv03 "ICMvalue_Rsrv03";
BA_ "CompuMethodName" SG_ 707 IICMvalue_Rsrv04 "ICMvalue_Rsrv04";
BA_ "ISignalName" SG_ 707 IICMvalue_Rsrv04 "IICMvalue_Rsrv04";
BA_ "LongName" SG_ 707 IICMvalue_Rsrv04 "ICM_value_Reserved04";
BA_ "SysSignalName" SG_ 707 IICMvalue_Rsrv04 "ICMvalue_Rsrv04";
BA_ "CompuMethodName" SG_ 707 IICMvalue_Rsrv05 "ICMvalue_Rsrv05";
BA_ "ISignalName" SG_ 707 IICMvalue_Rsrv05 "IICMvalue_Rsrv05";
BA_ "LongName" SG_ 707 IICMvalue_Rsrv05 "ICM_value_Reserved05";
BA_ "SysSignalName" SG_ 707 IICMvalue_Rsrv05 "ICMvalue_Rsrv05";
BA_ "CompuMethodName" SG_ 707 IICMvalue_Rsrv06 "ICMvalue_Rsrv06";
BA_ "ISignalName" SG_ 707 IICMvalue_Rsrv06 "IICMvalue_Rsrv06";
BA_ "LongName" SG_ 707 IICMvalue_Rsrv06 "ICM_value_Reserved06";
BA_ "SysSignalName" SG_ 707 IICMvalue_Rsrv06 "ICMvalue_Rsrv06";
BA_ "CompuMethodName" SG_ 308 IZXD_20ms_Group07_CRC "ZXD_20ms_Group07_CRC";
BA_ "ISignalName" SG_ 308 IZXD_20ms_Group07_CRC "IZXD_20ms_Group07_CRC";
BA_ "SysSignalName" SG_ 308 IZXD_20ms_Group07_CRC "ZXD_20ms_Group07_CRC";
BA_ "CompuMethodName" SG_ 308 IZXD_20ms_Group07_RC "ZXD_20ms_Group07_RC";
BA_ "ISignalName" SG_ 308 IZXD_20ms_Group07_RC "IZXD_20ms_Group07_RC";
BA_ "SysSignalName" SG_ 308 IZXD_20ms_Group07_RC "ZXD_20ms_Group07_RC";
BA_ "CompuMethodName" SG_ 308 IZXD_20ms_Group07_Reserved1 "ZXD_20ms_Group07_Reserved1";
BA_ "GenSigStartValue" SG_ 308 IZXD_20ms_Group07_Reserved1 15;
BA_ "ISignalName" SG_ 308 IZXD_20ms_Group07_Reserved1 "IZXD_20ms_Group07_Reserved1";
BA_ "SysSignalName" SG_ 308 IZXD_20ms_Group07_Reserved1 "ZXD_20ms_Group07_Reserved1";
BA_ "CompuMethodName" SG_ 308 IZXD_20ms_Group07_Reserved3 "ZXD_20ms_Group07_Reserved3";
BA_ "GenSigStartValue" SG_ 308 IZXD_20ms_Group07_Reserved3 7;
BA_ "ISignalName" SG_ 308 IZXD_20ms_Group07_Reserved3 "IZXD_20ms_Group07_Reserved3";
BA_ "SysSignalName" SG_ 308 IZXD_20ms_Group07_Reserved3 "ZXD_20ms_Group07_Reserved3";
BA_ "CompuMethodName" SG_ 308 IAPAEPBOPReq "APAEPBOPReq";
BA_ "ISignalName" SG_ 308 IAPAEPBOPReq "IAPAEPBOPReq";
BA_ "LongName" SG_ 308 IAPAEPBOPReq "Advanced Park Assist Electric Park Brake Operation Request";
BA_ "SysSignalName" SG_ 308 IAPAEPBOPReq "APAEPBOPReq";
BA_ "CompuMethodName" SG_ 308 IZXD_20ms_Group07_Reserved2 "ZXD_20ms_Group07_Reserved2";
BA_ "GenSigStartValue" SG_ 308 IZXD_20ms_Group07_Reserved2 7;
BA_ "ISignalName" SG_ 308 IZXD_20ms_Group07_Reserved2 "IZXD_20ms_Group07_Reserved2";
BA_ "SysSignalName" SG_ 308 IZXD_20ms_Group07_Reserved2 "ZXD_20ms_Group07_Reserved2";
BA_ "CompuMethodName" SG_ 308 IZXD_20ms_Group07_Reserved4 "ZXD_20ms_Group07_Reserved4";
BA_ "GenSigStartValue" SG_ 308 IZXD_20ms_Group07_Reserved4 255;
BA_ "ISignalName" SG_ 308 IZXD_20ms_Group07_Reserved4 "IZXD_20ms_Group07_Reserved4";
BA_ "SysSignalName" SG_ 308 IZXD_20ms_Group07_Reserved4 "ZXD_20ms_Group07_Reserved4";
BA_ "CompuMethodName" SG_ 308 IAIPkgAPASCSAcclReqVal "AIPkgAPASCSAcclReqVal";
BA_ "ISignalName" SG_ 308 IAIPkgAPASCSAcclReqVal "IAIPkgAPASCSAcclReqVal";
BA_ "LongName" SG_ 308 IAIPkgAPASCSAcclReqVal "Ai Parking APA Acceleration Request Value";
BA_ "SysSignalName" SG_ 308 IAIPkgAPASCSAcclReqVal "AIPkgAPASCSAcclReqVal";
BA_ "CompuMethodName" SG_ 308 IZXD_20ms_Group07_Reserved5 "ZXD_20ms_Group07_Reserved5";
BA_ "GenSigStartValue" SG_ 308 IZXD_20ms_Group07_Reserved5 7;
BA_ "ISignalName" SG_ 308 IZXD_20ms_Group07_Reserved5 "IZXD_20ms_Group07_Reserved5";
BA_ "SysSignalName" SG_ 308 IZXD_20ms_Group07_Reserved5 "ZXD_20ms_Group07_Reserved5";
BA_ "CompuMethodName" SG_ 308 IAPASCSAcclReqSts "APASCSAcclReqSts";
BA_ "ISignalName" SG_ 308 IAPASCSAcclReqSts "IAPASCSAcclReqSts";
BA_ "LongName" SG_ 308 IAPASCSAcclReqSts "Advanced Park Assist Stability Control System Acceleration Request Status";
BA_ "SysSignalName" SG_ 308 IAPASCSAcclReqSts "APASCSAcclReqSts";
BA_ "CompuMethodName" SG_ 308 IAPAEPBOPReqV "APAEPBOPReqV";
BA_ "ISignalName" SG_ 308 IAPAEPBOPReqV "IAPAEPBOPReqV";
BA_ "LongName" SG_ 308 IAPAEPBOPReqV "Advanced Park Assist Electric Park Brake Operation Request Validity";
BA_ "SysSignalName" SG_ 308 IAPAEPBOPReqV "APAEPBOPReqV";
BA_ "CompuMethodName" SG_ 308 IAutodDrvngSysSCSSdslReqV "AutodDrvngSysSCSSdslReqV";
BA_ "ISignalName" SG_ 308 IAutodDrvngSysSCSSdslReqV "IAutodDrvngSysSCSSdslReqV";
BA_ "LongName" SG_ 308 IAutodDrvngSysSCSSdslReqV "Automated Driving System Stability Control System Standstill Request Validity";
BA_ "SysSignalName" SG_ 308 IAutodDrvngSysSCSSdslReqV "AutodDrvngSysSCSSdslReqV";
BA_ "CompuMethodName" SG_ 308 IAutodDrvngSysSCSSdslReq "AutodDrvngSysSCSSdslReq";
BA_ "ISignalName" SG_ 308 IAutodDrvngSysSCSSdslReq "IAutodDrvngSysSCSSdslReq";
BA_ "LongName" SG_ 308 IAutodDrvngSysSCSSdslReq "Automated Driving System Stability Control System Standstill Request";
BA_ "SysSignalName" SG_ 308 IAutodDrvngSysSCSSdslReq "AutodDrvngSysSCSSdslReq";
BA_ "CompuMethodName" SG_ 308 IZXD_20ms_Group07_Reserved6 "ZXD_20ms_Group07_Reserved6";
BA_ "GenSigStartValue" SG_ 308 IZXD_20ms_Group07_Reserved6 63;
BA_ "ISignalName" SG_ 308 IZXD_20ms_Group07_Reserved6 "IZXD_20ms_Group07_Reserved6";
BA_ "SysSignalName" SG_ 308 IZXD_20ms_Group07_Reserved6 "ZXD_20ms_Group07_Reserved6";
BA_ "CompuMethodName" SG_ 308 IAutodDrvngSysSCSDrvOffReqV "AutodDrvngSysSCSDrvOffReqV";
BA_ "ISignalName" SG_ 308 IAutodDrvngSysSCSDrvOffReqV "IAutodDrvngSysSCSDrvOffReqV";
BA_ "LongName" SG_ 308 IAutodDrvngSysSCSDrvOffReqV "Automated Driving System Stability Control System Drive Off Request Validity";
BA_ "SysSignalName" SG_ 308 IAutodDrvngSysSCSDrvOffReqV "AutodDrvngSysSCSDrvOffReqV";
BA_ "CompuMethodName" SG_ 308 IAutodDrvngSysSCSDrvOffReq "AutodDrvngSysSCSDrvOffReq";
BA_ "ISignalName" SG_ 308 IAutodDrvngSysSCSDrvOffReq "IAutodDrvngSysSCSDrvOffReq";
BA_ "LongName" SG_ 308 IAutodDrvngSysSCSDrvOffReq "Automated Driving System Stability Control System Drive Off Request";
BA_ "SysSignalName" SG_ 308 IAutodDrvngSysSCSDrvOffReq "AutodDrvngSysSCSDrvOffReq";
BA_ "CompuMethodName" SG_ 308 IAutodDrvngSysMdReqV "AutodDrvngSysMdReqV";
BA_ "ISignalName" SG_ 308 IAutodDrvngSysMdReqV "IAutodDrvngSysMdReqV";
BA_ "LongName" SG_ 308 IAutodDrvngSysMdReqV "Automated Driving System Mode Request Validity";
BA_ "SysSignalName" SG_ 308 IAutodDrvngSysMdReqV "AutodDrvngSysMdReqV";
BA_ "CompuMethodName" SG_ 308 IAutodDrvngSysMdReq "AutodDrvngSysMdReq";
BA_ "ISignalName" SG_ 308 IAutodDrvngSysMdReq "IAutodDrvngSysMdReq";
BA_ "LongName" SG_ 308 IAutodDrvngSysMdReq "Automated Driving System Mode Request";
BA_ "SysSignalName" SG_ 308 IAutodDrvngSysMdReq "AutodDrvngSysMdReq";
BA_ "CompuMethodName" SG_ 308 IAutodDrvngSysFlrStsV "AutodDrvngSysFlrStsV";
BA_ "ISignalName" SG_ 308 IAutodDrvngSysFlrStsV "IAutodDrvngSysFlrStsV";
BA_ "LongName" SG_ 308 IAutodDrvngSysFlrStsV "Automated Driving System Failure Status Validity";
BA_ "SysSignalName" SG_ 308 IAutodDrvngSysFlrStsV "AutodDrvngSysFlrStsV";
BA_ "CompuMethodName" SG_ 308 IAutodDrvngSysFlrSts "AutodDrvngSysFlrSts";
BA_ "ISignalName" SG_ 308 IAutodDrvngSysFlrSts "IAutodDrvngSysFlrSts";
BA_ "LongName" SG_ 308 IAutodDrvngSysFlrSts "Automated Driving System Failure Status";
BA_ "SysSignalName" SG_ 308 IAutodDrvngSysFlrSts "AutodDrvngSysFlrSts";
BA_ "CompuMethodName" SG_ 774 ITrfcLghtFuctionSwSts "TrfcLghtFuctionSwSts";
BA_ "ISignalName" SG_ 774 ITrfcLghtFuctionSwSts "ITrfcLghtFuctionSwSts";
BA_ "LongName" SG_ 774 ITrfcLghtFuctionSwSts "Traffic Light Fuction Switch Status";
BA_ "SysSignalName" SG_ 774 ITrfcLghtFuctionSwSts "TrfcLghtFuctionSwSts";
BA_ "CompuMethodName" SG_ 774 IAPASpdMdSwSts "APASpdMdSwSts";
BA_ "GenSigStartValue" SG_ 774 IAPASpdMdSwSts 1;
BA_ "ISignalName" SG_ 774 IAPASpdMdSwSts "IAPASpdMdSwSts";
BA_ "LongName" SG_ 774 IAPASpdMdSwSts "Advanced Park Assist Speed Mode Switch Status";
BA_ "SysSignalName" SG_ 774 IAPASpdMdSwSts "APASpdMdSwSts";
BA_ "CompuMethodName" SG_ 774 IParkngInPrgs "ParkngInPrgs";
BA_ "ISignalName" SG_ 774 IParkngInPrgs "IParkngInPrgs";
BA_ "LongName" SG_ 774 IParkngInPrgs "Parking Progress";
BA_ "SysSignalName" SG_ 774 IParkngInPrgs "ParkngInPrgs";
BA_ "CompuMethodName" SG_ 774 ITrfcMrgdInfoSignDist "TrfcMrgdInfoSignDist";
BA_ "ISignalName" SG_ 774 ITrfcMrgdInfoSignDist "ITrfcMrgdInfoSignDist";
BA_ "LongName" SG_ 774 ITrfcMrgdInfoSignDist "Traffic_Merged_Information_Sign_Distance";
BA_ "SysSignalName" SG_ 774 ITrfcMrgdInfoSignDist "TrfcMrgdInfoSignDist";
BA_ "CompuMethodName" SG_ 774 ITrfcMrgdForbidDist "TrfcMrgdForbidDist";
BA_ "ISignalName" SG_ 774 ITrfcMrgdForbidDist "ITrfcMrgdForbidDist";
BA_ "LongName" SG_ 774 ITrfcMrgdForbidDist "Traffic_Merged_Forbid_Sign_Distance";
BA_ "SysSignalName" SG_ 774 ITrfcMrgdForbidDist "TrfcMrgdForbidDist";
BA_ "CompuMethodName" SG_ 774 ITrfcMrgdWrnngSignDist "TrfcMrgdWrnngSignDist";
BA_ "ISignalName" SG_ 774 ITrfcMrgdWrnngSignDist "ITrfcMrgdWrnngSignDist";
BA_ "LongName" SG_ 774 ITrfcMrgdWrnngSignDist "Traffic_Merged_Warnning_Sign_Distance";
BA_ "SysSignalName" SG_ 774 ITrfcMrgdWrnngSignDist "TrfcMrgdWrnngSignDist";
BA_ "CompuMethodName" SG_ 774 ITrfcMrgdForbidSign "TrfcMrgdForbidSign";
BA_ "ISignalName" SG_ 774 ITrfcMrgdForbidSign "ITrfcMrgdForbidSign";
BA_ "LongName" SG_ 774 ITrfcMrgdForbidSign "Traffic_Merged_Forbid_Sign";
BA_ "SysSignalName" SG_ 774 ITrfcMrgdForbidSign "TrfcMrgdForbidSign";
BA_ "CompuMethodName" SG_ 774 ITrfcMrgdWrnngSign "TrfcMrgdWrnngSign";
BA_ "ISignalName" SG_ 774 ITrfcMrgdWrnngSign "ITrfcMrgdWrnngSign";
BA_ "LongName" SG_ 774 ITrfcMrgdWrnngSign "Traffic_Merged_Warnning_Sign";
BA_ "SysSignalName" SG_ 774 ITrfcMrgdWrnngSign "TrfcMrgdWrnngSign";
BA_ "CompuMethodName" SG_ 807 IEndToEndPilotSwSts "EndToEndPilotSwSts";
BA_ "GenSigStartValue" SG_ 807 IEndToEndPilotSwSts 2;
BA_ "ISignalName" SG_ 807 IEndToEndPilotSwSts "IEndToEndPilotSwSts";
BA_ "LongName" SG_ 807 IEndToEndPilotSwSts "End To End Pilot Switch Status";
BA_ "SysSignalName" SG_ 807 IEndToEndPilotSwSts "EndToEndPilotSwSts";
BA_ "CompuMethodName" SG_ 807 IDLP_NarwSpcAstSts "DLP_NarwSpcAstSts";
BA_ "ISignalName" SG_ 807 IDLP_NarwSpcAstSts "IDLP_NarwSpcAstSts";
BA_ "LongName" SG_ 807 IDLP_NarwSpcAstSts "Narrow Space Assist Status";
BA_ "SysSignalName" SG_ 807 IDLP_NarwSpcAstSts "DLP_NarwSpcAstSts";
BA_ "CompuMethodName" SG_ 807 IACCSLIFMsgResp "ACCSLIFMsgResp";
BA_ "ISignalName" SG_ 807 IACCSLIFMsgResp "IACCSLIFMsgResp";
BA_ "LongName" SG_ 807 IACCSLIFMsgResp "ACC Speed Limit Control Massage Response";
BA_ "SysSignalName" SG_ 807 IACCSLIFMsgResp "ACCSLIFMsgResp";
BA_ "CompuMethodName" SG_ 807 ISLIFSts_IPD "SLIFSts_IPD";
BA_ "GenSigStartValue" SG_ 807 ISLIFSts_IPD 1;
BA_ "ISignalName" SG_ 807 ISLIFSts_IPD "ISLIFSts_IPD";
BA_ "LongName" SG_ 807 ISLIFSts_IPD "Speed Limit Information Function Status";
BA_ "SysSignalName" SG_ 807 ISLIFSts_IPD "SLIFSts_IPD";
BA_ "CompuMethodName" SG_ 807 ITSRSts "TSRSts";
BA_ "ISignalName" SG_ 807 ITSRSts "ITSRSts";
BA_ "LongName" SG_ 807 ITSRSts "Traffic Sign Recognization Function Status";
BA_ "SysSignalName" SG_ 807 ITSRSts "TSRSts";
BA_ "CompuMethodName" SG_ 807 ITSRSwReqResp "TSRSwReqResp";
BA_ "ISignalName" SG_ 807 ITSRSwReqResp "ITSRSwReqResp";
BA_ "LongName" SG_ 807 ITSRSwReqResp "TSR_Switch_Request_Response";
BA_ "SysSignalName" SG_ 807 ITSRSwReqResp "TSRSwReqResp";
BA_ "CompuMethodName" SG_ 807 ITSRTrgtBanSign "TSRTrgtBanSign";
BA_ "ISignalName" SG_ 807 ITSRTrgtBanSign "ITSRTrgtBanSign";
BA_ "LongName" SG_ 807 ITSRTrgtBanSign "Traffic Sign Recognization Target Ban Sign";
BA_ "SysSignalName" SG_ 807 ITSRTrgtBanSign "TSRTrgtBanSign";
BA_ "CompuMethodName" SG_ 807 ITSRTrgtWarnSign "TSRTrgtWarnSign";
BA_ "ISignalName" SG_ 807 ITSRTrgtWarnSign "ITSRTrgtWarnSign";
BA_ "LongName" SG_ 807 ITSRTrgtWarnSign "Traffic Sign Recognization Target Warning Sign";
BA_ "SysSignalName" SG_ 807 ITSRTrgtWarnSign "TSRTrgtWarnSign";
BA_ "CompuMethodName" SG_ 807 ISpdAstSysTrgtSpd_IPD "SpdAstSysTrgtSpd_IPD";
BA_ "ISignalName" SG_ 807 ISpdAstSysTrgtSpd_IPD "ISpdAstSysTrgtSpd_IPD";
BA_ "LongName" SG_ 807 ISpdAstSysTrgtSpd_IPD "Speed Assist System Target Speed";
BA_ "SysSignalName" SG_ 807 ISpdAstSysTrgtSpd_IPD "SpdAstSysTrgtSpd_IPD";
BA_ "CompuMethodName" SG_ 807 ITrfcMrgdInfoSign "TrfcMrgdInfoSign";
BA_ "ISignalName" SG_ 807 ITrfcMrgdInfoSign "ITrfcMrgdInfoSign";
BA_ "LongName" SG_ 807 ITrfcMrgdInfoSign "Traffic_Merged_Information_Sign";
BA_ "SysSignalName" SG_ 807 ITrfcMrgdInfoSign "TrfcMrgdInfoSign";
VAL_ 118 IICBtoVMCEPSRsvd02 0 "ICBtoVMCEPSRsvd02_0__0" 1 "ICBtoVMCEPSRsvd02_1__1" 2 "ICBtoVMCEPSRsvd02_2__2" 3 "ICBtoVMCEPSRsvd02_3__3" 4 "ICBtoVMCEPSRsvd02_4__4" 5 "ICBtoVMCEPSRsvd02_5__5" 6 "ICBtoVMCEPSRsvd02_6__6" 7 "ICBtoVMCEPSRsvd02_7__7";
VAL_ 118 IICBtoVMCEPSRsvd03 0 "ICBtoVMCEPSRsvd03_0__0" 1 "ICBtoVMCEPSRsvd03_1__1" 2 "ICBtoVMCEPSRsvd03_2__2" 3 "ICBtoVMCEPSRsvd03_3__3" 4 "ICBtoVMCEPSRsvd03_4__4" 5 "ICBtoVMCEPSRsvd03_5__5" 6 "ICBtoVMCEPSRsvd03_6__6" 7 "ICBtoVMCEPSRsvd03_7__7" 8 "ICBtoVMCEPSRsvd03_8__8" 9 "ICBtoVMCEPSRsvd03_9__9" 10 "ICBtoVMCEPSRsvd03_10__10" 11 "ICBtoVMCEPSRsvd03_11__11" 12 "ICBtoVMCEPSRsvd03_12__12" 13 "ICBtoVMCEPSRsvd03_13__13" 14 "ICBtoVMCEPSRsvd03_14__14" 15 "ICBtoVMCEPSRsvd03_15__15" 16 "ICBtoVMCEPSRsvd03_16__16" 17 "ICBtoVMCEPSRsvd03_17__17" 18 "ICBtoVMCEPSRsvd03_18__18" 19 "ICBtoVMCEPSRsvd03_19__19" 20 "ICBtoVMCEPSRsvd03_20__20" 21 "ICBtoVMCEPSRsvd03_21__21" 22 "ICBtoVMCEPSRsvd03_22__22" 23 "ICBtoVMCEPSRsvd03_23__23" 24 "ICBtoVMCEPSRsvd03_24__24" 25 "ICBtoVMCEPSRsvd03_25__25" 26 "ICBtoVMCEPSRsvd03_26__26" 27 "ICBtoVMCEPSRsvd03_27__27" 28 "ICBtoVMCEPSRsvd03_28__28" 29 "ICBtoVMCEPSRsvd03_29__29" 30 "ICBtoVMCEPSRsvd03_30__30" 31 "ICBtoVMCEPSRsvd03_31__31" 32 "ICBtoVMCEPSRsvd03_32__32" 33 "ICBtoVMCEPSRsvd03_33__33" 34 "ICBtoVMCEPSRsvd03_34__34" 35 "ICBtoVMCEPSRsvd03_35__35" 36 "ICBtoVMCEPSRsvd03_36__36" 37 "ICBtoVMCEPSRsvd03_37__37" 38 "ICBtoVMCEPSRsvd03_38__38" 39 "ICBtoVMCEPSRsvd03_39__39" 40 "ICBtoVMCEPSRsvd03_40__40" 41 "ICBtoVMCEPSRsvd03_41__41" 42 "ICBtoVMCEPSRsvd03_42__42" 43 "ICBtoVMCEPSRsvd03_43__43" 44 "ICBtoVMCEPSRsvd03_44__44" 45 "ICBtoVMCEPSRsvd03_45__45" 46 "ICBtoVMCEPSRsvd03_46__46" 47 "ICBtoVMCEPSRsvd03_47__47" 48 "ICBtoVMCEPSRsvd03_48__48" 49 "ICBtoVMCEPSRsvd03_49__49" 50 "ICBtoVMCEPSRsvd03_50__50" 51 "ICBtoVMCEPSRsvd03_51__51" 52 "ICBtoVMCEPSRsvd03_52__52" 53 "ICBtoVMCEPSRsvd03_53__53" 54 "ICBtoVMCEPSRsvd03_54__54" 55 "ICBtoVMCEPSRsvd03_55__55" 56 "ICBtoVMCEPSRsvd03_56__56" 57 "ICBtoVMCEPSRsvd03_57__57" 58 "ICBtoVMCEPSRsvd03_58__58" 59 "ICBtoVMCEPSRsvd03_59__59" 60 "ICBtoVMCEPSRsvd03_60__60" 61 "ICBtoVMCEPSRsvd03_61__61" 62 "ICBtoVMCEPSRsvd03_62__62" 63 "ICBtoVMCEPSRsvd03_63__63" 64 "ICBtoVMCEPSRsvd03_64__64" 65 "ICBtoVMCEPSRsvd03_65__65" 66 "ICBtoVMCEPSRsvd03_66__66" 67 "ICBtoVMCEPSRsvd03_67__67" 68 "ICBtoVMCEPSRsvd03_68__68" 69 "ICBtoVMCEPSRsvd03_69__69" 70 "ICBtoVMCEPSRsvd03_70__70" 71 "ICBtoVMCEPSRsvd03_71__71" 72 "ICBtoVMCEPSRsvd03_72__72" 73 "ICBtoVMCEPSRsvd03_73__73" 74 "ICBtoVMCEPSRsvd03_74__74" 75 "ICBtoVMCEPSRsvd03_75__75" 76 "ICBtoVMCEPSRsvd03_76__76" 77 "ICBtoVMCEPSRsvd03_77__77" 78 "ICBtoVMCEPSRsvd03_78__78" 79 "ICBtoVMCEPSRsvd03_79__79" 80 "ICBtoVMCEPSRsvd03_80__80" 81 "ICBtoVMCEPSRsvd03_81__81" 82 "ICBtoVMCEPSRsvd03_82__82" 83 "ICBtoVMCEPSRsvd03_83__83" 84 "ICBtoVMCEPSRsvd03_84__84" 85 "ICBtoVMCEPSRsvd03_85__85" 86 "ICBtoVMCEPSRsvd03_86__86" 87 "ICBtoVMCEPSRsvd03_87__87" 88 "ICBtoVMCEPSRsvd03_88__88" 89 "ICBtoVMCEPSRsvd03_89__89" 90 "ICBtoVMCEPSRsvd03_90__90" 91 "ICBtoVMCEPSRsvd03_91__91" 92 "ICBtoVMCEPSRsvd03_92__92" 93 "ICBtoVMCEPSRsvd03_93__93" 94 "ICBtoVMCEPSRsvd03_94__94" 95 "ICBtoVMCEPSRsvd03_95__95" 96 "ICBtoVMCEPSRsvd03_96__96" 97 "ICBtoVMCEPSRsvd03_97__97" 98 "ICBtoVMCEPSRsvd03_98__98" 99 "ICBtoVMCEPSRsvd03_99__99" 100 "ICBtoVMCEPSRsvd03_100__100" 101 "ICBtoVMCEPSRsvd03_101__101" 102 "ICBtoVMCEPSRsvd03_102__102";
VAL_ 118 IICBtoVMCEPSRsvd04 0 "ICBtoVMCEPSRsvd04_0__0" 1 "ICBtoVMCEPSRsvd04_1__1" 2 "ICBtoVMCEPSRsvd04_2__2" 3 "ICBtoVMCEPSRsvd04_3__3" 4 "ICBtoVMCEPSRsvd04_4__4" 5 "ICBtoVMCEPSRsvd04_5__5" 6 "ICBtoVMCEPSRsvd04_6__6" 7 "ICBtoVMCEPSRsvd04_7__7" 8 "ICBtoVMCEPSRsvd04_8__8" 9 "ICBtoVMCEPSRsvd04_9__9" 10 "ICBtoVMCEPSRsvd04_10__10" 11 "ICBtoVMCEPSRsvd04_11__11" 12 "ICBtoVMCEPSRsvd04_12__12" 13 "ICBtoVMCEPSRsvd04_13__13" 14 "ICBtoVMCEPSRsvd04_14__14" 15 "ICBtoVMCEPSRsvd04_15__15" 16 "ICBtoVMCEPSRsvd04_16__16" 17 "ICBtoVMCEPSRsvd04_17__17" 18 "ICBtoVMCEPSRsvd04_18__18" 19 "ICBtoVMCEPSRsvd04_19__19" 20 "ICBtoVMCEPSRsvd04_20__20" 21 "ICBtoVMCEPSRsvd04_21__21" 22 "ICBtoVMCEPSRsvd04_22__22" 23 "ICBtoVMCEPSRsvd04_23__23" 24 "ICBtoVMCEPSRsvd04_24__24" 25 "ICBtoVMCEPSRsvd04_25__25" 26 "ICBtoVMCEPSRsvd04_26__26" 27 "ICBtoVMCEPSRsvd04_27__27" 28 "ICBtoVMCEPSRsvd04_28__28" 29 "ICBtoVMCEPSRsvd04_29__29" 30 "ICBtoVMCEPSRsvd04_30__30" 31 "ICBtoVMCEPSRsvd04_31__31" 32 "ICBtoVMCEPSRsvd04_32__32" 33 "ICBtoVMCEPSRsvd04_33__33" 34 "ICBtoVMCEPSRsvd04_34__34" 35 "ICBtoVMCEPSRsvd04_35__35" 36 "ICBtoVMCEPSRsvd04_36__36" 37 "ICBtoVMCEPSRsvd04_37__37" 38 "ICBtoVMCEPSRsvd04_38__38" 39 "ICBtoVMCEPSRsvd04_39__39" 40 "ICBtoVMCEPSRsvd04_40__40" 41 "ICBtoVMCEPSRsvd04_41__41" 42 "ICBtoVMCEPSRsvd04_42__42" 43 "ICBtoVMCEPSRsvd04_43__43" 44 "ICBtoVMCEPSRsvd04_44__44" 45 "ICBtoVMCEPSRsvd04_45__45" 46 "ICBtoVMCEPSRsvd04_46__46" 47 "ICBtoVMCEPSRsvd04_47__47" 48 "ICBtoVMCEPSRsvd04_48__48" 49 "ICBtoVMCEPSRsvd04_49__49" 50 "ICBtoVMCEPSRsvd04_50__50" 51 "ICBtoVMCEPSRsvd04_51__51" 52 "ICBtoVMCEPSRsvd04_52__52" 53 "ICBtoVMCEPSRsvd04_53__53" 54 "ICBtoVMCEPSRsvd04_54__54" 55 "ICBtoVMCEPSRsvd04_55__55" 56 "ICBtoVMCEPSRsvd04_56__56" 57 "ICBtoVMCEPSRsvd04_57__57" 58 "ICBtoVMCEPSRsvd04_58__58" 59 "ICBtoVMCEPSRsvd04_59__59" 60 "ICBtoVMCEPSRsvd04_60__60" 61 "ICBtoVMCEPSRsvd04_61__61" 62 "ICBtoVMCEPSRsvd04_62__62" 63 "ICBtoVMCEPSRsvd04_63__63" 64 "ICBtoVMCEPSRsvd04_64__64" 65 "ICBtoVMCEPSRsvd04_65__65" 66 "ICBtoVMCEPSRsvd04_66__66" 67 "ICBtoVMCEPSRsvd04_67__67" 68 "ICBtoVMCEPSRsvd04_68__68" 69 "ICBtoVMCEPSRsvd04_69__69" 70 "ICBtoVMCEPSRsvd04_70__70" 71 "ICBtoVMCEPSRsvd04_71__71" 72 "ICBtoVMCEPSRsvd04_72__72" 73 "ICBtoVMCEPSRsvd04_73__73" 74 "ICBtoVMCEPSRsvd04_74__74" 75 "ICBtoVMCEPSRsvd04_75__75" 76 "ICBtoVMCEPSRsvd04_76__76" 77 "ICBtoVMCEPSRsvd04_77__77" 78 "ICBtoVMCEPSRsvd04_78__78" 79 "ICBtoVMCEPSRsvd04_79__79" 80 "ICBtoVMCEPSRsvd04_80__80" 81 "ICBtoVMCEPSRsvd04_81__81" 82 "ICBtoVMCEPSRsvd04_82__82" 83 "ICBtoVMCEPSRsvd04_83__83" 84 "ICBtoVMCEPSRsvd04_84__84" 85 "ICBtoVMCEPSRsvd04_85__85" 86 "ICBtoVMCEPSRsvd04_86__86" 87 "ICBtoVMCEPSRsvd04_87__87" 88 "ICBtoVMCEPSRsvd04_88__88" 89 "ICBtoVMCEPSRsvd04_89__89" 90 "ICBtoVMCEPSRsvd04_90__90" 91 "ICBtoVMCEPSRsvd04_91__91" 92 "ICBtoVMCEPSRsvd04_92__92" 93 "ICBtoVMCEPSRsvd04_93__93" 94 "ICBtoVMCEPSRsvd04_94__94" 95 "ICBtoVMCEPSRsvd04_95__95" 96 "ICBtoVMCEPSRsvd04_96__96" 97 "ICBtoVMCEPSRsvd04_97__97" 98 "ICBtoVMCEPSRsvd04_98__98" 99 "ICBtoVMCEPSRsvd04_99__99" 100 "ICBtoVMCEPSRsvd04_100__100" 101 "ICBtoVMCEPSRsvd04_101__101" 102 "ICBtoVMCEPSRsvd04_102__102";
VAL_ 118 IICBHigLeCtrlSts 0 "ICBHigLeCtrlSts_0__0" 1 "ICBHigLeCtrlSts_1__1" 2 "ICBHigLeCtrlSts_2__2" 3 "ICBHigLeCtrlSts_3__3" 4 "ICBHigLeCtrlSts_4__4" 5 "ICBHigLeCtrlSts_5__5" 6 "ICBHigLeCtrlSts_6__6" 7 "ICBHigLeCtrlSts_7__7" 8 "ICBHigLeCtrlSts_8__8" 9 "ICBHigLeCtrlSts_9__9" 10 "ICBHigLeCtrlSts_10__10" 11 "ICBHigLeCtrlSts_11__11" 12 "ICBHigLeCtrlSts_12__12" 13 "ICBHigLeCtrlSts_13__13" 14 "ICBHigLeCtrlSts_14__14" 15 "ICBHigLeCtrlSts_15__15";
VAL_ 118 IICBtoVMCEPSRsvd01 0 "ICBtoVMCEPSRsvd01_0__0" 1 "ICBtoVMCEPSRsvd01_1__1" 2 "ICBtoVMCEPSRsvd01_2__2" 3 "ICBtoVMCEPSRsvd01_3__3";
VAL_ 118 IICBHigLeCtrlReason 0 "ICBHigLeCtrlReason_0_Value_0" 1 "ICBHigLeCtrlReason_1__1" 2 "ICBHigLeCtrlReason_2__2" 3 "ICBHigLeCtrlReason_3__3" 4 "ICBHigLeCtrlReason_4__4" 5 "ICBHigLeCtrlReason_5__5" 6 "ICBHigLeCtrlReason_6__6" 7 "ICBHigLeCtrlReason_7__7" 8 "ICBHigLeCtrlReason_8__8" 9 "ICBHigLeCtrlReason_9__9" 10 "ICBHigLeCtrlReason_10__10" 11 "ICBHigLeCtrlReason_11__11" 12 "ICBHigLeCtrlReason_12__12" 13 "ICBHigLeCtrlReason_13__13" 14 "ICBHigLeCtrlReason_14__14" 15 "ICBHigLeCtrlReason_15__15";
VAL_ 118 IICBHigLeCtrlFltSts 0 "ICBHigLeCtrlFltSts_0_Nomal" 1 "ICBHigLeCtrlFltSts_1_AEBAction" 2 "ICBHigLeCtrlFltSts_2_AEBFailt" 3 "ICBHigLeCtrlFltSts_3__3" 4 "ICBHigLeCtrlFltSts_4__4" 5 "ICBHigLeCtrlFltSts_5__5" 6 "ICBHigLeCtrlFltSts_6__6" 7 "ICBHigLeCtrlFltSts_7__7" 8 "ICBHigLeCtrlFltSts_8__8" 9 "ICBHigLeCtrlFltSts_9__9" 10 "ICBHigLeCtrlFltSts_10__10" 11 "ICBHigLeCtrlFltSts_11__11" 12 "ICBHigLeCtrlFltSts_12__12" 13 "ICBHigLeCtrlFltSts_13__13" 14 "ICBHigLeCtrlFltSts_14__14" 15 "ICBHigLeCtrlFltSts_15__15";
VAL_ 805 INOAQukChgSwReq 0 "NOAQukChgSwReq_0_False" 1 "NOAQukChgSwReq_1_True";
VAL_ 805 IPDCPwrSts 0 "PDCPwrSts_0_OFF" 1 "PDCPwrSts_1_ON";
VAL_ 805 IMMCUPwrSts 0 "MMCUPwrSts_0_OFF" 1 "MMCUPwrSts_1_ON";
VAL_ 805 IFICMACRTemV 0 "FICMACRTemV_0_Valid" 1 "FICMACRTemV_1_Invalid";
VAL_ 805 IAIParkngReq_ZXD 0 "AIParkngReq_ZXD_0_No_Request" 1 "AIParkngReq_ZXD_1_Start_Parking_in" 2 "AIParkngReq_ZXD_2_Start_Parking_out" 3 "AIParkngReq_ZXD_3_Pause" 4 "AIParkngReq_ZXD_4_Continue" 5 "AIParkngReq_ZXD_5_Cancel" 7 "AIParkngReq_ZXD_7_Left_Parking_out" 8 "AIParkngReq_ZXD_8_Right_Parking_out" 9 "AIParkngReq_ZXD_9_Fast_Parking" 10 "AIParkngReq_ZXD_10_Line_out_System_Start" 11 "AIParkngReq_ZXD_11_Line_back_System_Start" 12 "AIParkngReq_ZXD_12_Call_to_Position_X" 13 "AIParkngReq_ZXD_13_StartParkingScanningManualDriving" 14 "AIParkngReq_ZXD_14_Remote_turn_left" 15 "AIParkngReq_ZXD_15_Remote_turn_right" 16 "AIParkngReq_ZXD_16_RememberBuildMap" 17 "AIParkngReq_ZXD_17_Remember_Park_In" 18 "AIParkngReq_ZXD_18_Remember_Summon" 19 "AIParkngReq_ZXD_19_Start_Remember_Parking" 20 "AIParkngReq_ZXD_20_Keep_Going_Forword" 21 "AIParkngReq_ZXD_21_Keep_Going_Back" 22 "AIParkngReq_ZXD_22_Start_AVP_in" 23 "AIParkngReq_ZXD_23_Start_AVP_out" 24 "AIParkngReq_ZXD_24_Back_Left_Parking_out" 25 "AIParkngReq_ZXD_25_Back_Right_Parking_out" 26 "AIParkngReq_ZXD_26_Start_NRCD" 27 "AIParkngReq_ZXD_27_Front_Left_Cross_Park_Out" 28 "AIParkngReq_ZXD_28_Front_Left_Parallel_Park_Out" 29 "AIParkngReq_ZXD_29_Front_Out_Park_Out" 30 "AIParkngReq_ZXD_30_Front_Right_Cross_Park_Out" 31 "AIParkngReq_ZXD_31_Front_Right_Parallel_Park_Out" 32 "AIParkngReq_ZXD_32_Back_Out_Park_Out" 33 "AIParkngReq_ZXD_33_Back_Left_Cross_Park_Out" 34 "AIParkngReq_ZXD_34_Back_Right_Cross_Park_Out" 35 "AIParkngReq_ZXD_35_Start_Confirm" 36 "AIParkngReq_ZXD_36_Start_RPI" 37 "AIParkngReq_ZXD_37_Start_RPI_Super" 38 "AIParkngReq_ZXD_38_Confirm" 39 "AIParkngReq_ZXD_39_Quit" 40 "AIParkngReq_ZXD_40_Start_RADS" 41 "AIParkngReq_ZXD_41_Start_NPA" 48 "AIParkngReq_ZXD_48_Start_NCP" 49 "AIParkngReq_ZXD_49_AIParkngReq_reserved" 50 "AIParkngReq_ZXD_50_AIParkngReq_reserved" 51 "AIParkngReq_ZXD_51_AIParkngReq_reserved" 52 "AIParkngReq_ZXD_52_AIParkngReq_reserved" 53 "AIParkngReq_ZXD_53_AIParkngReq_reserved" 54 "AIParkngReq_ZXD_54_AIParkngReq_reserved" 55 "AIParkngReq_ZXD_55_AIParkngReq_reserved" 56 "AIParkngReq_ZXD_56_AIParkngReq_reserved" 57 "AIParkngReq_ZXD_57_AIParkngReq_reserved" 58 "AIParkngReq_ZXD_58_AIParkngReq_reserved" 59 "AIParkngReq_ZXD_59_AIParkngReq_reserved" 60 "AIParkngReq_ZXD_60_AIParkngReq_reserved" 61 "AIParkngReq_ZXD_61_AIParkngReq_reserved" 62 "AIParkngReq_ZXD_62_AIParkngReq_reserved" 63 "AIParkngReq_ZXD_63_AIParkngReq_reserved" 64 "AIParkngReq_ZXD_64_AIParkngReq_reserved" 65 "AIParkngReq_ZXD_65_AIParkngReq_reserved" 66 "AIParkngReq_ZXD_66_AIParkngReq_reserved" 67 "AIParkngReq_ZXD_67_AIParkngReq_reserved" 68 "AIParkngReq_ZXD_68_AIParkngReq_reserved" 69 "AIParkngReq_ZXD_69_AIParkngReq_reserved" 70 "AIParkngReq_ZXD_70_AIParkngReq_reserved" 71 "AIParkngReq_ZXD_71_AIParkngReq_reserved" 72 "AIParkngReq_ZXD_72_AIParkngReq_reserved" 73 "AIParkngReq_ZXD_73_AIParkngReq_reserved" 74 "AIParkngReq_ZXD_74_AIParkngReq_reserved" 75 "AIParkngReq_ZXD_75_AIParkngReq_reserved" 76 "AIParkngReq_ZXD_76_AIParkngReq_reserved" 77 "AIParkngReq_ZXD_77_AIParkngReq_reserved" 78 "AIParkngReq_ZXD_78_AIParkngReq_reserved" 79 "AIParkngReq_ZXD_79_AIParkngReq_reserved" 80 "AIParkngReq_ZXD_80_AIParkngReq_reserved" 81 "AIParkngReq_ZXD_81_AIParkngReq_reserved" 82 "AIParkngReq_ZXD_82_AIParkngReq_reserved" 83 "AIParkngReq_ZXD_83_AIParkngReq_reserved" 84 "AIParkngReq_ZXD_84_AIParkngReq_reserved" 85 "AIParkngReq_ZXD_85_AIParkngReq_reserved" 86 "AIParkngReq_ZXD_86_AIParkngReq_reserved" 87 "AIParkngReq_ZXD_87_AIParkngReq_reserved" 88 "AIParkngReq_ZXD_88_AIParkngReq_reserved" 89 "AIParkngReq_ZXD_89_AIParkngReq_reserved" 90 "AIParkngReq_ZXD_90_AIParkngReq_reserved" 91 "AIParkngReq_ZXD_91_AIParkngReq_reserved" 92 "AIParkngReq_ZXD_92_AIParkngReq_reserved" 93 "AIParkngReq_ZXD_93_AIParkngReq_reserved" 94 "AIParkngReq_ZXD_94_AIParkngReq_reserved" 95 "AIParkngReq_ZXD_95_AIParkngReq_reserved" 96 "AIParkngReq_ZXD_96_AIParkngReq_reserved" 97 "AIParkngReq_ZXD_97_AIParkngReq_reserved" 98 "AIParkngReq_ZXD_98_AIParkngReq_reserved" 99 "AIParkngReq_ZXD_99_AIParkngReq_reserved" 100 "AIParkngReq_ZXD_100_AIParkngReq_reserved" 101 "AIParkngReq_ZXD_101_AIParkngReq_reserved" 102 "AIParkngReq_ZXD_102_AIParkngReq_reserved" 103 "AIParkngReq_ZXD_103_AIParkngReq_reserved" 104 "AIParkngReq_ZXD_104_AIParkngReq_reserved" 105 "AIParkngReq_ZXD_105_AIParkngReq_reserved" 106 "AIParkngReq_ZXD_106_AIParkngReq_reserved" 107 "AIParkngReq_ZXD_107_AIParkngReq_reserved" 108 "AIParkngReq_ZXD_108_AIParkngReq_reserved" 109 "AIParkngReq_ZXD_109_AIParkngReq_reserved" 110 "AIParkngReq_ZXD_110_AIParkngReq_reserved" 111 "AIParkngReq_ZXD_111_AIParkngReq_reserved" 112 "AIParkngReq_ZXD_112_AIParkngReq_reserved" 113 "AIParkngReq_ZXD_113_AIParkngReq_reserved" 114 "AIParkngReq_ZXD_114_AIParkngReq_reserved" 115 "AIParkngReq_ZXD_115_AIParkngReq_reserved" 116 "AIParkngReq_ZXD_116_AIParkngReq_reserved" 117 "AIParkngReq_ZXD_117_AIParkngReq_reserved" 118 "AIParkngReq_ZXD_118_AIParkngReq_reserved" 119 "AIParkngReq_ZXD_119_AIParkngReq_reserved" 120 "AIParkngReq_ZXD_120_AIParkngReq_reserved" 121 "AIParkngReq_ZXD_121_AIParkngReq_reserved" 122 "AIParkngReq_ZXD_122_AIParkngReq_reserved" 123 "AIParkngReq_ZXD_123_AIParkngReq_reserved" 124 "AIParkngReq_ZXD_124_AIParkngReq_reserved" 125 "AIParkngReq_ZXD_125_AIParkngReq_reserved" 126 "AIParkngReq_ZXD_126_AIParkngReq_reserved" 127 "AIParkngReq_ZXD_127_AIParkngReq_reserved" 128 "AIParkngReq_ZXD_128_AIParkngReq_reserved" 129 "AIParkngReq_ZXD_129_AIParkngReq_reserved" 130 "AIParkngReq_ZXD_130_AIParkngReq_reserved" 131 "AIParkngReq_ZXD_131_AIParkngReq_reserved" 132 "AIParkngReq_ZXD_132_AIParkngReq_reserved" 133 "AIParkngReq_ZXD_133_AIParkngReq_reserved" 134 "AIParkngReq_ZXD_134_AIParkngReq_reserved" 135 "AIParkngReq_ZXD_135_AIParkngReq_reserved" 136 "AIParkngReq_ZXD_136_AIParkngReq_reserved" 137 "AIParkngReq_ZXD_137_AIParkngReq_reserved" 138 "AIParkngReq_ZXD_138_AIParkngReq_reserved" 139 "AIParkngReq_ZXD_139_AIParkngReq_reserved" 140 "AIParkngReq_ZXD_140_AIParkngReq_reserved" 141 "AIParkngReq_ZXD_141_AIParkngReq_reserved" 142 "AIParkngReq_ZXD_142_AIParkngReq_reserved" 143 "AIParkngReq_ZXD_143_AIParkngReq_reserved" 144 "AIParkngReq_ZXD_144_AIParkngReq_reserved" 145 "AIParkngReq_ZXD_145_AIParkngReq_reserved" 146 "AIParkngReq_ZXD_146_AIParkngReq_reserved" 147 "AIParkngReq_ZXD_147_AIParkngReq_reserved" 148 "AIParkngReq_ZXD_148_AIParkngReq_reserved" 149 "AIParkngReq_ZXD_149_AIParkngReq_reserved" 150 "AIParkngReq_ZXD_150_AIParkngReq_reserved" 151 "AIParkngReq_ZXD_151_AIParkngReq_reserved" 152 "AIParkngReq_ZXD_152_AIParkngReq_reserved" 153 "AIParkngReq_ZXD_153_AIParkngReq_reserved" 154 "AIParkngReq_ZXD_154_AIParkngReq_reserved" 155 "AIParkngReq_ZXD_155_AIParkngReq_reserved" 156 "AIParkngReq_ZXD_156_AIParkngReq_reserved" 157 "AIParkngReq_ZXD_157_AIParkngReq_reserved" 158 "AIParkngReq_ZXD_158_AIParkngReq_reserved" 159 "AIParkngReq_ZXD_159_AIParkngReq_reserved" 160 "AIParkngReq_ZXD_160_AIParkngReq_reserved" 161 "AIParkngReq_ZXD_161_AIParkngReq_reserved" 162 "AIParkngReq_ZXD_162_AIParkngReq_reserved" 163 "AIParkngReq_ZXD_163_AIParkngReq_reserved" 164 "AIParkngReq_ZXD_164_AIParkngReq_reserved" 165 "AIParkngReq_ZXD_165_AIParkngReq_reserved" 166 "AIParkngReq_ZXD_166_AIParkngReq_reserved" 167 "AIParkngReq_ZXD_167_AIParkngReq_reserved" 168 "AIParkngReq_ZXD_168_AIParkngReq_reserved" 169 "AIParkngReq_ZXD_169_AIParkngReq_reserved" 170 "AIParkngReq_ZXD_170_AIParkngReq_reserved" 171 "AIParkngReq_ZXD_171_AIParkngReq_reserved" 172 "AIParkngReq_ZXD_172_AIParkngReq_reserved" 173 "AIParkngReq_ZXD_173_AIParkngReq_reserved" 174 "AIParkngReq_ZXD_174_AIParkngReq_reserved" 175 "AIParkngReq_ZXD_175_AIParkngReq_reserved" 176 "AIParkngReq_ZXD_176_AIParkngReq_reserved" 177 "AIParkngReq_ZXD_177_AIParkngReq_reserved" 178 "AIParkngReq_ZXD_178_AIParkngReq_reserved" 179 "AIParkngReq_ZXD_179_AIParkngReq_reserved" 180 "AIParkngReq_ZXD_180_AIParkngReq_reserved" 181 "AIParkngReq_ZXD_181_AIParkngReq_reserved" 182 "AIParkngReq_ZXD_182_AIParkngReq_reserved" 183 "AIParkngReq_ZXD_183_AIParkngReq_reserved" 184 "AIParkngReq_ZXD_184_AIParkngReq_reserved" 185 "AIParkngReq_ZXD_185_AIParkngReq_reserved" 186 "AIParkngReq_ZXD_186_AIParkngReq_reserved" 187 "AIParkngReq_ZXD_187_AIParkngReq_reserved" 188 "AIParkngReq_ZXD_188_AIParkngReq_reserved" 189 "AIParkngReq_ZXD_189_AIParkngReq_reserved" 190 "AIParkngReq_ZXD_190_AIParkngReq_reserved" 191 "AIParkngReq_ZXD_191_AIParkngReq_reserved" 192 "AIParkngReq_ZXD_192_AIParkngReq_reserved" 193 "AIParkngReq_ZXD_193_AIParkngReq_reserved" 194 "AIParkngReq_ZXD_194_AIParkngReq_reserved" 195 "AIParkngReq_ZXD_195_AIParkngReq_reserved" 196 "AIParkngReq_ZXD_196_AIParkngReq_reserved" 197 "AIParkngReq_ZXD_197_AIParkngReq_reserved" 198 "AIParkngReq_ZXD_198_AIParkngReq_reserved" 199 "AIParkngReq_ZXD_199_AIParkngReq_reserved" 200 "AIParkngReq_ZXD_200_AIParkngReq_reserved" 201 "AIParkngReq_ZXD_201_AIParkngReq_reserved" 202 "AIParkngReq_ZXD_202_AIParkngReq_reserved" 203 "AIParkngReq_ZXD_203_AIParkngReq_reserved" 204 "AIParkngReq_ZXD_204_AIParkngReq_reserved" 205 "AIParkngReq_ZXD_205_AIParkngReq_reserved" 206 "AIParkngReq_ZXD_206_AIParkngReq_reserved" 207 "AIParkngReq_ZXD_207_AIParkngReq_reserved" 208 "AIParkngReq_ZXD_208_AIParkngReq_reserved" 209 "AIParkngReq_ZXD_209_AIParkngReq_reserved" 210 "AIParkngReq_ZXD_210_AIParkngReq_reserved" 211 "AIParkngReq_ZXD_211_AIParkngReq_reserved" 212 "AIParkngReq_ZXD_212_AIParkngReq_reserved" 213 "AIParkngReq_ZXD_213_AIParkngReq_reserved" 214 "AIParkngReq_ZXD_214_AIParkngReq_reserved" 215 "AIParkngReq_ZXD_215_AIParkngReq_reserved" 216 "AIParkngReq_ZXD_216_AIParkngReq_reserved" 217 "AIParkngReq_ZXD_217_AIParkngReq_reserved" 218 "AIParkngReq_ZXD_218_AIParkngReq_reserved" 219 "AIParkngReq_ZXD_219_AIParkngReq_reserved" 220 "AIParkngReq_ZXD_220_AIParkngReq_reserved" 221 "AIParkngReq_ZXD_221_AIParkngReq_reserved" 222 "AIParkngReq_ZXD_222_AIParkngReq_reserved" 223 "AIParkngReq_ZXD_223_AIParkngReq_reserved" 224 "AIParkngReq_ZXD_224_AIParkngReq_reserved" 225 "AIParkngReq_ZXD_225_AIParkngReq_reserved" 226 "AIParkngReq_ZXD_226_AIParkngReq_reserved" 227 "AIParkngReq_ZXD_227_AIParkngReq_reserved" 228 "AIParkngReq_ZXD_228_AIParkngReq_reserved" 229 "AIParkngReq_ZXD_229_AIParkngReq_reserved" 230 "AIParkngReq_ZXD_230_AIParkngReq_reserved" 231 "AIParkngReq_ZXD_231_AIParkngReq_reserved" 232 "AIParkngReq_ZXD_232_AIParkngReq_reserved" 233 "AIParkngReq_ZXD_233_AIParkngReq_reserved" 234 "AIParkngReq_ZXD_234_AIParkngReq_reserved" 235 "AIParkngReq_ZXD_235_AIParkngReq_reserved" 236 "AIParkngReq_ZXD_236_AIParkngReq_reserved" 237 "AIParkngReq_ZXD_237_AIParkngReq_reserved" 238 "AIParkngReq_ZXD_238_AIParkngReq_reserved" 239 "AIParkngReq_ZXD_239_AIParkngReq_reserved" 240 "AIParkngReq_ZXD_240_AIParkngReq_reserved" 241 "AIParkngReq_ZXD_241_AIParkngReq_reserved" 242 "AIParkngReq_ZXD_242_AIParkngReq_reserved" 243 "AIParkngReq_ZXD_243_AIParkngReq_reserved" 244 "AIParkngReq_ZXD_244_AIParkngReq_reserved" 245 "AIParkngReq_ZXD_245_AIParkngReq_reserved" 246 "AIParkngReq_ZXD_246_AIParkngReq_reserved" 247 "AIParkngReq_ZXD_247_AIParkngReq_reserved" 248 "AIParkngReq_ZXD_248_AIParkngReq_reserved" 249 "AIParkngReq_ZXD_249_AIParkngReq_reserved" 250 "AIParkngReq_ZXD_250_AIParkngReq_reserved" 251 "AIParkngReq_ZXD_251_AIParkngReq_reserved" 252 "AIParkngReq_ZXD_252_AIParkngReq_reserved" 253 "AIParkngReq_ZXD_253_AIParkngReq_reserved" 254 "AIParkngReq_ZXD_254_AIParkngReq_reserved" 255 "AIParkngReq_ZXD_255_AIParkngReq_reserved";
VAL_ 805 IFICMACRAirMdSwReq 0 "FICMACRAirMdSwReq_0_No_request" 1 "FICMACRAirMdSwReq_1_Short_press" 2 "FICMACRAirMdSwReq_2_Long_press";
VAL_ 805 IFICMACLAirMdSwReq 0 "FICMACLAirMdSwReq_0_No_request" 1 "FICMACLAirMdSwReq_1_Short_press" 2 "FICMACLAirMdSwReq_2_Long_press";
VAL_ 805 IFICMACIonizerReqSwReq 0 "FICMACIonizerReqSwReq_0_No_request" 1 "FICMACIonizerReqSwReq_1_Short_press" 2 "FICMACIonizerReqSwReq_2_Long_press";
VAL_ 805 IFICMACFreshSwReq 0 "FICMACFreshSwReq_0_No_request" 1 "FICMACFreshSwReq_1_Short_press" 2 "FICMACFreshSwReq_2_Long_press";
VAL_ 805 IFICMClmOnOffSwReq 0 "FICMClmOnOffSwReq_0_No_request" 1 "FICMClmOnOffSwReq_1_Short_press" 2 "FICMClmOnOffSwReq_2_Long_press" 3 "FICMClmOnOffSwReq_3_Reversed";
VAL_ 805 IFICMACSyncSwReq 0 "FICMACSyncSwReq_0_No_request" 1 "FICMACSyncSwReq_1_Short_press" 2 "FICMACSyncSwReq_2_Long_press" 3 "FICMACSyncSwReq_3_Reserved";
VAL_ 805 IFICMACRTemIncSwReq 0 "FICMACRTemIncSwReq_0_No_request" 1 "FICMACRTemIncSwReq_1_Short_press" 2 "FICMACRTemIncSwReq_2_Long_press";
VAL_ 805 IFICMACRTemDecSwReq 0 "FICMACRTemDecSwReq_0_No_request" 1 "FICMACRTemDecSwReq_1_Short_press" 2 "FICMACRTemDecSwReq_2_Long_press";
VAL_ 805 IFICMAirClnrBlwrLvlReq 0 "FICMAirClnrBlwrLvlReq_0_Blower_Off" 1 "FICMAirClnrBlwrLvlReq_1_level" 2 "FICMAirClnrBlwrLvlReq_2_level" 3 "FICMAirClnrBlwrLvlReq_3_level" 4 "FICMAirClnrBlwrLvlReq_4_level" 5 "FICMAirClnrBlwrLvlReq_5_level" 6 "FICMAirClnrBlwrLvlReq_6_level" 7 "FICMAirClnrBlwrLvlReq_7_level";
VAL_ 805 IFICMACRTemReq 0 "FICMACRTemReq_0_Lo" 30 "FICMACRTemReq_30_High" 31 "FICMACRTemReq_31_Reserved";
VAL_ 805 IAutoLaneChngVcCmd 0 "AutoLaneChngVcCmd_0_NoRequest" 1 "AutoLaneChngVcCmd_1_Right_Command_Auto_Lane_Change" 2 "AutoLaneChngVcCmd_2_Left_Command_Auto_Lane_Change" 3 "AutoLaneChngVcCmd_3_Cancel_Command_Auto_Lane_Change";
VAL_ 805 IFICMIFPACOnOffSwReq 0 "FICMIFPACOnOffSwReq_0_No_request" 1 "FICMIFPACOnOffSwReq_1_Short_press" 2 "FICMIFPACOnOffSwReq_2_Long_press";
VAL_ 805 INOAReportSetSwReq 0 "NOAReportSetSwReq_0_no_request" 1 "NOAReportSetSwReq_1_detail" 2 "NOAReportSetSwReq_2_concision" 3 "NOAReportSetSwReq_3_minimal" 4 "NOAReportSetSwReq_4_Reserved";
VAL_ 805 INarRoVslAssSwReq 0 "NarRoVslAssSwReq_0_0_No_request" 1 "NarRoVslAssSwReq_1_1_Off" 2 "NarRoVslAssSwReq_2_2_Near" 3 "NarRoVslAssSwReq_3_3_Middle" 4 "NarRoVslAssSwReq_4_4_Far";
VAL_ 805 IParkngSpdSwResp 0 "ParkngSpdSwResp_0_Default" 1 "ParkngSpdSwResp_1_Low_Speed" 2 "ParkngSpdSwResp_2_Middle_Speed" 3 "ParkngSpdSwResp_3_High_Speed";
VAL_ 805 INrwroadBwdAssSwReq 0 "NrwroadBwdAssSwReq_0_0_No_request" 1 "NrwroadBwdAssSwReq_1_1_Request_Start" 2 "NrwroadBwdAssSwReq_2_2_Request_Active" 3 "NrwroadBwdAssSwReq_3_3_Pause" 4 "NrwroadBwdAssSwReq_4_4_Continue" 5 "NrwroadBwdAssSwReq_5_5_Quit";
VAL_ 805 IAutoLaneChngSwReq 0 "AutoLaneChngSwReq_0_AutoLaneChngSwReq_0_no_request" 1 "AutoLaneChngSwReq_1_AutoLaneChngSwReq_1_off" 2 "AutoLaneChngSwReq_2_AutoLaneChngSwReq_2_lane_change_suggestion" 3 "AutoLaneChngSwReq_3_AutoLaneChngSwReq_3_AlcWithDriver" 4 "AutoLaneChngSwReq_4_AutoLaneChngSwReq_4_AlcWithoutDriver_reserved" 5 "AutoLaneChngSwReq_5_AutoLaneChngSwReq_5_Reserved" 6 "AutoLaneChngSwReq_6_AutoLaneChngSwReq_6_Reserved" 7 "AutoLaneChngSwReq_7_AutoLaneChngSwReq_7_Reserved";
VAL_ 805 IESSAdoWrnngReq 0 "ESSAdoWrnngReq_0_no_request" 1 "ESSAdoWrnngReq_1_off" 2 "ESSAdoWrnngReq_2_on";
VAL_ 805 IAutoLaneChngSetReq 0 "AutoLaneChngSetReq_0_NoRequest" 1 "AutoLaneChngSetReq_1_Level1" 2 "AutoLaneChngSetReq_2_Level2" 3 "AutoLaneChngSetReq_3_Level3";
VAL_ 805 IAPAOneKeyParkSwReq 0 "APAOneKeyParkSwReq_0_no_request" 1 "APAOneKeyParkSwReq_1_Off" 2 "APAOneKeyParkSwReq_2_On";
VAL_ 805 INarRoVslAssQuit 0 "NarRoVslAssQuit_0_NoRequest" 1 "NarRoVslAssQuit_1_Quit";
VAL_ 805 ILCRSwReq 0 "LCRSwReq_0_NoRequest" 1 "LCRSwReq_1_off" 2 "LCRSwReq_2_on" 3 "LCRSwReq_3_reserved";
VAL_ 805 IFrtCarGoNotfrSwReq 0 "FrtCarGoNotfrSwReq_0_No_request" 1 "FrtCarGoNotfrSwReq_1_Off" 2 "FrtCarGoNotfrSwReq_2_On" 3 "FrtCarGoNotfrSwReq_3_Reserved";
VAL_ 805 IESSswReq 0 "ESSSwReq_0_NoRequest" 1 "ESSSwReq_1_off" 2 "ESSSwReq_2_on" 3 "AESSwDspCmd_3_On";
VAL_ 805 INOPSwReq 0 "NOPSwReq_0_NoRequest" 1 "NOPSwReq_1_off" 2 "NOPSwReq_2_on" 3 "NOPSwReq_3_reserved";
VAL_ 805 INOPCitySwReq 0 "NOPCitySwReq_0_NoRequest" 1 "NOPCitySwReq_1_Off" 2 "NOPCitySwReq_2_On" 3 "NOPCitySwReq_3_Reserved";
VAL_ 805 INOALaneSetSwReq 0 "NOALaneSetSwReq_0_No_request" 1 "NOALaneSetSwReq_1_Left1" 2 "NOALaneSetSwReq_2_Left2" 3 "NOALaneSetSwReq_3_Reserved";
VAL_ 805 INOAETCSetSwReq 0 "NOAETCSetSwReq_0_NoRequest" 1 "NOAETCSetSwReq_1_MTC" 2 "NOAETCSetSwReq_2_ETC" 3 "NOAETCSetSwReq_3_Reserved";
VAL_ 805 IWlcmLghtReq 0 "WlcmLghtReq_0_false" 1 "WlcmLghtReq_1_true";
VAL_ 805 ID2DSwReq 0 "D2DSwReq_0_no_request" 1 "D2DSwReq_1_off" 2 "D2DSwReq_2_on" 3 "D2DSwReq_3_reserved";
VAL_ 805 IPEBSwReq 0 "PEBSwReq_0_No_Request" 1 "PEBSwReq_1_Request";
VAL_ 805 IParkngDirSw 0 "ParkngDirSw_0_No_Request" 1 "ParkngDirSw_1_Front_parking_in" 2 "ParkngDirSw_2_back_parking_in" 3 "ParkngDirSw_3_Reserved";
VAL_ 805 INrwroadBwdAssConfrmSwReq 0 "NrwroadBwdAssConfrmSwReq_0_0_No_request" 1 "NrwroadBwdAssConfrmSwReq_1_1_Active_request" 2 "NrwroadBwdAssConfrmSwReq_2_2_quit_request";
VAL_ 805 IFrwlLghtReq 0 "FrwlLghtReq_0_false" 1 "FrwlLghtReq_1_true";
VAL_ 805 IFollowMeHomeReq 0 "FollowMeHomeReq_0_false" 1 "FollowMeHomeReq_1_true";
VAL_ 805 IFVCMPowerFailSwReq 0 "FVCMPowerFailSwReq_0_NoRequest" 1 "FVCMPowerFailSwReq_1_off" 2 "FVCMPowerFailSwReq_2_on" 3 "FVCMPowerFailSwReq_3_LowPwrMd";
VAL_ 805 ID2DPriETClanSwReq 0 "D2DPriETClanSwReq_0_no_request" 1 "D2DPriETClanSwReq_1_off" 2 "D2DPriETClanSwReq_2_on" 3 "D2DPriETClanSwReq_3_reserved";
VAL_ 805 ISLIFWrnngMdReq 0 "SLIFWrnngMdReq_0__NoRequest" 1 "SLIFWrnngMdReq_1__Off" 2 "SLIFWrnngMdReq_2__Visual" 3 "SLIFWrnngMdReq_3__Audible";
VAL_ 805 IAIParkngEPAMdsw 0 "AIParkngEPAMdsw_0_Lockmode" 1 "AIParkngEPAMdsw_1_Simplemode";
VAL_ 534 ISWSPB3SwStuckL 0 "SWSPB3SwStuckL_l_0_No_Stuck" 1 "SWSPB3SwStuckL_l_1_Stuck";
VAL_ 534 ISWSSelRSwStuckL 0 "SWSSelRSwStuckL_l_0_No_Stuck" 1 "SWSSelRSwStuckL_l_1_Stuck";
VAL_ 534 ISWSSelLSwStuckL 0 "SWSSelLSwStuckL_l_0_No_Stuck" 1 "SWSSelLSwStuckL_l_1_Stuck";
VAL_ 534 ISWSPB2SwStuckL 0 "SWSPB2SwStuckL_l_0_No_Stuck" 1 "SWSPB2SwStuckL_l_1_Stuck";
VAL_ 534 ISWSCnfmSwStuckL 0 "SWSCnfmSwStuckL_l_0_No_Stuck" 1 "SWSCnfmSwStuckL_l_1_Stuck";
VAL_ 534 ISWSPB1SwStuckL 0 "SWSPB1SwStuckL_l_0_No_Stuck" 1 "SWSPB1SwStuckL_l_1_Stuck";
VAL_ 534 IDMSSts 0 "DMSSts_0_Off" 1 "DMSSts_1_Standby" 2 "DMSSts_2_Active" 3 "DMSSts_3_Camera_Blocked" 4 "DMSSts_4_System_temporary_unavailable" 5 "DMSSts_5_Service_required" 6 "DMSSts_6_Initialization" 7 "DMSSts_7_Performance_Degradation";
VAL_ 534 ISWSSelLSwAL 0 "SWSSelLSwAL_l_0_Idle" 1 "SWSSelLSwAL_l_1_Press" 2 "SWSSelLSwAL_l_2_Reserved" 3 "SWSSelLSwAL_l_3_Error";
VAL_ 534 ISWSSelDwnSwAL 0 "SWSSelDwnSwAL_l_0_Idle" 1 "SWSSelDwnSwAL_l_1_Press" 2 "SWSSelDwnSwAL_l_2_Reserved" 3 "SWSSelDwnSwAL_l_3_Error";
VAL_ 534 ISWSSelUpSwAL 0 "SWSSelUpSwAL_l_0_Idle" 1 "SWSSelUpSwAL_l_1_Press" 2 "SWSSelUpSwAL_l_2_Reserved" 3 "SWSSelUpSwAL_l_3_Error";
VAL_ 534 ISWSPB2SwAL 0 "SWSPB2SwAL_l_0_Idle" 1 "SWSPB2SwAL_l_1_Press" 2 "SWSPB2SwAL_l_2_Reserved" 3 "SWSPB2SwAL_l_3_Error";
VAL_ 534 ISWSPB1SwAL 0 "SWSPB1SwAL_l_0_Idle" 1 "SWSPB1SwAL_l_1_Press" 2 "SWSPB1SwAL_l_2_Reserved" 3 "SWSPB1SwAL_l_3_Error";
VAL_ 534 ISWSCnfmSwAL 0 "SWSCnfmSwAL_l_0_Idle" 1 "SWSCnfmSwAL_l_1_Press" 2 "SWSCnfmSwAL_l_2_Reserved" 3 "SWSCnfmSwAL_l_3_Error";
VAL_ 534 ISWSSelRSwAL 0 "SWSSelRSwAL_l_0_Idle" 1 "SWSSelRSwAL_l_1_Press" 2 "SWSSelRSwAL_l_2_Reserved" 3 "SWSSelRSwAL_l_3_Error";
VAL_ 534 IRoughRoaddetection 0 "RoughRoaddetection_0_NotDetected" 1 "RoughRoaddetection_1_Detected";
VAL_ 534 ISWSPB3SwAL 0 "SWSPB3SwAL_l_0_Idle" 1 "SWSPB3SwAL_l_1_Press" 2 "SWSPB3SwAL_l_2_Reserved" 3 "SWSPB3SwAL_l_3_Error";
VAL_ 711 ISCFRemSwReq 0 "SCFRemSwReq_0_NoRequest" 1 "SCFRemSwReq_1_off" 2 "SCFRemSwReq_2_on" 3 "SCFRemSwReq_3_Reserved";
VAL_ 711 ISCFSwReq 0 "SCFSwReq_0_NoRequest" 1 "SCFSwReq_1_off" 2 "SCFSwReq_2_on" 3 "SCFSwReq_3_Reserved";
VAL_ 711 IICMtoIPDScrnRespC 0 "ICMtoIPDScrnRespC_0_FALSE" 1 "ICMtoIPDScrnRespC_1_TRUE" 2 "ICMtoIPDScrnRespC_2_reserved" 3 "ICMtoIPDScrnRespC_3_reserved";
VAL_ 711 IMemParkngBtnRcnmCfm 0 "MemParkngBtnRcnmCfm_0_NoRequest" 1 "MemParkngBtnRcnmCfm_1_Reject" 2 "MemParkngBtnRcnmCfm_2_SavePath" 3 "MemParkngBtnRcnmCfm_3_Reserved";
VAL_ 711 ISLWFWarSwReq 0 "SLWFWarSwReq_0_NoRequest" 1 "SLWFWarSwReq_1_off" 2 "SLWFWarSwReq_2_on" 3 "SLWFWarSwReq_3_Reserved";
VAL_ 711 ISLWFSwReq 0 "SLWFSwReq_0_NoRequest" 1 "SLWFSwReq_1_off" 2 "SLWFSwReq_2_on" 3 "SLWFSwReq_3_Reserved";
VAL_ 711 ISpdLmtCotNatReq 1 "SpdLmtCotNatReq_1__1" 2 "SpdLmtCotNatReq_2__2" 3 "SpdLmtCotNatReq_3__3" 4 "SpdLmtCotNatReq_4__4" 5 "SpdLmtCotNatReq_5__5" 6 "SpdLmtCotNatReq_6__6" 7 "SpdLmtCotNatReq_7__7" 8 "SpdLmtCotNatReq_8__8" 9 "SpdLmtCotNatReq_9__9" 10 "SpdLmtCotNatReq_10__10" 11 "SpdLmtCotNatReq_11__11" 12 "SpdLmtCotNatReq_12__12" 13 "SpdLmtCotNatReq_13__13" 14 "SpdLmtCotNatReq_14__14" 15 "SpdLmtCotNatReq_15__15" 16 "SpdLmtCotNatReq_16__16" 17 "SpdLmtCotNatReq_17__17" 18 "SpdLmtCotNatReq_18__18" 19 "SpdLmtCotNatReq_19__19" 20 "SpdLmtCotNatReq_20__20" 21 "SpdLmtCotNatReq_21__21" 22 "SpdLmtCotNatReq_22__22" 23 "SpdLmtCotNatReq_23__23" 24 "SpdLmtCotNatReq_24__24" 25 "SpdLmtCotNatReq_25__25" 26 "SpdLmtCotNatReq_26__26" 27 "SpdLmtCotNatReq_27__27" 28 "SpdLmtCotNatReq_28__28" 29 "SpdLmtCotNatReq_29__29" 30 "SpdLmtCotNatReq_30__30" 31 "SpdLmtCotNatReq_31__31" 32 "SpdLmtCotNatReq_32__32" 33 "SpdLmtCotNatReq_33__33" 34 "SpdLmtCotNatReq_34__34" 35 "SpdLmtCotNatReq_35__35" 36 "SpdLmtCotNatReq_36__36" 37 "SpdLmtCotNatReq_37__37" 38 "SpdLmtCotNatReq_38__38" 39 "SpdLmtCotNatReq_39__39" 40 "SpdLmtCotNatReq_40__40" 41 "SpdLmtCotNatReq_41__41" 42 "SpdLmtCotNatReq_42__42" 43 "SpdLmtCotNatReq_43__43" 44 "SpdLmtCotNatReq_44__44" 45 "SpdLmtCotNatReq_45__45" 46 "SpdLmtCotNatReq_46__46" 47 "SpdLmtCotNatReq_47__47" 48 "SpdLmtCotNatReq_48__48" 49 "SpdLmtCotNatReq_49__49" 50 "SpdLmtCotNatReq_50__50" 51 "SpdLmtCotNatReq_51__51" 52 "SpdLmtCotNatReq_52__52" 53 "SpdLmtCotNatReq_53__53" 54 "SpdLmtCotNatReq_54__54" 55 "SpdLmtCotNatReq_55__55" 56 "SpdLmtCotNatReq_56__56" 57 "SpdLmtCotNatReq_57__57" 58 "SpdLmtCotNatReq_58__58" 59 "SpdLmtCotNatReq_59__59" 60 "SpdLmtCotNatReq_60__60" 61 "SpdLmtCotNatReq_61__61" 62 "SpdLmtCotNatReq_62__62" 63 "SpdLmtCotNatReq_63__63" 64 "SpdLmtCotNatReq_64__64" 65 "SpdLmtCotNatReq_65__65" 66 "SpdLmtCotNatReq_66__66" 67 "SpdLmtCotNatReq_67__67" 68 "SpdLmtCotNatReq_68__68" 69 "SpdLmtCotNatReq_69__69" 70 "SpdLmtCotNatReq_70__70" 71 "SpdLmtCotNatReq_71__71" 72 "SpdLmtCotNatReq_72__72" 73 "SpdLmtCotNatReq_73__73" 74 "SpdLmtCotNatReq_74__74" 75 "SpdLmtCotNatReq_75__75" 76 "SpdLmtCotNatReq_76__76" 77 "SpdLmtCotNatReq_77__77" 78 "SpdLmtCotNatReq_78__78" 79 "SpdLmtCotNatReq_79__79" 80 "SpdLmtCotNatReq_80__80" 81 "SpdLmtCotNatReq_81__81" 82 "SpdLmtCotNatReq_82__82" 83 "SpdLmtCotNatReq_83__83" 84 "SpdLmtCotNatReq_84__84" 85 "SpdLmtCotNatReq_85__85" 86 "SpdLmtCotNatReq_86__86" 87 "SpdLmtCotNatReq_87__87" 88 "SpdLmtCotNatReq_88__88" 89 "SpdLmtCotNatReq_89__89" 90 "SpdLmtCotNatReq_90__90" 91 "SpdLmtCotNatReq_91__91" 92 "SpdLmtCotNatReq_92__92" 93 "SpdLmtCotNatReq_93__93" 94 "SpdLmtCotNatReq_94__94" 95 "SpdLmtCotNatReq_95__95" 96 "SpdLmtCotNatReq_96__96" 97 "SpdLmtCotNatReq_97__97" 98 "SpdLmtCotNatReq_98__98" 99 "SpdLmtCotNatReq_99__99" 100 "SpdLmtCotNatReq_100__100" 101 "SpdLmtCotNatReq_101__101" 102 "SpdLmtCotNatReq_102__102";
VAL_ 711 IICMtoIPDScrnRespA1 0 "ICMtoIPDScrnRespA1_0_FALSE" 1 "ICMtoIPDScrnRespA1_1_TRUE" 2 "ICMtoIPDScrnRespA1_2_reserved" 3 "ICMtoIPDScrnRespA1_3_reserved";
VAL_ 711 IOrderLaneChgeReq 0 "OrderLaneChgeReq_0_NoRequest" 1 "OrderLaneChgeReq_1__Off" 2 "OrderLaneChgeReq_2__ON" 3 "OrderLaneChgeReq_3_Reserved" 4 "OrderLaneChgeReq_4_Reserved" 5 "OrderLaneChgeReq_5_Reserved" 6 "OrderLaneChgeReq_6_Reserved" 7 "OrderLaneChgeReq_7_Reserved";
VAL_ 711 ISpdLmtCotMdlReq 0 "SpdLmtCotMdlReq_0_AIPilotSwReq_0_NoRequest" 1 "SpdLmtCotMdlReq_1__Off" 2 "SpdLmtCotMdlReq_2__SLIF" 3 "SpdLmtCotMdlReq_3__ISA" 4 "SpdLmtCotMdlReq_4_Reserved" 5 "SpdLmtCotMdlReq_5_Reserved" 6 "SpdLmtCotMdlReq_6_Reserved" 7 "SpdLmtCotMdlReq_7_Reserved";
VAL_ 711 IAIParkingSoundResp 0 "AIParkingSoundResp_0_FALSE" 1 "AIParkingSoundResp_1_TRUE" 2 "AIParkingSoundResp_2_reserved" 3 "AIParkingSoundResp_3_reserved";
VAL_ 711 IACCSLIFMsgReq 0 "ACCSLIFMsgReq_0_Unavailable" 1 "ACCSLIFMsgReq_1_Off" 2 "ACCSLIFMsgReq_2_ON" 3 "ACCSLIFMsgReq_3_Hide" 4 "ACCSLIFMsgReq_4_Reserved" 5 "ACCSLIFMsgReq_5_Reserved" 6 "ACCSLIFMsgReq_6_Reserved" 7 "ACCSLIFMsgReq_7_Reserved";
VAL_ 711 IAESSwReq 0 "AESSwReq_0_NoRequest" 1 "AESSwReq_1_off" 2 "AESSwReq_2_on" 3 "AESSwReq_3_Reserved";
VAL_ 711 IRCWPedWrnngSwReq 0 "RCWPedWrnngSwReq_0_no_request" 1 "RCWPedWrnngSwReq_1_ON_request" 2 "RCWPedWrnngSwReq_2_OFF_request" 3 "RCWPedWrnngSwReq_3_Reserved" 4 "RCWPedWrnngSwReq_4_Reserved" 5 "RCWPedWrnngSwReq_5_Reserved" 6 "RCWPedWrnngSwReq_6_Reserved" 7 "RCWPedWrnngSwReq_7_Reserved";
VAL_ 711 ISpedRegulaModSwReq 0 "SpedRegulaModSwReq_0_no_request" 1 "SpedRegulaModSwReq_1_ON_request" 2 "SpedRegulaModSwReq_2_OFF_request" 3 "SpedRegulaModSwReq_3_Reserved" 4 "SpedRegulaModSwReq_4_Reserved" 5 "SpedRegulaModSwReq_5_Reserved" 6 "SpedRegulaModSwReq_6_Reserved" 7 "SpedRegulaModSwReq_7_Reserved";
VAL_ 711 ISpedRegulaPerReq 0 "SpedRegulaPerReq_0_0" 1 "SpedRegulaPerReq_1_5" 2 "SpedRegulaPerReq_2_10" 3 "SpedRegulaPerReq_3_15" 4 "SpedRegulaPerReq_4_20" 5 "SpedRegulaPerReq_5_25" 6 "SpedRegulaPerReq_6_30" 7 "SpedRegulaPerReq_7_35" 8 "SpedRegulaPerReq_8_Reserved" 9 "SpedRegulaPerReq_9__35" 10 "SpedRegulaPerReq_10__30" 11 "SpedRegulaPerReq_11__25" 12 "SpedRegulaPerReq_12__20" 13 "SpedRegulaPerReq_13__15" 14 "SpedRegulaPerReq_14__10" 15 "SpedRegulaPerReq_15__5";
VAL_ 711 ISpedRegulaFixeReq 0 "SpedRegulaFixeReq_0_0" 1 "SpedRegulaFixeReq_1_5" 2 "SpedRegulaFixeReq_2_10" 3 "SpedRegulaFixeReq_3_15" 4 "SpedRegulaFixeReq_4_20" 5 "SpedRegulaFixeReq_5_25" 6 "SpedRegulaFixeReq_6_30" 7 "SpedRegulaFixeReq_7_35" 8 "SpedRegulaFixeReq_8_Reserved" 9 "SpedRegulaFixeReq_9__35" 10 "SpedRegulaFixeReq_10__30" 11 "SpedRegulaFixeReq_11__25" 12 "SpedRegulaFixeReq_12__20" 13 "SpedRegulaFixeReq_13__15" 14 "SpedRegulaFixeReq_14__10" 15 "SpedRegulaFixeReq_15__5";
VAL_ 711 IIPDtoICMScrnRespA2 0 "IPDtoICMScrnRespA2_0_FALSE" 1 "IPDtoICMScrnRespA2_1__TRUE" 2 "IPDtoICMScrnRespA2_2_reserved" 3 "IPDtoICMScrnRespA2_3_reserved";
VAL_ 711 IRCWRearCollisionWrnngSwReq 0 "RCWRearCollisionWrnngSwReq_0_no_request" 1 "RCWRearCollisionWrnngSwReq_1_ON_request" 2 "RCWRearCollisionWrnngSwReq_2_OFF_request" 3 "RCWRearCollisionWrnngSwReq_3_Reserved" 4 "RCWRearCollisionWrnngSwReq_4_Reserved" 5 "RCWRearCollisionWrnngSwReq_5_Reserved" 6 "RCWRearCollisionWrnngSwReq_6_Reserved" 7 "RCWRearCollisionWrnngSwReq_7_Reserved";
VAL_ 711 IMemParkingReserveICM1 0 "MemParkingReserveICM1_0_1" 1 "MemParkingReserveICM1_1_2" 2 "MemParkingReserveICM1_2_3" 3 "MemParkingReserveICM1_3_4";
VAL_ 711 INOAE2ESwReq 0 "NOAE2ESwReq_0_no_request" 1 "NOAE2ESwReq_1_ON_request" 2 "NOAE2ESwReq_2_OFF_request" 3 "NOAE2ESwReq_3_Reserved" 4 "NOAE2ESwReq_4_Reserved" 5 "NOAE2ESwReq_5_Reserved" 6 "NOAE2ESwReq_6_Reserved" 7 "NOAE2ESwReq_7_Reserved";
VAL_ 711 IIPDCoDrivingPlusSwReq 0 "IPDCoDrivingPlusSwReq_0_no_request" 1 "IPDCoDrivingPlusSwReq_1_ON_request" 2 "IPDCoDrivingPlusSwReq_2_OFF_request" 3 "IPDCoDrivingPlusSwReq_3_Reserved" 4 "IPDCoDrivingPlusSwReq_4_Reserved" 5 "IPDCoDrivingPlusSwReq_5_Reserved" 6 "IPDCoDrivingPlusSwReq_6_Reserved" 7 "IPDCoDrivingPlusSwReq_7_Reserved";
VAL_ 711 IMemParkingReserveICM2 0 "MemParkingReserveICM2_0_1" 1 "MemParkingReserveICM2_1_2" 2 "MemParkingReserveICM2_2_3" 3 "MemParkingReserveICM2_3_4";
VAL_ 711 IMemoryDrvSwReq 0 "MemoryDrvSwReq_0_no_request" 1 "MemoryDrvSwReq_1_ON_request" 2 "MemoryDrvSwReq_2_OFF_request" 3 "MemoryDrvSwReq_3_Reserved" 4 "MemoryDrvSwReq_4_Reserved" 5 "MemoryDrvSwReq_5_Reserved" 6 "MemoryDrvSwReq_6_Reserved" 7 "MemoryDrvSwReq_7_Reserved";
VAL_ 711 IPilotE2ESwReq 0 "PilotE2ESwReq_0_no_request" 1 "PilotE2ESwReq_1_ON_request" 2 "PilotE2ESwReq_2_OFF_request" 3 "PilotE2ESwReq_3_Reserved" 4 "PilotE2ESwReq_4_Reserved" 5 "PilotE2ESwReq_5_Reserved" 6 "PilotE2ESwReq_6_Reserved" 7 "PilotE2ESwReq_7_Reserved";
VAL_ 711 IMemParkingReserveICM3 0 "MemParkingReserveICM3_0_1" 1 "MemParkingReserveICM3_1_2" 2 "MemParkingReserveICM3_2_3" 3 "MemParkingReserveICM3_3_4";
VAL_ 711 IMemoryRouteSaveCancelReq 0 "MemoryRouteSaveCancelReq_0__0" 1 "MemoryRouteSaveCancelReq_1__1" 2 "MemoryRouteSaveCancelReq_2__2" 3 "MemoryRouteSaveCancelReq_3_Reserved" 4 "MemoryRouteSaveCancelReq_4_Reserved" 5 "MemoryRouteSaveCancelReq_5_Reserved" 6 "MemoryRouteSaveCancelReq_6_Reserved" 7 "MemoryRouteSaveCancelReq_7_Reserved";
VAL_ 711 IMemoryDrvSetSwReq 0 "MemoryDrvSetSwReq_0_no_request" 1 "MemoryDrvSetSwReq_1_ON_request" 2 "MemoryDrvSetSwReq_2_OFF_request" 3 "MemoryDrvSetSwReq_3_Reserved" 4 "MemoryDrvSetSwReq_4_Reserved" 5 "MemoryDrvSetSwReq_5_Reserved" 6 "MemoryDrvSetSwReq_6_Reserved" 7 "MemoryDrvSetSwReq_7_Reserved";
VAL_ 711 INOAE2ESetSeReq 0 "NOAE2ESetSeReq_0_no_request" 1 "NOAE2ESetSeReq_1_ON_request" 2 "NOAE2ESetSeReq_2_OFF_request" 3 "NOAE2ESetSeReq_3_Reserved" 4 "NOAE2ESetSeReq_4_Reserved" 5 "NOAE2ESetSeReq_5_Reserved" 6 "NOAE2ESetSeReq_6_Reserved" 7 "NOAE2ESetSeReq_7_Reserved";
VAL_ 711 INOAE2ESetReq 0 "NOAE2ESetReq_0_no_request" 1 "NOAE2ESetReq_1_ON_request" 2 "NOAE2ESetReq_2_OFF_request" 3 "NOAE2ESetReq_3_Reserved" 4 "NOAE2ESetReq_4_Reserved" 5 "NOAE2ESetReq_5_Reserved" 6 "NOAE2ESetReq_6_Reserved" 7 "NOAE2ESetReq_7_Reserved";
VAL_ 711 IPilotE2ESetSeReq 0 "PilotE2ESetSeReq_0_no_request" 1 "PilotE2ESetSeReq_1_ON_request" 2 "PilotE2ESetSeReq_2_OFF_request" 3 "PilotE2ESetSeReq_3_Reserved" 4 "PilotE2ESetSeReq_4_Reserved" 5 "PilotE2ESetSeReq_5_Reserved" 6 "PilotE2ESetSeReq_6_Reserved" 7 "PilotE2ESetSeReq_7_Reserved";
VAL_ 711 IPilotE2ESetReq 0 "PilotE2ESetReq_0_no_request" 1 "PilotE2ESetReq_1_ON_request" 2 "PilotE2ESetReq_2_OFF_request" 3 "PilotE2ESetReq_3_Reserved" 4 "PilotE2ESetReq_4_Reserved" 5 "PilotE2ESetReq_5_Reserved" 6 "PilotE2ESetReq_6_Reserved" 7 "PilotE2ESetReq_7_Reserved";
VAL_ 711 IMemParkingReserveICM6 0 "MemParkingReserveICM6_0_1" 1 "MemParkingReserveICM6_1_2" 2 "MemParkingReserveICM6_2_3" 3 "MemParkingReserveICM6_3_4" 4 "MemParkingReserveICM6_4_5" 5 "MemParkingReserveICM6_5_6" 6 "MemParkingReserveICM6_6_7" 7 "MemParkingReserveICM6_7_8" 8 "MemParkingReserveICM6_8_9" 9 "MemParkingReserveICM6_9_10" 10 "MemParkingReserveICM6_10_11" 11 "MemParkingReserveICM6_11_12" 12 "MemParkingReserveICM6_12_13" 13 "MemParkingReserveICM6_13_14" 14 "MemParkingReserveICM6_14_15" 15 "MemParkingReserveICM6_15_16";
VAL_ 711 IMemParkingReserveICM5 0 "MemParkingReserveICM5_0_1" 1 "MemParkingReserveICM5_1_2" 2 "MemParkingReserveICM5_2_3" 3 "MemParkingReserveICM5_3_4" 4 "MemParkingReserveICM5_4_5" 5 "MemParkingReserveICM5_5_6" 6 "MemParkingReserveICM5_6_7" 7 "MemParkingReserveICM5_7_8" 8 "MemParkingReserveICM5_8_9" 9 "MemParkingReserveICM5_9_10" 10 "MemParkingReserveICM5_10_11" 11 "MemParkingReserveICM5_11_12" 12 "MemParkingReserveICM5_12_13" 13 "MemParkingReserveICM5_13_14" 14 "MemParkingReserveICM5_14_15" 15 "MemParkingReserveICM5_15_16";
VAL_ 711 IMemParkingReserveICM4 0 "MemParkingReserveICM4_0_1" 1 "MemParkingReserveICM4_1_2" 2 "MemParkingReserveICM4_2_3" 3 "MemParkingReserveICM4_3_4" 4 "MemParkingReserveICM4_4_5" 5 "MemParkingReserveICM4_5_6" 6 "MemParkingReserveICM4_6_7" 7 "MemParkingReserveICM4_7_8" 8 "MemParkingReserveICM4_8_9" 9 "MemParkingReserveICM4_9_10" 10 "MemParkingReserveICM4_10_11" 11 "MemParkingReserveICM4_11_12" 12 "MemParkingReserveICM4_12_13" 13 "MemParkingReserveICM4_13_14" 14 "MemParkingReserveICM4_14_15" 15 "MemParkingReserveICM4_15_16";
VAL_ 707 IICMSwReq_Reserve11 0 "ICMSwReq_Reserve11_0_Reserved" 1 "ICMSwReq_Reserve11_1_Reserved" 2 "ICMSwReq_Reserve11_2_Reserved" 3 "ICMSwReq_Reserve11_3_Reserved";
VAL_ 707 IICMSwReq_Reserve02 0 "ICMSwReq_Reserve02_0_Reserved" 1 "ICMSwReq_Reserve02_1_Reserved" 2 "ICMSwReq_Reserve02_2_Reserved" 3 "ICMSwReq_Reserve02_3_Reserved" 4 "ICMSwReq_Reserve02_4_Reserved" 5 "ICMSwReq_Reserve02_5_Reserved" 6 "ICMSwReq_Reserve02_6_Reserved" 7 "ICMSwReq_Reserve02_7_Reserved";
VAL_ 707 IICMSwReq_Reserve01 0 "ICMSwReq_Reserve01_0_Reserved" 1 "ICMSwReq_Reserve01_1_Reserved" 2 "ICMSwReq_Reserve01_2_Reserved" 3 "ICMSwReq_Reserve01_3_Reserved" 4 "ICMSwReq_Reserve01_4_Reserved" 5 "ICMSwReq_Reserve01_5_Reserved" 6 "ICMSwReq_Reserve01_6_Reserved" 7 "ICMSwReq_Reserve01_7_Reserved";
VAL_ 707 IICMSwReq_Reserve12 0 "ICMSwReq_Reserve12_0_Reserved" 1 "ICMSwReq_Reserve12_1_Reserved" 2 "ICMSwReq_Reserve12_2_Reserved" 3 "ICMSwReq_Reserve12_3_Reserved";
VAL_ 707 IICMSwReq_Reserve04 0 "ICMSwReq_Reserve04_0_Reserved" 1 "ICMSwReq_Reserve04_1_Reserved" 2 "ICMSwReq_Reserve04_2_Reserved" 3 "ICMSwReq_Reserve04_3_Reserved" 4 "ICMSwReq_Reserve04_4_Reserved" 5 "ICMSwReq_Reserve04_5_Reserved" 6 "ICMSwReq_Reserve04_6_Reserved" 7 "ICMSwReq_Reserve04_7_Reserved";
VAL_ 707 IICMSwReq_Reserve03 0 "ICMSwReq_Reserve03_0_Reserved" 1 "ICMSwReq_Reserve03_1_Reserved" 2 "ICMSwReq_Reserve03_2_Reserved" 3 "ICMSwReq_Reserve03_3_Reserved" 4 "ICMSwReq_Reserve03_4_Reserved" 5 "ICMSwReq_Reserve03_5_Reserved" 6 "ICMSwReq_Reserve03_6_Reserved" 7 "ICMSwReq_Reserve03_7_Reserved";
VAL_ 707 IICMSwReq_Reserve13 0 "ICMSwReq_Reserve13_0_Reserved" 1 "ICMSwReq_Reserve13_1_Reserved" 2 "ICMSwReq_Reserve13_2_Reserved" 3 "ICMSwReq_Reserve13_3_Reserved";
VAL_ 707 IICMSwReq_Reserve06 0 "ICMSwReq_Reserve06_0_Reserved" 1 "ICMSwReq_Reserve06_1_Reserved" 2 "ICMSwReq_Reserve06_2_Reserved" 3 "ICMSwReq_Reserve06_3_Reserved" 4 "ICMSwReq_Reserve06_4_Reserved" 5 "ICMSwReq_Reserve06_5_Reserved" 6 "ICMSwReq_Reserve06_6_Reserved" 7 "ICMSwReq_Reserve06_7_Reserved";
VAL_ 707 IICMSwReq_Reserve05 0 "ICMSwReq_Reserve05_0_Reserved" 1 "ICMSwReq_Reserve05_1_Reserved" 2 "ICMSwReq_Reserve05_2_Reserved" 3 "ICMSwReq_Reserve05_3_Reserved" 4 "ICMSwReq_Reserve05_4_Reserved" 5 "ICMSwReq_Reserve05_5_Reserved" 6 "ICMSwReq_Reserve05_6_Reserved" 7 "ICMSwReq_Reserve05_7_Reserved";
VAL_ 707 IICMSwReq_Reserve14 0 "ICMSwReq_Reserve14_0_Reserved" 1 "ICMSwReq_Reserve14_1_Reserved" 2 "ICMSwReq_Reserve14_2_Reserved" 3 "ICMSwReq_Reserve14_3_Reserved";
VAL_ 707 IICMSwReq_Reserve08 0 "ICMSwReq_Reserve08_0_Reserved" 1 "ICMSwReq_Reserve08_1_Reserved" 2 "ICMSwReq_Reserve08_2_Reserved" 3 "ICMSwReq_Reserve08_3_Reserved" 4 "ICMSwReq_Reserve08_4_Reserved" 5 "ICMSwReq_Reserve08_5_Reserved" 6 "ICMSwReq_Reserve08_6_Reserved" 7 "ICMSwReq_Reserve08_7_Reserved";
VAL_ 707 IICMSwReq_Reserve07 0 "ICMSwReq_Reserve07_0_Reserved" 1 "ICMSwReq_Reserve07_1_Reserved" 2 "ICMSwReq_Reserve07_2_Reserved" 3 "ICMSwReq_Reserve07_3_Reserved" 4 "ICMSwReq_Reserve07_4_Reserved" 5 "ICMSwReq_Reserve07_5_Reserved" 6 "ICMSwReq_Reserve07_6_Reserved" 7 "ICMSwReq_Reserve07_7_Reserved";
VAL_ 707 IICMSwReq_Reserve15 0 "ICMSwReq_Reserve15_0_Reserved" 1 "ICMSwReq_Reserve15_1_Reserved" 2 "ICMSwReq_Reserve15_2_Reserved" 3 "ICMSwReq_Reserve15_3_Reserved";
VAL_ 707 IICMSwReq_Reserve10 0 "ICMSwReq_Reserve10_0_Reserved" 1 "ICMSwReq_Reserve10_1_Reserved" 2 "ICMSwReq_Reserve10_2_Reserved" 3 "ICMSwReq_Reserve10_3_Reserved" 4 "ICMSwReq_Reserve10_4_Reserved" 5 "ICMSwReq_Reserve10_5_Reserved" 6 "ICMSwReq_Reserve10_6_Reserved" 7 "ICMSwReq_Reserve10_7_Reserved";
VAL_ 707 IICMSwReq_Reserve09 0 "ICMSwReq_Reserve09_0_Reserved" 1 "ICMSwReq_Reserve09_1_Reserved" 2 "ICMSwReq_Reserve09_2_Reserved" 3 "ICMSwReq_Reserve09_3_Reserved" 4 "ICMSwReq_Reserve09_4_Reserved" 5 "ICMSwReq_Reserve09_5_Reserved" 6 "ICMSwReq_Reserve09_6_Reserved" 7 "ICMSwReq_Reserve09_7_Reserved";
VAL_ 707 IICMSwReq_Reserve19 0 "ICMSwReq_Reserve19_0_Reserved" 1 "ICMSwReq_Reserve19_1_Reserved" 2 "ICMSwReq_Reserve19_2_Reserved" 3 "ICMSwReq_Reserve19_3_Reserved";
VAL_ 707 IICMSwReq_Reserve18 0 "ICMSwReq_Reserve18_0_Reserved" 1 "ICMSwReq_Reserve18_1_Reserved" 2 "ICMSwReq_Reserve18_2_Reserved" 3 "ICMSwReq_Reserve18_3_Reserved";
VAL_ 707 IICMSwReq_Reserve17 0 "ICMSwReq_Reserve17_0_Reserved" 1 "ICMSwReq_Reserve17_1_Reserved" 2 "ICMSwReq_Reserve17_2_Reserved" 3 "ICMSwReq_Reserve17_3_Reserved";
VAL_ 707 IICMSwReq_Reserve16 0 "ICMSwReq_Reserve16_0_Reserved" 1 "ICMSwReq_Reserve16_1_Reserved" 2 "ICMSwReq_Reserve16_2_Reserved" 3 "ICMSwReq_Reserve16_3_Reserved";
VAL_ 707 IICMSwReq_Reserve20 0 "ICMSwReq_Reserve20_0_Reserved" 1 "ICMSwReq_Reserve20_1_Reserved" 2 "ICMSwReq_Reserve20_2_Reserved" 3 "ICMSwReq_Reserve20_3_Reserved";
VAL_ 707 IICMwarnType1_Rsrv01 0 "ICMwarnType1_Rsrv01_0_Reserved" 1 "ICMwarnType1_Rsrv01_1_Reserved" 2 "ICMwarnType1_Rsrv01_2_Reserved" 3 "ICMwarnType1_Rsrv01_3_Reserved";
VAL_ 707 IICMwarnType1_Rsrv02 0 "ICMwarnType1_Rsrv02_0_Reserved" 1 "ICMwarnType1_Rsrv02_1_Reserved" 2 "ICMwarnType1_Rsrv02_2_Reserved" 3 "ICMwarnType1_Rsrv02_3_Reserved";
VAL_ 707 IICMwarnType3_Rsrv01 0 "CldBdyAdjSts_0_Noaction" 1 "CldBdyAdjSts_1_LeftLiftAndRightLower" 2 "CldBdyAdjSts_2_LeftLiftAndRightKeep" 3 "CldBdyAdjSts_3_LeftLowerAndRightLift" 4 "CldBdyAdjSts_4_LeftLowerAndRightKeep" 5 "CldBdyAdjSts_5_LeftKeepAndRightLift" 6 "CldBdyAdjSts_6_LeftKeepAndRightLower" 7 "CldBdyAdjSts_7_Complete" 8 "CldBdyAdjSts_8_Exiting" 9 "CldBdyAdjSts_9_Pending" 10 "CldBdyAdjSts_10_Timeout" 11 "CldBdyAdjSts_11_Failure" 12 "CldBdyAdjSts_12_Reserved" 13 "CldBdyAdjSts_13_Reserved" 14 "CldBdyAdjSts_14_Reserved" 15 "CldBdyAdjSts_15_Reserved";
VAL_ 707 IICMwarnType1_Rsrv03 0 "VMCAPCSetSts_0_SignalNotAvailable" 1 "VMCAPCSetSts_1_Enable" 2 "VMCAPCSetSts_2_Disable";
VAL_ 707 IICMwarnType1_Rsrv04 0 "ICMwarnType1_Rsrv04_0_Reserved" 1 "ICMwarnType1_Rsrv04_1_Reserved" 2 "ICMwarnType1_Rsrv04_2_Reserved" 3 "ICMwarnType1_Rsrv04_3_Reserved";
VAL_ 707 IICMwarnType1_Rsrv05 0 "ICMwarnType1_Rsrv05_0_Reserved" 1 "ICMwarnType1_Rsrv05_1_Reserved" 2 "ICMwarnType1_Rsrv05_2_Reserved" 3 "ICMwarnType1_Rsrv05_3_Reserved";
VAL_ 308 IAPAEPBOPReq 0 "APAEPBOPReq_0_No_Request" 1 "APAEPBOPReq_1_Apply" 2 "APAEPBOPReq_2_Release";
VAL_ 308 IAPASCSAcclReqSts 0 "APASCSAcclReqSts_0_NoRequest" 1 "APASCSAcclReqSts_1_DecelerationRequest";
VAL_ 308 IAPAEPBOPReqV 0 "APAEPBOPReqV_0_Valid" 1 "APAEPBOPReqV_1_Invalid";
VAL_ 308 IAutodDrvngSysSCSSdslReqV 0 "AutodDrvngSysSCSSdslReqV_0_Valid" 1 "AutodDrvngSysSCSSdslReqV_1_Invalid";
VAL_ 308 IAutodDrvngSysSCSSdslReq 0 "AutodDrvngSysSCSSdslReq_0_NoRequest" 1 "AutodDrvngSysSCSSdslReq_1_request";
VAL_ 308 IAutodDrvngSysSCSDrvOffReqV 0 "AutodDrvngSysSCSDrvOffReqV_0_Valid" 1 "AutodDrvngSysSCSDrvOffReqV_1_Invalid";
VAL_ 308 IAutodDrvngSysSCSDrvOffReq 0 "AutodDrvngSysSCSDrvOffReq_0_NoRequest" 1 "AutodDrvngSysSCSDrvOffReq_1_DriveOffRequest";
VAL_ 308 IAutodDrvngSysMdReqV 0 "AutodDrvngSysMdReqV_0_Valid" 1 "AutodDrvngSysMdReqV_1_Invalid";
VAL_ 308 IAutodDrvngSysMdReq 0 "AutodDrvngSysMdReq_0_DriverModeRequest" 1 "AutodDrvngSysMdReq_1_AutomatedDriverModeRequest";
VAL_ 308 IAutodDrvngSysFlrStsV 0 "AutodDrvngSysFlrStsV_0_Valid" 1 "AutodDrvngSysFlrStsV_1_Invalid";
VAL_ 308 IAutodDrvngSysFlrSts 0 "AutodDrvngSysFlrSts_0_NoError" 1 "AutodDrvngSysFlrSts_1_PerformanceDegradation" 2 "AutodDrvngSysFlrSts_2_SystemUnavailable" 3 "AutodDrvngSysFlrSts_3_Reserved" 4 "AutodDrvngSysFlrSts_4_Reserved" 5 "AutodDrvngSysFlrSts_5_Reserved" 6 "AutodDrvngSysFlrSts_6_Reserved" 7 "AutodDrvngSysFlrSts_7_Reserved";
VAL_ 774 ITrfcLghtFuctionSwSts 0 "TrfcLghtFuctionSwSts_0_Trfclghtfnswsts_0_Unavailable" 1 "TrfcLghtFuctionSwSts_1_TrfcLghtFnSwSts_1_OFF" 2 "TrfcLghtFuctionSwSts_2_TrfcLghtFnSwSts_2_Warning" 3 "TrfcLghtFuctionSwSts_3_TrfcLghtFnSwSts_3_Contorl";
VAL_ 774 IAPASpdMdSwSts 0 "APASpdMdSwSts_0_Disable" 1 "APASpdMdSwSts_1_Fast" 2 "APASpdMdSwSts_2_Slow" 3 "APASpdMdSwSts_3_Reserved";
VAL_ 807 IEndToEndPilotSwSts 0 "EndToEndPilotSwSts_0_Endtoendpilotswsts_0_Unavailable" 1 "EndToEndPilotSwSts_1_ON" 2 "EndToEndPilotSwSts_2_OFF";
VAL_ 807 IDLP_NarwSpcAstSts 0 "DLP_NarwSpcAstSts_0_Off" 1 "DLP_NarwSpcAstSts_1_ForwardWorking" 2 "DLP_NarwSpcAstSts_2_BackwardWorking";
VAL_ 807 IACCSLIFMsgResp 0 "ACCSLIFMsgResp_0_NoRequest" 1 "ACCSLIFMsgResp_1__Off" 2 "ACCSLIFMsgResp_2__ON" 3 "ACCSLIFMsgResp_3_Reserved" 4 "ACCSLIFMsgResp_4_Reserved" 5 "ACCSLIFMsgResp_5_Reserved" 6 "ACCSLIFMsgResp_6_Reserved" 7 "ACCSLIFMsgResp_7_Reserved";
VAL_ 807 ISLIFSts_IPD 0 "SLIFSts_IPD_0_Off" 1 "SLIFSts_IPD_1_Active" 2 "SLIFSts_IPD_2_Overspeed" 3 "SLIFSts_IPD_3_Standby" 4 "SLIFSts_IPD_4_Fault";
VAL_ 807 ITSRSts 0 "TSRSts_0_Off" 1 "TSRSts_1_Active" 3 "TSRSts_3_Standby" 4 "TSRSts_4_Fault";
VAL_ 807 ITSRSwReqResp 0 "TSRSwReqResp_0_Unavailable" 1 "TSRSwReqResp_1_Off" 2 "TSRSwReqResp_2_On";
VAL_ 807 ITSRTrgtBanSign 0 "TSRTrgtBanSign_0_NoSign" 1 "TSRTrgtBanSign_1_NoOvertake" 2 "TSRTrgtBanSign_2_NoAnimalPowerVehicle" 3 "TSRTrgtBanSign_3_NoBus" 4 "TSRTrgtBanSign_4_NoElectricTricycle" 5 "TSRTrgtBanSign_5_NoTurnaround" 6 "TSRTrgtBanSign_6_NoBicycle" 7 "TSRTrgtBanSign_7_NoTruckLeft" 8 "TSRTrgtBanSign_8_NoTrailer" 9 "TSRTrgtBanSign_9_NoWalkers" 10 "TSRTrgtBanSign_10_NoCar" 11 "TSRTrgtBanSign_11_NoWhistle" 12 "TSRTrgtBanSign_12_NoMotorcycle" 13 "TSRTrgtBanSign_13_NoObjectshown" 14 "TSRTrgtBanSign_14_NoStraight" 15 "TSRTrgtBanSign_15_NoRickshaw" 16 "TSRTrgtBanSign_16_NoHumanpoweredtrucks" 17 "TSRTrgtBanSign_17_NoHumanpoweredtricycles" 18 "TSRTrgtBanSign_18_NoTractor" 19 "TSRTrgtBanSign_19_NoRightTurn" 20 "TSRTrgtBanSign_20_NoLeftRightTurn" 21 "TSRTrgtBanSign_21_NoStraightRightTurn" 22 "TSRTrgtBanSign_22_NolowSpeedtruck" 23 "TSRTrgtBanSign_23_NoLeftTurn" 24 "TSRTrgtBanSign_24_NoCarTurnRight" 25 "TSRTrgtBanSign_25_NoCar" 26 "TSRTrgtBanSign_26_NoTruck" 27 "TSRTrgtBanSign_27_NoDangerousgoodvehicle" 28 "TSRTrgtBanSign_28_NoStraightLeftTurn" 29 "TSRTrgtBanSign_29_Quality_Limit" 30 "TSRTrgtBanSign_30_Axle_load_Limit" 31 "TSRTrgtBanSign_31_Custom" 32 "TSRTrgtBanSign_32_Check" 33 "TSRTrgtBanSign_33_NoParking" 34 "TSRTrgtBanSign_34_NoLongParking" 35 "TSRTrgtBanSign_35_Higth_limit_350cm" 36 "TSRTrgtBanSign_36_Width_limit_300cm" 37 "TSRTrgtBanSign_37_StopGiveWay" 38 "TSRTrgtBanSign_38_GiveWay" 39 "TSRTrgtBanSign_38_NoPass" 40 "TSRTrgtBanSign_40_OncomingGiveWay" 41 "TSRTrgtBanSign_41_NoEntry" 42 "TSRTrgtBanSign_42_RelieveNoOvertake";
VAL_ 807 ITSRTrgtWarnSign 0 "TSRTrgtWarnSign_0_NoSign" 1 "TSRTrgtWarnSign_1_Dangerous_road_by_mountain_Right" 2 "TSRTrgtWarnSign_2_Dangerous_road_by_mountain_Left" 3 "TSRTrgtWarnSign_3_Town" 4 "TSRTrgtWarnSign_4_Dike_Road_Right" 5 "TSRTrgtWarnSign_5_Dike_Road_Left" 6 "TSRTrgtWarnSign_6_T_Crossover" 7 "TSRTrgtWarnSign_7_Ferry" 8 "TSRTrgtWarnSign_8_Narrowing" 9 "TSRTrgtWarnSign_9_Falling_Rocks_Left" 10 "TSRTrgtWarnSign_10_ReverseCurveL" 11 "TSRTrgtWarnSign_11_ReverseCurveR" 12 "TSRTrgtWarnSign_12_Waterway" 13 "TSRTrgtWarnSign_13_Crossroad" 14 "TSRTrgtWarnSign_14_Intersection" 15 "TSRTrgtWarnSign_15_Y_Crossing_LR" 16 "TSRTrgtWarnSign_16_Y_Crossing_RR" 17 "TSRTrgtWarnSign_17_Y_Crossing_LF" 18 "TSRTrgtWarnSign_18_Narrowing_Left" 19 "TSRTrgtWarnSign_19_Y_Crossing_RF" 20 "TSRTrgtWarnSign_20_T_Intersection" 21 "TSRTrgtWarnSign_21_T_Intersection_Left" 22 "TSRTrgtWarnSign_22_T_Intersection_Right" 23 "TSRTrgtWarnSign_23_Roundabout" 24 "TSRTrgtWarnSign_24_ContinuousBend" 25 "TSRTrgtWarnSign_25_ContinuousDownhill" 26 "TSRTrgtWarnSign_26_Uneven" 27 "TSRTrgtWarnSign_27_Rain" 28 "TSRTrgtWarnSign_28_Low_lying_Road" 29 "TSRTrgtWarnSign_29_Convex_Road" 30 "TSRTrgtWarnSign_30_Slow" 31 "TSRTrgtWarnSign_31_Uphill" 32 "TSRTrgtWarnSign_32_WarnWorks" 33 "TSRTrgtWarnSign_33_Cross_Plane" 34 "TSRTrgtWarnSign_34_AccidentProneSection" 35 "TSRTrgtWarnSign_35_Two_way_traffic" 36 "TSRTrgtWarnSign_36_WarnWildanimal" 37 "TSRTrgtWarnSign_37_Tunnel" 38 "TSRTrgtWarnSign_38_lightingIntoTunnel" 39 "TSRTrgtWarnSign_39_Arched_bridge" 40 "TSRTrgtWarnSign_40_Unguarded_railway_crossing" 41 "TSRTrgtWarnSign_41_Downhill" 42 "TSRTrgtWarnSign_42_SharpTurnR" 43 "TSRTrgtWarnSign_43_SharpTurnL" 44 "TSRTrgtWarnSign_44_Easy_slide" 45 "TSRTrgtWarnSign_45_Traffic_Light" 46 "TSRTrgtWarnSign_46_Guarded_railway_crossing" 47 "TSRTrgtWarnSign_47_Narrowing_Right" 48 "TSRTrgtWarnSign_48_Passfromright" 49 "TSRTrgtWarnSign_49_Narrow_bridge" 50 "TSRTrgtWarnSign_50_Maintaindistance" 51 "TSRTrgtWarnSign_51_ThunderStorm" 52 "TSRTrgtWarnSign_52_Warn_handicapped" 53 "TSRTrgtWarnSign_53_Tidal_driveway" 54 "TSRTrgtWarnSign_54_Fog" 55 "TSRTrgtWarnSign_55_WarnKids" 56 "TSRTrgtWarnSign_56_WarnBike" 57 "TSRTrgtWarnSign_57_WarnPed" 58 "TSRTrgtWarnSign_58_ConfluenceL" 59 "TSRTrgtWarnSign_59_ConfluenceR" 60 "TSRTrgtWarnSign_60_WarnCrosswind" 61 "TSRTrgtWarnSign_61_Snow" 62 "TSRTrgtWarnSign_62_Falling_Rocks_Right" 63 "TSRTrgtWarnSign_63_WarnRisk" 64 "TSRTrgtWarnSign_64_WarnCattle" 65 "TSRTrgtWarnSign_65_Passfromleft" 66 "TSRTrgtWarnSign_66_Passfromleftright" 67 "TSRTrgtWarnSign_67_Warnqueue" 68 "TSRTrgtWarnSign_68_SpeedHump" 69 "TSRTrgtWarnSign_69_AccidentManagement" 70 "TSRTrgtWarnSign_70_IcyRoad";
SIG_GROUP_ 308 IZXD_20ms_Group07 1 : IAIPkgAPASCSAcclReqVal IAPAEPBOPReq IAPAEPBOPReqV IAPASCSAcclReqSts IAutodDrvngSysFlrSts IAutodDrvngSysFlrStsV IAutodDrvngSysMdReq IAutodDrvngSysMdReqV IAutodDrvngSysSCSDrvOffReq IAutodDrvngSysSCSDrvOffReqV IAutodDrvngSysSCSSdslReq IAutodDrvngSysSCSSdslReqV IZXD_20ms_Group07_CRC IZXD_20ms_Group07_RC IZXD_20ms_Group07_Reserved1 IZXD_20ms_Group07_Reserved2 IZXD_20ms_Group07_Reserved3 IZXD_20ms_Group07_Reserved4 IZXD_20ms_Group07_Reserved5 IZXD_20ms_Group07_Reserved6;
SIG_GROUP_ 774 ICBAD_100ms_PDU32 1 : ITrfcLghtFuctionSwSts IAPASpdMdSwSts IParkngInPrgs;
SIG_GROUP_ 774 IPD_100ms_PDU105 2 : ITrfcMrgdInfoSignDist ITrfcMrgdForbidDist ITrfcMrgdWrnngSignDist;
SIG_GROUP_ 774 IPD_100ms_PDU109 3 : ITrfcMrgdForbidSign;
SIG_GROUP_ 774 IPD_100ms_PDU110 4 : ITrfcMrgdWrnngSign;
SIG_GROUP_ 807 ICBAD_100ms_PDU35 1 : IEndToEndPilotSwSts IDLP_NarwSpcAstSts;
SIG_GROUP_ 807 ICBAD_ZONE_100ms_PDU32 2 : IACCSLIFMsgResp ISLIFSts_IPD ITSRSts ITSRSwReqResp ITSRTrgtBanSign ITSRTrgtWarnSign ISpdAstSysTrgtSpd_IPD;
SIG_GROUP_ 807 IPD_100ms_PDU111 3 : ITrfcMrgdInfoSign;
